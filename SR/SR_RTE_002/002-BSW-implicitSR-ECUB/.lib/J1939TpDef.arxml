AUTOSAR XML (schema 4-2-2)
package /AUTOSAR
  module definition J1939Tp [0..1]: post-build-variant-support=true, variants link-time/post-build/pre-compile  # Configuration of the J1939Tp (J1939 Transport Protocol) module.
    container J1939TpGeneral  # This container describes the general configuration parameters of the J1939Tp module.
      boolean J1939TpCancellationSupport [0..1]: multiplicity set at pre-compile, set at pre-compile, default-value=false  # Enable transmit and receive cancellation. | The APIs J1939Tp_CancelTransmit() and J1939Tp_CancelReceive() will only be available when this parameter is enabled.
      boolean J1939TpDevErrorDetect: set at pre-compile, default-value=true  # Switches the Default Error Tracer (Det) detection and notification ON or OFF. | * true: enabled (ON). * false: disabled (OFF).
      boolean J1939TpVersionInfoApi: set at pre-compile  # The function J1939Tp_GetVersionInfo is configurable (On/Off) by this configuration parameter.
      float J1939TpMainFunctionPeriod: 0..Inf, scope=ECU, set at pre-compile, default-value=0.01  # Allow to configure the time for the MainFunction (in seconds). | Please note: This configuration value shall be equal to the value in the ScheduleManager module.
      float J1939TpTxConfTimeout: 0..65.535, set at pre-compile, default-value=0  # Timeout in seconds for the CanIf Tx confirmation. After this time the J1939Tp assumes that an N-PDU could not be transmitted. | Please note: The Tx confirmation timeout should be set to a value that enabled detection of a lost Tx confirmation in time, and that ensures that normal transmission delay caused by lower message priority does not lead to an error.
    container J1939TpConfiguration  # This container contains the configuration parameters and sub containers of the J1939Tp module that define the communication paths.
      container J1939TpRxChannel [0..*]  # This container describes a reception channel of the J1939Tp module. A channel referencing N-PDUs without MetaData is used for all N-SDUs that share the same source address (SA) and the same destination address (BAM: DA = 0xFF, CMDT: DA != 0xFF). A channel with N-PDUs with MetaData is used for all possible source and destination addresses.
        boolean J1939TpRxCancellationSupport [0..1]: multiplicity set at pre-compile, set at pre-compile, default-value=true  # Enable receive cancellation using the API J1939Tp_CancelReceive() for this channel.
        boolean J1939TpRxDynamicBlockCalculation [0..1]: multiplicity set at pre-compile, set at pre-compile, default-value=true  # Enable dynamic calculation of "number of packets that can be sent" value in TP.CM_CTS, based on the size of buffers in upper layers reported via StartOfReception and PduR_J1939TpCopyRxData.
        boolean J1939TpRxRetrySupport [0..1]: multiplicity set at pre-compile, set at pre-compile, default-value=true  # Enable support for triggering repetition of failed transmission using TP.CM_CTS with a packet number that has already been sent. Retransmission is triggered when a sequence number is missing or a timeout occurs during reception.
        integer J1939TpRxDynamicBufferRatio [0..1]: 0..100, multiplicity set at pre-compile, set at pre-compile, default-value=80, default-value=0  # Percentage of available buffer that shall be used for retry. | This parameter is only applicable when "J1939TpRxRetrySupport" and "J1939TpRxDynamicBlockCalculation" are enabled.
        integer J1939TpRxPacketsPerBlock [0..1]: 1..255, multiplicity set at pre-compile, set at pre-compile, default-value=16, default-value=1  # Number of TP.DT frames the receiving J1939Tp module allows the sender to send before waiting for another TP.CM_CTS. This parameter is transmitted in the TP.CM_CTS frame, and is thus only relevant for reception of messages via CMDT. When J1939TpRxDynamicBlockCalculation is enabled, this parameter specifies a maximum for the calculated value. For further details on this parameter value see SAE J1939/21.
        enumeration J1939TpRxProtocolType [0..1]: {J1939TP_PROTOCOL_BAM, J1939TP_PROTOCOL_CMDT}, multiplicity set at pre-compile, set at pre-compile, default-value=J1939TP_PROTOCOL_BAM  # Protocol type used by this channel. This parameter is only required for channels with fixed destination address.
        integer J1939TpRxSa [0..1]: 0..253, multiplicity set at post-build in variant link-time+post-build / pre-compile in variant pre-compile, post-build-variant-multiplicity=true, post-build-variant-value=true, set at post-build in variant link-time+post-build / pre-compile in variant pre-compile  # Source address (SA) of this channel. This parameter is only required for channels with fixed SA which use N-PDUs with MetaData.
        integer J1939TpRxDa [0..1]: 0..253, multiplicity set at post-build in variant link-time+post-build / pre-compile in variant pre-compile, post-build-variant-multiplicity=true, post-build-variant-value=true, set at post-build in variant link-time+post-build / pre-compile in variant pre-compile  # Destination address (DA) of this channel. This parameter is only required for channels with fixed DA which use N-PDUs with MetaData containing the DA.
        container J1939TpRxCmNPdu  # This N-PDU represents the TP.CM frame of a J1939 transport protocol session. TP.CM is used both by BAM and CMDT to initialize the connection. For CMDT, it is also used to abort the connection.
          string J1939TpRxCmNPduId: scope=ECU, set at pre-compile, symbolic-name-value=true  # The N-PDU identifier used for communication with CanIf.
          reference J1939TpRxCmNPduRef: post-build-variant-value=true, set at post-build in variant link-time+post-build / pre-compile in variant pre-compile, destination=Pdu  # Reference to the Pdu object representing the N-PDU.
        container J1939TpRxDtNPdu  # This N-PDU represents the TP.DT frame of a J1939 transport protocol session. TP.DT is used both by BAM and CMDT to transfer the contents of an N-SDU.
          string J1939TpRxDtNPduId: scope=ECU, set at pre-compile, symbolic-name-value=true  # The N-PDU identifier used for communication with CanIf.
          reference J1939TpRxDtNPduRef: post-build-variant-value=true, set at post-build in variant link-time+post-build / pre-compile in variant pre-compile, destination=Pdu  # Reference to the Pdu object representing the N-PDU.
        container J1939TpRxPg [1..*]  # Parameter group received by the J1939 transport layer.
          boolean J1939TpRxPgDynLength: set at pre-compile  # This flag is set to TRUE when the N-SDU refers to a PGN with variable length. | Please note: When this attribute is TRUE, the sub container J1939TpRxDirectNPdu is required.
          integer J1939TpRxPgPGN: 0..262143, set at pre-compile, default-value=0  # PGN of the referenced N-SDUs.
          container J1939TpRxDirectNPdu [0..1]  # This N-PDU represents the short frame that is used for a dynamic length PGN when it has a length of less that 8 bytes. | Please note: This sub container is only necessary when J1939TpRxPgDynLength is TRUE.
            string J1939TpRxDirectNPduId: scope=ECU, set at pre-compile, symbolic-name-value=true  # The N-PDU identifier used for communication with CanIf.
            reference J1939TpRxDirectNPduRef: post-build-variant-value=true, set at post-build in variant link-time+post-build / pre-compile in variant pre-compile, destination=Pdu  # Reference to the Pdu object representing the N-PDU.
          container J1939TpRxNSdu [1..*]  # This container describes the parameters that are relevant for the reception of a specific N-SDU.
            string J1939TpRxNSduId: scope=ECU, set at pre-compile, symbolic-name-value=true  # This is a unique identifier for a received N-SDU. This Id is used in the CancelReceive and ChangeParameter API call.
            reference J1939TpRxNSduRef: post-build-variant-value=true, set at post-build in variant link-time+post-build / pre-compile in variant pre-compile, destination=Pdu  # Reference to the Pdu object representing the N-SDU.
        container J1939TpTxFcNPdu [0..1]  # This N-PDU represents the TP.CM frame that is used in reverse direction for a J1939 transport protocol session using the CMDT protocol type. TP.CM in reverse direction is used for intermediate and final acknowledgement of received data and to abort the connection. | Please note: This sub container is only required when J1939TpRxProtocolType is J1939TP_PROTOCOL_CMDT or when it is not configured at all.
          string J1939TpTxFcNPduTxConfId: scope=ECU, set at pre-compile, symbolic-name-value=true  # The N-PDU identifier used for Tx confirmation from CanIf.
          reference J1939TpTxFcNPduRef: post-build-variant-value=true, set at post-build in variant link-time+post-build / pre-compile in variant pre-compile, destination=Pdu  # Reference to the Pdu object representing the N-PDU. | Please note: When two channels have identical but exchanged source and destination addresses, the Pdu referenced by this parameter is shared with J1939TpTxCmNPduRef of the corresponding J1939TpTxChannel.
      container J1939TpTxChannel [0..*]  # This container describes a transmission channel of the J1939Tp module. A channel referencing N-PDUs without MetaData is used for all N-SDUs that share the same source address (SA) and the same destination address (BAM: DA = 0xFF, CMDT: DA != 0xFF). A channel with N-PDUs with MetaData is used for all possible source and destination addresses.
        boolean J1939TpTxCancellationSupport [0..1]: multiplicity set at pre-compile, set at pre-compile, default-value=true  # Enable transmit cancellation using the API J1939Tp_CancelTransmit() for this channel.
        boolean J1939TpTxDynamicBlockCalculation [0..1]: multiplicity set at pre-compile, set at pre-compile, default-value=true  # Enable dynamic calculation of "maximum number of packets that can be sent" value in TP.CM_RTS, based on the available amount of data in upper layers reported via PduR_J1939TpCopyTxData.
        boolean J1939TpTxRetrySupport [0..1]: multiplicity set at pre-compile, set at pre-compile, default-value=true  # Enable support for repetition of failed transmission using TP.CM_CTS with a packet number that has already been sent. Retransmission is handled via the retry feature of PduR_J1939TpCopyTxData.
        integer J1939TpTxMaxPacketsPerBlock [0..1]: 1..255, multiplicity set at pre-compile, set at pre-compile, default-value=255, default-value=1  # Maximum number of TP.DT frames the transmitting J1939Tp module is ready to send before waiting for another TP.CM_CTS. This parameter is transmitted in the TP.CM_RTS frame, and is thus only relevant for transmission of messages via CMDT. When J1939TpTxDynamicBlockCalculation is enabled, this parameter specifies a maximum for the calculated value. For further details on this parameter value see SAE J1939/21.
        enumeration J1939TpTxProtocolType [0..1]: {J1939TP_PROTOCOL_BAM, J1939TP_PROTOCOL_CMDT}, multiplicity set at pre-compile, set at pre-compile, default-value=J1939TP_PROTOCOL_BAM  # Protocol type used by this channel. This parameter is only required for channels with fixed destination address.
        integer J1939TpTxSa [0..1]: 0..253, multiplicity set at post-build in variant link-time+post-build / pre-compile in variant pre-compile, post-build-variant-multiplicity=true, post-build-variant-value=true, set at post-build in variant link-time+post-build / pre-compile in variant pre-compile  # Source address (SA) of this channel. This parameter is only required for channels with fixed SA which use N-PDUs with MetaData.
        integer J1939TpTxDa [0..1]: 0..253, multiplicity set at post-build in variant link-time+post-build / pre-compile in variant pre-compile, post-build-variant-multiplicity=true, post-build-variant-value=true, set at post-build in variant link-time+post-build / pre-compile in variant pre-compile  # Destination address (DA) of this channel. This parameter is only required for channels with fixed DA which use N-PDUs with MetaData containing the DA.
        container J1939TpRxFcNPdu [0..1]  # This N-PDU represents the TP.CM frame that is used in reverse direction for a J1939 transport protocol session using the CMDT protocol type. TP.CM in reverse direction is used for intermediate and final acknowledgement of received data and to abort the connection. | Please note: This sub container is only required when J1939TpRxProtocolType is J1939TP_PROTOCOL_CMDT or when it is not configured at all.
          string J1939TpRxFcNPduId: scope=ECU, set at pre-compile, symbolic-name-value=true  # The N-PDU identifier used for communication with CanIf.
          reference J1939TpRxFcNPduRef: post-build-variant-value=true, set at post-build in variant link-time+post-build / pre-compile in variant pre-compile, destination=Pdu  # Reference to the Pdu object representing the N-PDU. | Please note: When two channels have identical but exchanged source and destination addresses, the Pdu referenced by this parameter is shared with J1939TpRxCmNPduRef of the corresponding J1939TpRxChannel.
        container J1939TpTxCmNPdu  # This N-PDU represents the TP.CM frame of a J1939 transport protocol session. TP.CM is used both by BAM and CMDT to initialize the connection. For CMDT, it is also used to abort the connection.
          string J1939TpTxCmNPduTxConfId: scope=ECU, set at pre-compile, symbolic-name-value=true  # The N-PDU identifier used for Tx confirmation from CanIf.
          reference J1939TpTxCmNPduRef: post-build-variant-value=true, set at post-build in variant link-time+post-build / pre-compile in variant pre-compile, destination=Pdu  # Reference to the Pdu object representing the N-PDU.
        container J1939TpTxDtNPdu  # This N-PDU represents the TP.DT frame of a J1939 transport protocol session. TP.DT is used both by BAM and CMDT to transfer the contents of an N-SDU.
          string J1939TpTxDtNPduTxConfId: scope=ECU, set at pre-compile, symbolic-name-value=true  # The N-PDU identifier used for Tx confirmation from CanIf.
          reference J1939TpTxDtNPduRef: post-build-variant-value=true, set at post-build in variant link-time+post-build / pre-compile in variant pre-compile, destination=Pdu  # Reference to the Pdu object representing the N-PDU.
        container J1939TpTxPg [1..*]  # Parameter group transmitted by the J1939 transport layer.
          boolean J1939TpTxPgDynLength: set at pre-compile  # This flag is set to TRUE when the N-SDU refers to a PGN with variable length. | Please note: When this attribute is TRUE, the sub container J1939TpTxDirectNPdu is required.
          integer J1939TpTxPgPGN: 0..262143, set at pre-compile, default-value=0  # PGN of the referenced N-SDUs.
          container J1939TpTxDirectNPdu [0..1]  # This N-PDU represents the short frame that is used for a dynamic length PGN when it has a length of less that 8 bytes. | Please note: This sub container is only necessary when J1939TpTxPgDynLength is TRUE.
            string J1939TpTxDirectNPduTxConfId: scope=ECU, set at pre-compile, symbolic-name-value=true  # The N-PDU identifier used for Tx confirmation from CanIf.
            reference J1939TpTxDirectNPduRef: post-build-variant-value=true, set at post-build in variant link-time+post-build / pre-compile in variant pre-compile, destination=Pdu  # Reference to the Pdu object representing the N-PDU.
          container J1939TpTxNSdu [1..*]  # This container describes the parameters that are relevant for the transmission of a specific N-SDU.
            string J1939TpTxNSduId: scope=ECU, set at pre-compile, symbolic-name-value=true  # The N-SDU identifier used for communication with PduR.
            reference J1939TpTxNSduRef: post-build-variant-value=true, set at post-build in variant link-time+post-build / pre-compile in variant pre-compile, destination=Pdu  # Reference to the Pdu object representing the N-SDU.
