AUTOSAR XML (schema 4-2-2)
package /AUTOSAR/System
  system system_0
    system mapping SystemMapping_0
      sw-impl-mappings:
        swc to impl mapping CptReceiverPrototypeImplMapping: component-implementation=swcImplementation_Receiver, component=rootSwCompositionPrototype_0.BottomComposition.CptReceiverPrototype.CptReceiverPrototype
        swc to impl mapping CptSenderPrototypeImplMapping: component-implementation=swcImplementation_Sender, component=rootSwCompositionPrototype_0.BottomComposition.CptSenderPrototype.CptSenderPrototype
      sw-mappings:
        swc to ecu mapping ECUA_SwcToEcuMapping: component=rootSwCompositionPrototype_0.BottomComposition.BottomComposition, ecu-instance=ECUA
        swc to ecu mapping ECUB_SwcToEcuMapping: component=rootSwCompositionPrototype_0.BottomComposition.CptReceiverPrototype.CptReceiverPrototype
    root-software-compositions:
      root sw composition prototype rootSwCompositionPrototype_0: software-composition=TopComposition
package /AUTOSAR/Compositions
  composition sw component type BottomComposition
    component CptReceiverPrototype: type=CptReceiver
    component CptSenderPrototype: type=CptSender
    connect CptSenderPrototype.PpExplict -> CptReceiverPrototype.RpExplicit
  composition sw component type TopComposition
    component BottomComposition: type=BottomComposition
package /AUTOSAR/SwcImplementations
  swc implementation swcImplementation_Sender: behavior=IbSender
  swc implementation swcImplementation_Receiver: behavior=IbReceiver
