AUTOSAR XML (schema 4-2-2)
package /AUTOSAR/System
  system system_0
    system mapping SystemMapping_0: sender-receiver-to-signal-group-mapping{data-element=BottomComposition.CptCtrl_1APrototype.rootSwCompositionPrototype_0.PpExplict.dataElementStruct, signal-group=SignalGroupStructA36_MsgStructA, type-mapping=sender-rec-record-type-mapping=record-element-mappings=[{implementation-record-element=Crc_Uint8, system-signal=SignalCrc8_MsgStructA}, {implementation-record-element=Data_Uint16, system-signal=SignalData16_MsgStructA}, {implementation-record-element=Counter_Uint8, system-signal=SignalCounter4_MsgStructA}, {implementation-record-element=Data_Uint8, system-signal=SignalData8_MsgStructA}]}
      sw-impl-mappings:
        swc to impl mapping CptReceiverPrototypeImplMapping: component-implementation=swcImplementation_CptObs_1A, component=rootSwCompositionPrototype_0.BottomComposition.CptObs_1APrototype.CptObs_1APrototype
        swc to impl mapping CptSenderPrototypeImplMapping: component-implementation=swcImplementation_CptCtrl_1A, component=rootSwCompositionPrototype_0.BottomComposition.CptCtrl_1APrototype.CptCtrl_1APrototype
        swc to impl mapping CptObs_BPrototypeImplMapping: component-implementation=swcImplementation_CptObs_1B, component=rootSwCompositionPrototype_0.BottomComposition.CptObs_1BPrototype.CptObs_1BPrototype
      sw-mappings:
        swc to ecu mapping ECUA_SwcToEcuMapping: ecu-instance=ECUA
          component:
            rootSwCompositionPrototype_0.BottomComposition.CptCtrl_1APrototype.CptCtrl_1APrototype
            rootSwCompositionPrototype_0.BottomComposition.CptObs_1APrototype.CptObs_1APrototype
        swc to ecu mapping ECUB_SwcToEcuMapping: component=rootSwCompositionPrototype_0.BottomComposition.CptObs_1APrototype.CptObs_1APrototype
        swc to ecu mapping ECUB_SwcToEcuMapping: component=rootSwCompositionPrototype_0.BottomComposition.CptObs_1BPrototype.CptObs_1BPrototype, ecu-instance=ECUB
    root-software-compositions:
      root sw composition prototype rootSwCompositionPrototype_0: software-composition=TopComposition
package /AUTOSAR/Compositions
  composition sw component type BottomComposition
    component CptObs_1APrototype: type=CptObs_1A
    component CptCtrl_1APrototype: type=CptCtrl_1A
    component CptObs_1BPrototype: type=CptObs_1B
    connect CptCtrl_1APrototype.PpExplict -> CptObs_1BPrototype.RpExplicit
    connect CptCtrl_1APrototype.PpExplict -> CptObs_1APrototype.RpExplicit
  composition sw component type TopComposition
    component BottomComposition: type=BottomComposition
package /AUTOSAR/SwcImplementations
  swc implementation swcImplementation_CptCtrl_1A: behavior=IbCtrl_1A
  swc implementation swcImplementation_CptObs_1A: behavior=IbObs_1A
  swc implementation swcImplementation_CptObs_1B: behavior=IbObs_1B
