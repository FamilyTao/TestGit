AUTOSAR XML (schema 4-2-2)
package /ECUA
  ecuc value collection ECUA: ecu-extract=system_0, ecuc-values=[EcuC, PduR, Os, Rte]
  module config EcuC
    EcuCGeneral: ByteOrder=LITTLE_ENDIAN
    EcucConfigSet
      EcucPduCollection: PduIdTypeEnum=UINT8, PduLengthTypeEnum=UINT8
    EcucPartitionCollection
  module config PduR
    PduRGeneral: PduRConfigType=PC_CONFIG, PduRDevErrorDetect=true, PduRMetaDataSupport=false, PduRVersionInfoApi=false, PduRZeroCostOperation=false
    PduRRoutingTables: PduRConfigurationId=0, PduRMaxRoutingPathCnt=20, PduRMaxRoutingPathGroupCnt=0, PduRMaxRoutingTableCnt=1
      PduRRoutingTable
  module config Os
    OsOS:
      OsNumberOfCores = 1
      OsScalabilityClass = SC1
      OsSystemStackSize = 1024
      OsStackMonitoring = false
      OsStatus = STANDARD
      OsUseGetServiceId = false
      OsUseParameterAccess = false
      OsUseResScheduler = true
      OsHooks: OsErrorHook=false, OsPostTaskHook=false, OsPreTaskHook=false, OsShutdownHook=false, OsStartupHook=false
    OSDEFAULTAPPMODE (OsAppMode)
    OsTask_10ms (OsTask): OsTaskActivation=1, OsTaskPriority=1, OsTaskSchedule=, OsTaskStackSize=100
    OsAlarm_10ms (OsAlarm): OsAlarmCounterRef=(unset)
      OsAlarmAction
        OsAlarmActivateTask: OsAlarmActivateTaskRef=OsTask_10ms
  module config Rte
    RteGeneration:
      RteBypassSupport = NONE
      RteCalibrationSupport = NONE
      RteCodeVendorId = 
      RteDevErrorDetect = false
      RteDevErrorDetectUninit = false
      RteGenerationMode = COMPATIBILITY_MODE
      RteInExclusiveAreaCheckEnabled = true
      RteIocInteractionReturnValue = RTE_IOC
      RteMeasurementSupport = false
      RteOptimizationMode = RUNTIME
      RteValueRangeCheckEnabled = false
      RteVfbTraceEnabled = false
      ArcGenerateWeakRunnableStubs = false
      ArcCalibrationFlashStartAddress = 
      RteVfbTrace = 
    RteInitializationBehavior: RteInitializationStrategy=, RteSectionInitializationPolicy=
    RteOsInteraction
    RteBswGeneral: RteSchMVersionInfoApi=false, RteUseComShadowSignalApi=false
    CptCtrlPrototypeInstance (RteSwComponentInstance): ArcGenerationEnabled=true, RteSoftwareComponentInstanceRef=CptCtrlPrototype, RteImplementationRef=swcImplementation_CptCtrl
      timingEvent_10_RunnableCtrl_RunnableMapping (RteEventToTaskMapping): RteImmediateRestart=false, RtePositionInTask=1, RteEventRef=timingEvent_10, RteMappedToTaskRef=OsTask_10ms
    CptObsPrototypeInstance (RteSwComponentInstance): ArcGenerationEnabled=true, RteSoftwareComponentInstanceRef=CptObsPrototype, RteImplementationRef=swcImplementation_CptObs
      timingEvent_10_Runnable_Obs_RunnableMapping (RteEventToTaskMapping): RteImmediateRestart=false, RtePositionInTask=0, RteEventRef=timingEvent_10, RteMappedToTaskRef=OsTask_10ms
