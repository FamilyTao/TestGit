AUTOSAR XML (schema 4-2-2)
package /AUTOSAR
  module definition CDD_FOTA [0..1]: post-build-variant-support=true, variants link-time/post-build/pre-compile  # Configuration of the FOTA (Diagnostic Communications Manager) module.
    container FOTAGeneral  # This container contains the configuration (parameters) for Component wide parameters
      boolean FOTAVersionInfoApi: set at pre-compile  # Preprocessor switch to enable or disable the output Version info of the functionality.
      boolean FOTADevErrorDetect: set at pre-compile  # Switches the Default Error Tracer (Det) detection and notification ON or OFF. | * true: enabled (ON). * false: disabled (OFF).
      integer FOTADcmRxBufferSize: 0..4294967295, scope=ECU, multiplicity set at pre-compile, set at pre-compile, default-value=0  # Maximum number of elements in buffer for handling of BSW errors (ref. to SWS_Dem_00207).
      enumeration FOTACrc: {CDD_FOTA_CRC8, CDD_FOTA_CRC8H2F, CDD_FOTA_CRC16, CDD_FOTA_CRC16ARC, CDD_FOTA_CRC32, CDD_FOTA_CRC32P4, CDD_FOTA_CRC64, CDD_FOTA_NONE_CRC}, set at pre-compile, default-value=CDD_FOTA_CRC8
      boolean FOTACrcBy37Enable: scope=ECU, set at pre-compile  # CRC verifies whether service 37 is used.
      boolean FOTABufferEnable: scope=ECU, set at pre-compile  # If set to FALSE the FOTA will not respond to diagnostic request that contains a service ID which is in the range from 0x40 to 0x7F or in the range from 0xC0 to 0xFF (Response IDs).
      boolean FOTAVirificCalloutEnable: multiplicity set at pre-compile, set at pre-compile, default-value=false  # This configuration switch defines, whether DDDID definition is stored non-volatile or not.
      integer FOTAProgramSize: 0..65535, scope=ECU, multiplicity set at pre-compile, set at pre-compile, default-value=0  # Fota Program Size
      integer FOTAEraseSize: 0..65535, scope=ECU, multiplicity set at pre-compile, set at pre-compile, default-value=0  # Fota Program Size
      function name FOTAVerificCallout: scope=ECU, multiplicity set at pre-compile, set at pre-compile, default-value=CDD_FOTA_VerificCallout  # Function name of prototype "DTCStatusChanged". [Std_ReturnType DemCallbackDTCStatusChangedFnc ( uint32 DTC, Dem_UdsStatusByteType DTCStatusOld, Dem_UdsStatusByteType DTCStatusNew); ]
      integer FOTAJumpAddressA: 0..4294967294, scope=ECU, set at link in variant link-time / pre-compile in variant post-build+pre-compile, default-value=0  # High memory address of a range allowed for writting.
      integer FOTAJumpAddressB: 0..4294967294, scope=ECU, set at link in variant link-time / pre-compile in variant post-build+pre-compile, default-value=0  # Low memory address of a range allowed for writting
      string FOTAHeaderFileInclusion [0..*]: scope=ECU, multiplicity set at pre-compile, set at pre-compile, regular-expression=[a-zA-Z0-9_]([a-zA-Z0-9\._])*  # Name of the header file(s) to be included by the FOTA module containing the used C-callback declarations.
      symbolic name reference FOTANvRamBlockIdRef: origin=AUTOSAR_ECUC V1.0.0, set at pre-compile, destination=NvMBlockDescriptor  # This reference contains the link to a non-volatile memory block. For post build time configurations worst case scenario shall be used.
      reference FOTAProtocolId: multiplicity set at pre-compile, set at pre-compile, destination=DcmDslProtocolRow  # This parameter is needed for function FOTA_GetVin
    container FOTAConfigSet  # This container contains the configuration parameters and sub containers of the FOTA module supporting multiple configuration sets.
      container FOTAWriteMemoryAppA [1..*]  # Provides the range of memory address allowed for writting.
        reference FOTAWriteMemoryRangeRef: multiplicity set at pre-compile, set at pre-compile, destination=DcmDspWriteMemoryRangeInfo  # Reference to DspWriteMemoryRange
      container FOTAWriteMemoryAppB [1..*]  # Provides the range of memory address allowed for writting.
        reference FOTAWriteMemoryRangeRef: multiplicity set at pre-compile, set at pre-compile, destination=DcmDspWriteMemoryRangeInfo  # Reference to DspWriteMemoryRange
