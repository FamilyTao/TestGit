AUTOSAR XML (schema 4-2-2)
package /AUTOSAR/Interfaces
  sender receiver interface SRIF_AllDataType: invalidation-policy{data-element=dataElementPrimitive, handle-invalid=KEEP}
    data dataElementPrimitive: invalid-value=3, type=PrimitiveUint16
    data dataElementArray: type=ArrayUint8
    data dataElementStruct: type=StructA
