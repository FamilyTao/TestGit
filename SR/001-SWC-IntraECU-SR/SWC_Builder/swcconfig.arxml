AUTOSAR XML (schema 4-2-2)
package /AUTOSAR/System
  system system_0
    system mapping SystemMapping_0: sender-receiver-to-signal-group-mapping{data-element=BottomComposition.CptReceiverPrototype.rootSwCompositionPrototype_0.ReceiverExplicit_Rp.structDE, signal-group=E2E_Demo_Group1_E2E_Msg_Profile1, type-mapping=sender-rec-record-type-mapping=record-element-mappings=[{implementation-record-element=Counter8, system-signal=E2E_Signal_Counter_E2E_Msg_Profile1}, {implementation-record-element=Crc8, system-signal=E2E_Signal_CRC_E2E_Msg_Profile1}, {implementation-record-element=Data16, system-signal=E2E_Signal_DATA_E2E_Msg_Profile1}]}
      sw-impl-mappings:
        swc to impl mapping CptReceiverPrototypeImplMapping: component-implementation=swcImplementation_Receiver, component=rootSwCompositionPrototype_0.BottomComposition.CptReceiverPrototype.CptReceiverPrototype
        swc to impl mapping CptSenderPrototypeImplMapping: component-implementation=swcImplementation_Sender, component=rootSwCompositionPrototype_0.BottomComposition.CptSenderPrototype.CptSenderPrototype
      sw-mappings:
        swc to ecu mapping ECUA_SwcToEcuMapping: component=rootSwCompositionPrototype_0.BottomComposition.CptSenderPrototype.CptSenderPrototype, ecu-instance=ECUA
        swc to ecu mapping ECUB_SwcToEcuMapping: component=rootSwCompositionPrototype_0.BottomComposition.CptReceiverPrototype.CptReceiverPrototype, ecu-instance=ECUB
    root-software-compositions:
      root sw composition prototype rootSwCompositionPrototype_0: software-composition=TopComposition
package /AUTOSAR/Compositions
  composition sw component type BottomComposition
    component CptReceiverPrototype: type=CptReceiver
    component CptSenderPrototype: type=CptSender
    connect CptSenderPrototype.SendExplict_Pp -> CptReceiverPrototype.ReceiverExplicit_Rp
  composition sw component type TopComposition
    component BottomComposition: type=BottomComposition
package /AUTOSAR/SwcImplementations
  swc implementation swcImplementation_Sender: behavior=IbSender
  swc implementation swcImplementation_Receiver: behavior=IbReceiver
package /AUTOSAR/DataTransformations
  data transformation set dataTransformationSet_0
    data transformation dataTransformation_StructE2E: execute-despite-data-unavailability=true, transformer-chain=[transformationTechnology_COMXf, transformationTechnologies_E2EXf]
    transformation technology transformationTechnology_COMXf: buffer-properties={header-length=12, in-place=false}, protocol=COMBased, transformer-class=SERIALIZER, version=1.0.0
    transformation technology transformationTechnologies_E2EXf:
      buffer-properties={header-length=0, in-place=true}
      protocol=E2E
      end-to-end-transformation-description{counter-offset=8, crc-offset=0, data-id-mode=ALL-16-BIT, data-id-nibble-offset=12, max-delta-counter=2, max-error-state-init=1, max-error-state-invalid=1, max-error-state-valid=1, max-no-new-or-repeated-data=14, min-ok-state-init=1, min-ok-state-invalid=2, min-ok-state-valid=1, offset=0, profile-behavior=R-4--2, profile-name=PROFILE_01, sync-counter-init=1, upper-header-bits-to-shift=0}
      transformer-class=SAFETY
      version=1.0.0
