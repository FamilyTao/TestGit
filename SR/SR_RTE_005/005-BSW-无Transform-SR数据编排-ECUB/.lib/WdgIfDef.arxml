AUTOSAR XML (schema 4-2-2)
package /AUTOSAR
  module definition WdgIf [0..1]: variants pre-compile  # Configuration of the WdgIf (Watchdog Interface) module.
    container WdgIfGeneral  # This container collects all generic watchdog interface parameters.
      boolean WdgIfDevErrorDetect: set at pre-compile, default-value=true  # Switches the Default Error Tracer (Det) detection and notification ON or OFF. | * true: enabled (ON). * false: disabled (OFF).
      boolean WdgIfVersionInfoApi: set at pre-compile  # Pre-processor switch to enable / disable the service returning the version information. | true: Version information service enabled false: Version information service disabled
      integer WdgIfNumberOfDevices: 1..255, set at pre-compile, symbolic-name-value=true, default-value=1  # Constant specifying the number of controlled watchdog drivers. Minimum number of watchdog drivers shall be one, maximum number limited by type of device index parameter. Can be calculated by counting the no. of references to the watchdog drivers.
      string WdgIfHeaderFileInclusion [0..*]: scope=ECU, multiplicity set at pre-compile, set at pre-compile, regular-expression=[a-zA-Z0-9_]([a-zA-Z0-9\._])*  # Name of the header file(s) to be included by the WdgIf module containing the used C-callback declarations.
    container WdgIfInternalDevice [0..128]  # It contains the information for the selection of a particular Watchdog device in case multiple Watchdog drivers are connected.
      integer WdgIfDeviceIndex: 0..255, scope=ECU, set at pre-compile, symbolic-name-value=true, default-value=0  # Represents the watchdog interface ID so that it can be referenced by the watchdog manager.
      function name TriggerConditionFunction: scope=ECU, multiplicity set at pre-compile, set at pre-compile, default-value=Wdg_SetTriggerCondition  # void <Api_Name>(unsigned short parameter). The parameter is the Timeout value (milliseconds) for setting the trigger counter which may not used for the external watchdog device.
      function name SetModeFunction: scope=ECU, multiplicity set at pre-compile, set at pre-compile, default-value=Wdg_SetMode  # unsigned char <Api_Name>(unsigned char parameter).The parameter is the watchdog mode, include WDGIF_OFF_MODE(0), WDGIF_FAST_MODE(1) and WDGIF_SLOW_MODE(2). For the external watchdog device, the WDGIF_FAST_MODE and WDGIF_SLOW_MODE may combine to the normal mode.
      symbolic name reference WdgIfDriverRef: set at pre-compile, destination=WdgGeneral  # Reference to the watchdog drivers that are controlled by the watchdog interface.
    container WdgIfExternalDevice [0..128]  # It contains the information for the selection of a particular Watchdog device in case multiple Watchdog drivers are connected.
      integer WdgIfExternalDeviceIndex: 0..255, scope=ECU, set at pre-compile, symbolic-name-value=true, default-value=0  # Represents the watchdog interface ID so that it can be referenced by the watchdog manager.
      function name TriggerConditionFunction: scope=ECU, multiplicity set at pre-compile, set at pre-compile, default-value=Wdg_SetTriggerCondition  # void <Api_Name>(unsigned short parameter). The parameter is the Timeout value (milliseconds) for setting the trigger counter which may not used for the external watchdog device.
      function name SetModeFunction: scope=ECU, multiplicity set at pre-compile, set at pre-compile, default-value=Wdg_SetMode  # unsigned char <Api_Name>(unsigned char parameter).The parameter is the watchdog mode, include WDGIF_OFF_MODE(0), WDGIF_FAST_MODE(1) and WDGIF_SLOW_MODE(2). For the external watchdog device, the WDGIF_FAST_MODE and WDGIF_SLOW_MODE may combine to the normal mode.
