AUTOSAR XML (schema 4-2-2)
package /AUTOSAR
  module definition EthIf [0..1]: post-build-variant-support=true, variants link-time/post-build/pre-compile  # Configuration of the EthIf (Ethernet Interface) module.
    container EthIfGeneral  # This container contains the general configuration parameters of the Ethernet Interface.
      boolean EthIfVlanUsed: set at pre-compile  # Switches the Virtual Local Area Networks (VLAN) ON or OFF. | * true: enabled (ON). * false: disabled (OFF).
      boolean EthIfDevErrorDetect: set at pre-compile, default-value=true  # Switches the Default Error Tracer (Det) detection and notification ON or OFF. | * true: enabled (ON). * false: disabled (OFF).
      boolean EthIfEnableRxInterrupt: set at pre-compile  # Enables / Disables receive interrupt.
      boolean EthIfEnableTxInterrupt: set at pre-compile  # Enables / Disables the transmit interrupt.
      boolean EthIfGetBaudRate: set at pre-compile  # Enables / Disables GetBaudRate API.
      boolean EthIfGetCounterState: set at pre-compile  # Enables / Disables GetCounterState API.
      boolean EthIfGetTransceiverWakeupModeApi [0..1]: multiplicity set at pre-compile, set at pre-compile, default-value=false  # Enables / Disables EthIf_GetTransceiverWakeupMode API
      boolean EthIfGlobalTimeSupport: set at pre-compile  # Enables/Disables the Global Time APIs used amongst others by Global Time Synchronization over Ethernet.
      float EthIfMainFunctionPeriod: 0..Inf, set at pre-compile, default-value=0.01  # Specifies the period of main function EthIf_MainFunctionRx and EthIf_MainFunctionTx in seconds. Ethernet Interface does not require this information but the BSW scheduler.
      float EthIfMainFunctionRxTimeout [0..1]: 0..Inf, set at pre-compile, default-value=0  # This parameter is deprecated and will be removed in future. Tags: atp.Status=obsolete, atp.StatusRevisionBegin=4.2.2 | Old description: Timeout in seconds after which the EthIf stops to receive frames in an EthIfMainFunctionRx period. This element is obsolete and will be removed in a future revision.
      integer EthIfMaxTrcvsTotal: 1..255, set at pre-compile, default-value=1  # Limits the total number of transceivers.
      integer EthIfRxIndicationIterations [0..1]: 0..65535, set at pre-compile, default-value=10  # Maximum number of Ethernet frames per Ethernet controller polled from the Ethernet driver within EthIf_MainFunctionRx.
      boolean EthIfStartAutoNegotiation: set at pre-compile  # Enables / Disables StartAutoNegotiation API.
      integer EthIfTrcvLinkStateChgMainReload: 1..255, set at pre-compile, default-value=1  # Specifies the frequency of transceiver link state change checks in each | period of main function EthIf_MainFunctionTx.
      boolean EthIfVersionInfoApi: set at pre-compile  # Enables / Disables version info API
      boolean EthIfVersionInfoApiMacro: set at pre-compile  # Enables / Disables version info API macro implementation.
      boolean EthIfWakeUpSupport: set at pre-compile, default-value=false  # Configures if wakeup is supported or not.
      boolean EthIfGetCtrlIdxList: set at pre-compile, default-value=false  # Enables / Disables GetCtrlIdxList API.
      float EthIfMainFunctionStatePeriod: 0..INF, multiplicity set at pre-compile, set at pre-compile, default-value=0.01  # Specifies the period of main function EthIf_MainFunctionState in seconds. Ethernet Interface does not require this information but the BSW scheduler.
      string EthIfPublicCddHeaderFile [0..*]: scope=ECU, multiplicity set at pre-compile, set at pre-compile, default-value=#include "TcpIp.h", max-length=32, min-length=1  # Defines header files for callback functions which shall be included in case of CDDs. Range of characters is 1.. 32.
    container EthIfConfigSet  # Collecting container for all parameters with post-build configuration classes.
      container EthIfController [1..*]  # This container contains the configuration of EthIfController.
        integer EthIfCtrlIdx: 0..255, scope=ECU, set at pre-compile, symbolic-name-value=true, default-value=0  # This parameter provides a zero-based consecutive index of the Ethernet Communication Controllers. Upper layer BSW modules and the EthIf itself use this index to identify a Ethernet CC.
        integer EthIfCtrlMtu: 64..9000, scope=ECU, post-build-variant-value=true, set at link in variant link-time / post-build in variant post-build / pre-compile in variant pre-compile, default-value=1500  # Specifies the maximum transmission unit (MTU) of the EthIfCtrl in [bytes]. | Note: in case a VLAN tag is used for the EthIfCtrl, the MTU is 4 bytes smaller than the maximum payload size of an Ethernet frame which can be transmitted on the network.
        integer EthIfMaxTxBufsTotal: 1..255, set at pre-compile, default-value=4  # Limits the total number of transmit buffers.
        integer EthIfVlanId [0..1]: 0..4095, scope=ECU, multiplicity set at link in variant link-time / post-build in variant post-build / pre-compile in variant pre-compile, post-build-variant-multiplicity=true, post-build-variant-value=true, set at link in variant link-time / post-build in variant post-build / pre-compile in variant pre-compile, default-value=0  # A virtual-LAN is identified by this attribute according to IEEE 802.1Q.
        reference EthIfPhysControllerRef: scope=ECU, post-build-variant-value=true, set at link in variant link-time / post-build in variant post-build / pre-compile in variant pre-compile, requires-symbolic-name-value=true, destination=EthIfPhysController  # Reference to a physical Ethernet controller, which is handled by the Ethernet Interface.
        reference EthIfEthTrcvRef [0..1]: scope=ECU, multiplicity set at link in variant link-time / post-build in variant post-build / pre-compile in variant pre-compile, post-build-variant-multiplicity=true, post-build-variant-value=true, set at link in variant link-time / post-build in variant post-build / pre-compile in variant pre-compile, requires-symbolic-name-value=true, destination=EthIfTransceiver  # Reference to an Ethernet transceiver, which is handled by the Ethernet Interface.
        choice reference EthIfSwitchRefOrPortGroupRef [0..1]: multiplicity set at link in variant link-time / post-build in variant post-build / pre-compile in variant pre-compile, post-build-variant-multiplicity=true, post-build-variant-value=true, set at link in variant link-time / post-build in variant post-build / pre-compile in variant pre-compile, destination=[EthIfSwitch, EthIfSwitchPortGroup]  # The choice reference allows to configure either the EthIfController references an EthIfSwitch or an EthIfSwitchPortGroup. | Reference to a EthIfSwitchPortGroup. In case port groups are controlled by PNC EthIfSwitchPortGroupRefSemantics shall have the value ETHIF_SWITCH_PORT_GROUP_LINK_INFO. In case port groups are controlled by the EhtIfController EthIfSwitchPortGroupRefSemantics shall have the value ETHIF_SWITCH_PORT_GROUP_CONTROL.
      container EthIfFrameOwnerConfig [0..*]  # Configuration of Ethernet frame owner
        integer EthIfFrameType: 0..65535, post-build-variant-value=true, set at link in variant link-time / post-build in variant post-build / pre-compile in variant pre-compile, default-value=2048  # Selects the Ethernet frame type.
        integer EthIfOwner: 0..255, post-build-variant-value=true, set at link in variant link-time / post-build in variant post-build / pre-compile in variant pre-compile, default-value=0  # Selects the owner of an Ethernet frame type. The owner is a zero based index into the callback function configuration 'EthIfRxIndicationConfig'. I.e. an Ethernet frame of type IPv4 (0x800) at index 0 will call the first callback function configured in 'EthIfRxIndicationConfig'.
      container EthIfPhysController [1..*]  # This container contains the configuration of EthIfPhysController. | The usage of EthIfEthCtrlRef and EthIfWEthCtrlRef is exclusive OR.
        integer EthIfPhysControllerIdx: 0..255, scope=ECU, set at pre-compile, symbolic-name-value=true, default-value=0  # This parameter provides a zero-based consecutive index of the physical Ethernet controllers. Upper layer BSW modules and the Ethernet Interface itself use this index to identify a physical Ethernet controller.
        choice reference EthIfEthCtrlRef [0..1]: scope=ECU, post-build-variant-value=true, set at link in variant link-time / post-build in variant post-build / pre-compile in variant pre-compile, requires-symbolic-name-value=true, destination=EthCtrlConfig  # Reference to a physical Ethernet controller, which is handled by a specific Ethernet controller driver.
      container EthIfRxIndicationConfig [1..*]  # Configuration of receive callback functions.
        function name EthIfRxIndicationFunction [0..1]: post-build-variant-value=true, set at link in variant link-time / post-build in variant post-build / pre-compile in variant pre-compile, default-value=TcpIp_RxIndication  # Specifies receive indication callback function.
      container EthIfSwitch [0..*]  # This container contains the configuration of EthIfSwitches.
        integer EthIfSwitchIdx: 0..255, scope=ECU, set at pre-compile, symbolic-name-value=true, default-value=0  # This parameter provides a zero-based consecutive index of the Ethernet Interface Switches. Upper layer BSW modules and the EthIf itself use this index to identify a Ethernet Switch.
        symbolic name reference EthIfSwitchRef [0..1]: scope=ECU, post-build-variant-value=true, set at link in variant link-time / post-build in variant post-build / pre-compile in variant pre-compile, destination=EthSwtConfig  # Reference to a Ethernet Switch, which is handled by a specific Ethernet Switch driver.
      container EthIfTrcvLinkStateChgConfig [1..*]  # Specifies link state change callback function
        function name EthIfTrcvLinkStateChgFunction [0..1]: post-build-variant-value=true, set at link in variant link-time / post-build in variant post-build / pre-compile in variant pre-compile, default-value=EthIf_ULTrcvLinkStateChg  # Specifies link state change callback function
      container EthIfTxConfirmationConfig [0..*]  # Configuration of transmit indication callback functions.
        function name EthIfTxConfirmationFunction [0..1]: post-build-variant-value=true, set at link in variant link-time / post-build in variant post-build / pre-compile in variant pre-compile, default-value=TcpIp_TxConfirmation  # Specifies transmit indication callback function
      container EthIfTransceiver [0..*]  # This container contains the configuration of EthIfTransceiver. | The usage of EthIfEthTrcvRef and EthIfWEthTrcvRefis exclusive OR.
        integer EthIfTransceiverIdx: 0..255, scope=ECU, set at pre-compile, symbolic-name-value=true, default-value=0  # This parameter provides a zero-based consecutive index of the Ethernet transceivers. Upper layer BSW modules and the Ethernet Interface itself use this index to identify an Ethernet tranceiver.
        choice reference EthIfEthTrcvRef [0..1]: scope=ECU, post-build-variant-value=true, set at link in variant link-time / post-build in variant post-build / pre-compile in variant pre-compile, requires-symbolic-name-value=true, destination=[EthTrcvConfig, EthTrcvConfig]  # Reference to an Ethernet transceiver, which is handled by a specific Ethernet transceiver driver.
    container EthTrcv_DriverApiConfigSet  # user defined
      container EthTrcv_DriverApi [0..255]
        function name EthTrcv_SetTransceiverWakeupModeApi: scope=ECU, multiplicity set at pre-compile, set at pre-compile, default-value=EthTrcv_SetTransceiverWakeupMode  # Multiplicity shall be equal to parameter DcmDspDataConditionCheckReadFnc. Only relevant if * DcmDspDataConditionCheckReadFncUsed is set to 'TRUE' and * DcmDspDataUsePort=="USE_DATA_SYNCH_FNC or * DcmDspDataUsePort==USE_DATA_ASYNCH_FNC" or * DcmDspDataUsePort==USE_DATA_ASYNCH_FNC_ERROR". This parameter is related to the interface Xxx_ReadData.
        function name EthTrcv_GetTransceiverWakeupModeApi: scope=ECU, multiplicity set at pre-compile, set at pre-compile, default-value=EthTrcv_GetTransceiverWakeupMode  # Multiplicity shall be equal to parameter DcmDspDataConditionCheckReadFnc. Only relevant if * DcmDspDataConditionCheckReadFncUsed is set to 'TRUE' and * DcmDspDataUsePort=="USE_DATA_SYNCH_FNC or * DcmDspDataUsePort==USE_DATA_ASYNCH_FNC" or * DcmDspDataUsePort==USE_DATA_ASYNCH_FNC_ERROR". This parameter is related to the interface Xxx_ReadData.
        function name EthTrcv_TransceiverLinkStateRequestApi: scope=ECU, multiplicity set at pre-compile, set at pre-compile, default-value=EthTrcv_TransceiverLinkStateRequest  # Multiplicity shall be equal to parameter DcmDspDataConditionCheckReadFnc. Only relevant if * DcmDspDataConditionCheckReadFncUsed is set to 'TRUE' and * DcmDspDataUsePort=="USE_DATA_SYNCH_FNC or * DcmDspDataUsePort==USE_DATA_ASYNCH_FNC" or * DcmDspDataUsePort==USE_DATA_ASYNCH_FNC_ERROR". This parameter is related to the interface Xxx_ReadData.
        function name EthTrcv_GetTransceiverModeApi: scope=ECU, multiplicity set at pre-compile, set at pre-compile, default-value=EthTrcv_GetTransceiverMode  # Multiplicity shall be equal to parameter DcmDspDataConditionCheckReadFnc. Only relevant if * DcmDspDataConditionCheckReadFncUsed is set to 'TRUE' and * DcmDspDataUsePort=="USE_DATA_SYNCH_FNC or * DcmDspDataUsePort==USE_DATA_ASYNCH_FNC" or * DcmDspDataUsePort==USE_DATA_ASYNCH_FNC_ERROR". This parameter is related to the interface Xxx_ReadData.
        function name EthTrcv_GetLinkStateApi: scope=ECU, multiplicity set at pre-compile, set at pre-compile, default-value=EthTrcv_GetLinkState  # Multiplicity shall be equal to parameter DcmDspDataConditionCheckReadFnc. Only relevant if * DcmDspDataConditionCheckReadFncUsed is set to 'TRUE' and * DcmDspDataUsePort=="USE_DATA_SYNCH_FNC or * DcmDspDataUsePort==USE_DATA_ASYNCH_FNC" or * DcmDspDataUsePort==USE_DATA_ASYNCH_FNC_ERROR". This parameter is related to the interface Xxx_ReadData.
        function name EthTrcv_SetTransceiverModeApi: scope=ECU, multiplicity set at pre-compile, set at pre-compile, default-value=EthTrcv_SetTransceiverMode  # Multiplicity shall be equal to parameter DcmDspDataConditionCheckReadFnc. Only relevant if * DcmDspDataConditionCheckReadFncUsed is set to 'TRUE' and * DcmDspDataUsePort=="USE_DATA_SYNCH_FNC or * DcmDspDataUsePort==USE_DATA_ASYNCH_FNC" or * DcmDspDataUsePort==USE_DATA_ASYNCH_FNC_ERROR". This parameter is related to the interface Xxx_ReadData.
        function name EthTrcv_CheckWakeupApi: scope=ECU, multiplicity set at pre-compile, set at pre-compile, default-value=EthTrcv_CheckWakeup  # Multiplicity shall be equal to parameter DcmDspDataConditionCheckReadFnc. Only relevant if * DcmDspDataConditionCheckReadFncUsed is set to 'TRUE' and * DcmDspDataUsePort=="USE_DATA_SYNCH_FNC or * DcmDspDataUsePort==USE_DATA_ASYNCH_FNC" or * DcmDspDataUsePort==USE_DATA_ASYNCH_FNC_ERROR". This parameter is related to the interface Xxx_ReadData.
        choice reference EthTrcvNameRef: scope=ECU, post-build-variant-value=true, set at link in variant link-time / post-build in variant post-build / pre-compile in variant pre-compile, destination=[EthTrcvGeneral, EthTrcvGeneral]
    container Eth_DriverApiConfigeSet  # user defined
      container Eth_DriverApi [1..255]
        function name Eth_SetControllerModeApi: scope=ECU, multiplicity set at pre-compile, set at pre-compile, default-value=Eth_SetControllerMode  # Multiplicity shall be equal to parameter DcmDspDataConditionCheckReadFnc. Only relevant if * DcmDspDataConditionCheckReadFncUsed is set to 'TRUE' and * DcmDspDataUsePort=="USE_DATA_SYNCH_FNC or * DcmDspDataUsePort==USE_DATA_ASYNCH_FNC" or * DcmDspDataUsePort==USE_DATA_ASYNCH_FNC_ERROR". This parameter is related to the interface Xxx_ReadData.
        function name Eth_GetControllerModeApi: scope=ECU, multiplicity set at pre-compile, set at pre-compile, default-value=Eth_GetControllerMode  # Multiplicity shall be equal to parameter DcmDspDataConditionCheckReadFnc. Only relevant if * DcmDspDataConditionCheckReadFncUsed is set to 'TRUE' and * DcmDspDataUsePort=="USE_DATA_SYNCH_FNC or * DcmDspDataUsePort==USE_DATA_ASYNCH_FNC" or * DcmDspDataUsePort==USE_DATA_ASYNCH_FNC_ERROR". This parameter is related to the interface Xxx_ReadData.
        function name Eth_ProvideTxBufferApi: scope=ECU, multiplicity set at pre-compile, set at pre-compile, default-value=Eth_ProvideTxBuffer  # Multiplicity shall be equal to parameter DcmDspDataConditionCheckReadFnc. Only relevant if * DcmDspDataConditionCheckReadFncUsed is set to 'TRUE' and * DcmDspDataUsePort=="USE_DATA_SYNCH_FNC or * DcmDspDataUsePort==USE_DATA_ASYNCH_FNC" or * DcmDspDataUsePort==USE_DATA_ASYNCH_FNC_ERROR". This parameter is related to the interface Xxx_ReadData.
        function name Eth_TransmitApi: scope=ECU, multiplicity set at pre-compile, set at pre-compile, default-value=Eth_Transmit  # Multiplicity shall be equal to parameter DcmDspDataConditionCheckReadFnc. Only relevant if * DcmDspDataConditionCheckReadFncUsed is set to 'TRUE' and * DcmDspDataUsePort=="USE_DATA_SYNCH_FNC or * DcmDspDataUsePort==USE_DATA_ASYNCH_FNC" or * DcmDspDataUsePort==USE_DATA_ASYNCH_FNC_ERROR". This parameter is related to the interface Xxx_ReadData.
        function name Eth_SetPhysAddrApi: scope=ECU, multiplicity set at pre-compile, set at pre-compile, default-value=Eth_SetPhysAddr  # Multiplicity shall be equal to parameter DcmDspDataConditionCheckReadFnc. Only relevant if * DcmDspDataConditionCheckReadFncUsed is set to 'TRUE' and * DcmDspDataUsePort=="USE_DATA_SYNCH_FNC or * DcmDspDataUsePort==USE_DATA_ASYNCH_FNC" or * DcmDspDataUsePort==USE_DATA_ASYNCH_FNC_ERROR". This parameter is related to the interface Xxx_ReadData.
        function name Eth_GetPhysAddrApi: scope=ECU, multiplicity set at pre-compile, set at pre-compile, default-value=Eth_GetPhysAddr  # Multiplicity shall be equal to parameter DcmDspDataConditionCheckReadFnc. Only relevant if * DcmDspDataConditionCheckReadFncUsed is set to 'TRUE' and * DcmDspDataUsePort=="USE_DATA_SYNCH_FNC or * DcmDspDataUsePort==USE_DATA_ASYNCH_FNC" or * DcmDspDataUsePort==USE_DATA_ASYNCH_FNC_ERROR". This parameter is related to the interface Xxx_ReadData.
        function name Eth_UpdatePhysAddrFilterApi: scope=ECU, multiplicity set at pre-compile, set at pre-compile, default-value=Eth_UpdatePhysAddrFilter  # Multiplicity shall be equal to parameter DcmDspDataConditionCheckReadFnc. Only relevant if * DcmDspDataConditionCheckReadFncUsed is set to 'TRUE' and * DcmDspDataUsePort=="USE_DATA_SYNCH_FNC or * DcmDspDataUsePort==USE_DATA_ASYNCH_FNC" or * DcmDspDataUsePort==USE_DATA_ASYNCH_FNC_ERROR". This parameter is related to the interface Xxx_ReadData.
        function name Eth_GetCurrentTimeApi: scope=ECU, multiplicity set at pre-compile, set at pre-compile, default-value=Eth_GetCurrentTime  # Multiplicity shall be equal to parameter DcmDspDataConditionCheckReadFnc. Only relevant if * DcmDspDataConditionCheckReadFncUsed is set to 'TRUE' and * DcmDspDataUsePort=="USE_DATA_SYNCH_FNC or * DcmDspDataUsePort==USE_DATA_ASYNCH_FNC" or * DcmDspDataUsePort==USE_DATA_ASYNCH_FNC_ERROR". This parameter is related to the interface Xxx_ReadData.
        function name Eth_EnableEgressTimeStampApi: scope=ECU, multiplicity set at pre-compile, set at pre-compile, default-value=Eth_EnableEgressTimeStamp  # Multiplicity shall be equal to parameter DcmDspDataConditionCheckReadFnc. Only relevant if * DcmDspDataConditionCheckReadFncUsed is set to 'TRUE' and * DcmDspDataUsePort=="USE_DATA_SYNCH_FNC or * DcmDspDataUsePort==USE_DATA_ASYNCH_FNC" or * DcmDspDataUsePort==USE_DATA_ASYNCH_FNC_ERROR". This parameter is related to the interface Xxx_ReadData.
        function name Eth_GetEgressTimeStampApi: scope=ECU, multiplicity set at pre-compile, set at pre-compile, default-value=Eth_GetEgressTimeStamp  # Multiplicity shall be equal to parameter DcmDspDataConditionCheckReadFnc. Only relevant if * DcmDspDataConditionCheckReadFncUsed is set to 'TRUE' and * DcmDspDataUsePort=="USE_DATA_SYNCH_FNC or * DcmDspDataUsePort==USE_DATA_ASYNCH_FNC" or * DcmDspDataUsePort==USE_DATA_ASYNCH_FNC_ERROR". This parameter is related to the interface Xxx_ReadData.
        function name Eth_GetIngressTimeStampApi: scope=ECU, multiplicity set at pre-compile, set at pre-compile, default-value=Eth_GetIngressTimeStamp  # Multiplicity shall be equal to parameter DcmDspDataConditionCheckReadFnc. Only relevant if * DcmDspDataConditionCheckReadFncUsed is set to 'TRUE' and * DcmDspDataUsePort=="USE_DATA_SYNCH_FNC or * DcmDspDataUsePort==USE_DATA_ASYNCH_FNC" or * DcmDspDataUsePort==USE_DATA_ASYNCH_FNC_ERROR". This parameter is related to the interface Xxx_ReadData.
        function name Eth_ReceiveApi: scope=ECU, multiplicity set at pre-compile, set at pre-compile, default-value=Eth_Receive  # Multiplicity shall be equal to parameter DcmDspDataConditionCheckReadFnc. Only relevant if * DcmDspDataConditionCheckReadFncUsed is set to 'TRUE' and * DcmDspDataUsePort=="USE_DATA_SYNCH_FNC or * DcmDspDataUsePort==USE_DATA_ASYNCH_FNC" or * DcmDspDataUsePort==USE_DATA_ASYNCH_FNC_ERROR". This parameter is related to the interface Xxx_ReadData.
        function name Eth_TxConfirmationApi: scope=ECU, multiplicity set at pre-compile, set at pre-compile, default-value=Eth_TxConfirmation  # Multiplicity shall be equal to parameter DcmDspDataConditionCheckReadFnc. Only relevant if * DcmDspDataConditionCheckReadFncUsed is set to 'TRUE' and * DcmDspDataUsePort=="USE_DATA_SYNCH_FNC or * DcmDspDataUsePort==USE_DATA_ASYNCH_FNC" or * DcmDspDataUsePort==USE_DATA_ASYNCH_FNC_ERROR". This parameter is related to the interface Xxx_ReadData.
        choice reference EthNameRef: scope=ECU, post-build-variant-value=true, set at link in variant link-time / post-build in variant post-build / pre-compile in variant pre-compile, destination=EthGeneral
