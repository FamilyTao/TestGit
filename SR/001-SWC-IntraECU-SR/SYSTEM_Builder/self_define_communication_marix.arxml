AUTOSAR XML (schema 4-2-2)
package /SystemInfo/CanClusters
  can cluster CanCluster_0: protocol-name=CAN
    can physical channel CanChannel_0: comm-connectors=[CanChannel_0_ECUB_conn, CanChannel_0_ECUA_conn]
      frame E2E_Msg_Profile1: id 0x302, from ECUA, to ECUB, frame-length=8, can-addressing-mode=STANDARD
        pdu E2E_Msg_Profile1: length=8, transmission-mode-conditions=[E2E_Signal_DATA_E2E_Msg_Profile1, E2E_Signal_Counter_E2E_Msg_Profile1, E2E_Signal_CRC_E2E_Msg_Profile1], transmission-mode-true-timing=cyclic-timing=time-period=0.1
          signal E2E_Signal_DATA_E2E_Msg_Profile1: start 24, 16 bit, big-endian, data-transformations=dataTransformation_StructE2E, base-type=uint16, end-to-end-transformation-i-signal-props{transformer=transformationTechnologies_E2EXf, data-ids=4370, data-length=16}, update-indication-bit-position=-1, to ECUB
          signal E2E_Signal_Counter_E2E_Msg_Profile1: start 12, 4 bit, big-endian, base-type=uint8, update-indication-bit-position=-1, to ECUB
          signal E2E_Signal_CRC_E2E_Msg_Profile1: start 0, 8 bit, big-endian, base-type=uint8, update-indication-bit-position=-1, to ECUB
          mapping E2E_Demo_Group1_E2E_Msg_Profile1: i-signal-group=E2E_Demo_Group1_E2E_Msg_Profile1, update-indication-bit-position=-1
package /SystemInfo/ISignals
  i signal group E2E_Demo_Group1_E2E_Msg_Profile1: com-based-signal-group-transformations=dataTransformation_StructE2E, i-signal=[E2E_Signal_Counter_E2E_Msg_Profile1, E2E_Signal_CRC_E2E_Msg_Profile1, E2E_Signal_DATA_E2E_Msg_Profile1], system-signal-group=E2E_Demo_Group1_E2E_Msg_Profile1
package /SystemInfo/UnitPackage
  unit NoUnit
package /SystemInfo/EcuInstances
  ecu instance ECUB: com-configuration-gw-time-base=0.005, com-configuration-rx-time-base=0.005, com-configuration-tx-time-base=0.005, sleep-mode-supported=false, wake-up-over-bus-supported=false
    can communication controller CanChannel_0_ECUB: wake-up-by-controller-supported=false, can-controller-attributes=can-controller-configuration={sync-jump-width=0, time-seg-1=20, time-seg-2=10}
    can communication connector CanChannel_0_ECUB_conn: comm-controller=CanChannel_0_ECUB
  ecu instance ECUA: com-configuration-gw-time-base=0.005, com-configuration-rx-time-base=0.005, com-configuration-tx-time-base=0.005, sleep-mode-supported=false, wake-up-over-bus-supported=false
    can communication controller CanChannel_0_ECUA: wake-up-by-controller-supported=false, can-controller-attributes=can-controller-configuration={sync-jump-width=0, time-seg-1=20, time-seg-2=10}
    can communication connector CanChannel_0_ECUA_conn: comm-controller=CanChannel_0_ECUA
