AUTOSAR XML (schema 4-2-2)
standard types defined: sint8, uint8, sint16, uint16, sint32, uint32, sint64, uint64, float, double, boolean
package /AUTOSAR/DataTypes
  4 x impl type:
    PrimitiveUint16: category=VALUE, base-type=uint16
    ArrayUint8: category=ARRAY
      element subElement: category=VALUE, array-size=10, base-type=uint8
    StructA: category=STRUCTURE
      4 x element, all with category=VALUE:
        Crc_Uint8: base-type=uint8
        Data_Uint16: base-type=uint16
        Counter_Uint8: base-type=uint8
        Data_Uint8: base-type=uint8
    StructArray: category=STRUCTURE
      element Arraydata: implementation-data-type=ArrayUint8
      element dataUint8: category=VALUE, base-type=uint8
package /AUTOSAR/SwBaseTypes
  4 x base type, all with category=FIXED_LENGTH:
    sint4: base-type-size=4, base-type-encoding=VOID, native-declaration=sint4
    uint4: base-type-size=4, base-type-encoding=NONE, native-declaration=uint4
    char8: base-type-size=8, base-type-encoding=NONE, native-declaration=char8
    char16: base-type-size=19, base-type-encoding=NONE, native-declaration=char16
