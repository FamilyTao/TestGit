AUTOSAR XML (schema 4-2-2)
package /AUTOSAR/Interfaces
  sender receiver interface SRIF_Explicit: invalidation-policy{data-element=dataElementPrimitive, handle-invalid=REPLACE}
    data dataElementPrimitive: invalid-value=0, type=PrimitiveUint16, init-value=0
    data dataElementArray: type=ArrayUint8
    data dataElementStruct: type=StructA
  sender receiver interface SRIF_primitive
    data dataprimitive: type=PrimitiveUint16
package /AUTOSAR/PortInterfaceMappingSets
  port interface mapping set PortMappingSet_Primitive
    port-interface-mappings:
      variable and parameter interface mapping VAP_Primtive: data-prototype-mapping{first-data-prototype=dataElementPrimitive, second-data-prototype=dataprimitive}
