AUTOSAR XML (schema 4-2-2)
package /AUTOSAR
  module definition FiM [0..1]: post-build-variant-support=true, variants post-build/pre-compile  # Configuration of the FiM (Function Inhibition Manager) module.
    container FiMGeneral
      boolean FiMAvailabilitySupport: set at pre-compile, default-value=false  # This configuration parameter specifies, if the Fim shall support the service to set the Availabity of a Funtionality. | true: Service is supported. false: Service is not supported
      boolean FiMDataFixed: set at pre-compile  # Enable or disable calibration of inhibit relations The scope of the parameter is to meet the requirement (FIM008) to have the option to calibrate inhibit data on the one hand side and also to provide the option to protect inhibit data for consistency reasons. Tags: atp.Status=obsolete
      boolean FiMDevErrorDetect: set at pre-compile, default-value=true  # Switches the Default Error Tracer (Det) detection and notification ON or OFF. | * true: enabled (ON). * false: disabled (OFF).
      boolean FiMEventUpdateTriggeredByDem: set at pre-compile  # This configuration parameter specifies the way FIM obtains status of EventIds. | TRUE: the DEM informs FIM about changes of event status, FALSE: the FIM polls event status from the DEM module either cyclically or on demand.
      integer FiMMaxEventsPerFidInhibitionConfiguration [0..1]: 1..65535, set at pre-compile, default-value=1  # This configuration parameter specifies the total maximum number of inhibiting events in a FiMInhibitionConfiguration. | Its applicable for post build configuration versions only and may be used to allocate the maximum size of memory to store and execute the configuration.
      integer FiMMaxFiMInhibitionConfigurations [0..1]: 1..65535, set at pre-compile, default-value=1  # This configuration parameter specifies the total maximum number of FiMInhibitionConfigurations. | Its applicable for post build configuration versions only and may be used to allocate the maximum size of memory to store and execute the configuration.
      integer FiMMaxInputEventsPerSummaryEvents [0..1]: 1..65535, set at pre-compile, default-value=1  # This configuration parameter specifies the total maximum number of input events per summary event. | Its applicable for post build configuration versions only and may be used to allocate the maximum size of memory to store and execute the configuration.
      integer FiMMaxSumEventsPerFidInhibitionConfiguration [0..1]: 1..65535, set at pre-compile, default-value=1  # This configuration parameter specifies the total maximum number of inhibiting summary events in a FiMInhibitionConfiguration. | Its applicable for post build configuration versions only and may be used to allocate the maximum size of memory to store and execute the configuration.
      integer FiMMaxSummaryEvents: 0..65535, set at pre-compile, default-value=0  # This configuration parameter specifies the maximum number of summarized events that can be configured.
      float FiMTaskTime: 0..0.1, scope=ECU, origin=AUTOSAR_ECUC V1.0.0, set at pre-compile, default-value=0  # Allow to configure the time for the periodic cyclic task. Please note: This configuration value shall be equal to the value in the Basic Software Scheduler configuration of the RTE module. Tags: atp.Status=obsolete | The AUTOSAR configuration standard is to use SI units, so this parameter is defined as float value in seconds. DEM configuration tools must convert this float value to the appropriate value format for the use in the software implementation of DEM. min: A negative value is not allowed. max: FID must be set after a maximal time of 100ms after DEM status is set. upperMultiplicity: Exactly one TaskTime must be specified per configuration. lowerMultiplicity: Exactly one TaskTime must be specified per configuration. This element is obsolete and will be removed in a future revision.
      boolean FiMVersionInfoApi: set at pre-compile  # This configuration parameter is used to switch on or to switch off the API to get the version information.
    container FiMConfigSet  # This container contains the configuration parameters and sub containers of the FiM module supporting multiple configuration sets.
      container FiMFID [1..*]  # This container includes symbolic names of all FIDs.
        integer FiMFunctionId: 0..65535, scope=ECU, set at pre-compile, symbolic-name-value=true, default-value=0  # Unique identifier of a FimFunctionId. This parameter should not be changeable by user, because the Id should be generated by Fim itself to prevent gaps and multiple use of an Id. | Note: The implementer can add the attribute 'withAuto' to the parameter definition which indicates that the value can be calculated by the generator automatically. When 'withAuto' is set to 'true' for this parameter definition the 'isAutoValue' can be set to 'true'. If 'isAutoValue' is set to 'true' the actual value will not be considered during ECU Configuration but will be (re-)calculated by the code generator and stored in the value attribute afterwards.
      container FiMInhibitionConfiguration [1..*]: multiplicity set at post-build in variant post-build / pre-compile in variant pre-compile, post-build-variant-multiplicity=true  # This container includes all configuration parameters concerning the relationship between event and FID.
        enumeration FiMInhInhibitionMask: {FIM_LAST_FAILED, FIM_NOT_TESTED, FIM_TESTED, FIM_TESTED_AND_FAILED}, post-build-variant-value=true, set at post-build in variant post-build / pre-compile in variant pre-compile, default-value=FIM_LAST_FAILED  # The configuration parameter is used to specify the inhibition mask for an event - FID relation.
        reference FiMInhComponentRef [0..*]: multiplicity set at post-build in variant post-build / pre-compile in variant pre-compile, post-build-variant-multiplicity=true, post-build-variant-value=true, set at post-build in variant post-build / pre-compile in variant pre-compile, destination=DemComponent  # Reference to a DemComponent which is necessary for function permission. | At least one FiMInhSumRef or FiMInhEventRef or FiMInhComponentRef needs to be configured.
        reference FiMInhFunctionIdRef: post-build-variant-value=true, set at post-build in variant post-build / pre-compile in variant pre-compile, destination=FiMFID
        reference FiMInhSumRef [0..*]: multiplicity set at post-build in variant post-build / pre-compile in variant pre-compile, post-build-variant-multiplicity=true, post-build-variant-value=true, set at post-build in variant post-build / pre-compile in variant pre-compile, destination=FiMSummaryEvent  # Selection of a summarized Event. | At least one FiMInhSumRef or FiMInhEventRef or FiMInhComponentRef needs to be configured.
        symbolic name reference FiMInhEventRef [0..*]: multiplicity set at post-build in variant post-build / pre-compile in variant pre-compile, post-build-variant-multiplicity=true, post-build-variant-value=true, set at post-build in variant post-build / pre-compile in variant pre-compile, destination=DemEventParameter  # Selection of an single DEM Event. | At least one FiMInhSumRef or FiMInhEventRef or FiMInhComponentRef needs to be configured.
      container FiMSummaryEvent [0..*]: multiplicity set at post-build in variant post-build / pre-compile in variant pre-compile, post-build-variant-multiplicity=true  # The summarized EventId definition record consists of a summarized event ID and specific Dem Events. | This record means that a particular FID that has to be disabled in case of summarized event (defined above) is to be disabled in any of the specific events. A possible solution could be assigning events as summarized events along with a list of specific events. During the configuration process the summarized event substitutes the referenced single events. However, it is not outlined how this requirement is solved - whether by configuration process or by implementation within the FiM. The FiM configuration tool could also build up a suitable data structure for summarized events and deal with it in the FiM implementation.
        symbolic name reference FiMInputEventRef [1..*]: multiplicity set at post-build in variant post-build / pre-compile in variant pre-compile, post-build-variant-multiplicity=true, post-build-variant-value=true, set at post-build in variant post-build / pre-compile in variant pre-compile, destination=DemEventParameter  # Reference to DemEventParameters combined to this summarized event.
