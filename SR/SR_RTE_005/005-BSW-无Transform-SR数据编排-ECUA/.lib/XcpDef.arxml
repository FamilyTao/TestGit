AUTOSAR XML (schema 4-2-2)
package /AUTOSAR
  module definition Xcp [0..1]: post-build-variant-support=true, variants post-build/pre-compile  # Configuration of the XCP module
    container XcpGeneral  # This container contains the general configuration parameters of the XCP.
      boolean XcpOnCddEnabled: set at pre-compile  # Enabling of XCPonCdd functionality(Not Support)
      boolean XcpOnFlexRayEnabled: set at pre-compile  # Enabling of XCPonFlexRay functionality(Not Support)
      enumeration XcpSupportType: {XcpOnEthernetEnabled, XcpOnCanEnabled}, scope=ECU, set at pre-compile, default-value=XcpOnCanEnabled  # XcpOnCanEnabled:Enabling of XCPonCAN functionality; XcpOnEthernetEnabled:Enabling of XCPonEthernet functionality.
      boolean XcpDevErrorDetect: set at pre-compile, default-value=true  # Switches the Default Error Tracer (Det) detection and notification ON or OFF. | * true: enabled (ON). * false: disabled (OFF).
      boolean XcpVersionInfoApi: set at pre-compile  # Enables/disables the existence of the XCP_GetVersionInfo() API service. | TRUE: XCP_GetVersionInfo() API service exists FALSE: XCP_GetVersionInfo() API service does not exist
      boolean XcpSuppressTxSupport: set at pre-compile  # Switches the support of suppressing transmission of PDUs per communication channel on or off. | TRUE: Suppressing of TxPDUs supported FALSE: Suppressing of TxPDUs not supported
      enumeration XcpDaqConfigType: {DAQ_DYNAMIC, DAQ_STATIC}, scope=ECU, set at pre-compile, default-value=DAQ_DYNAMIC  # Sets the DAQ_CONFIG_TYPE bit within the DAQ_PROPERTIES parameter to "static" or to "dynamic". If DAQ_STATIC is selected, the DAQ_CONFIG_TYPE bit is set to "0". If DAQ_DYNAMIC is selected, the DAQ_CONFIG_TYPE bit is set to "1".
      enumeration XcpIdentificationFieldType: {ABSOLUTE, RELATIVE_BYTE, RELATIVE_WORD, RELATIVE_WORD_ALIGNED}, set at pre-compile, default-value=ABSOLUTE  # Type of Identification Field the slave will use when transferring DAQ Packets to the master. The master has to use the same Type of Identification Field when transferring STIM Packets to the slave.
      boolean XcpPrescalerSupported: set at pre-compile  # This parameter enables and disables the support for Prescaler support. True is Enabled, False is disabled
      integer DynamicDAQBufferSize: 0..65535, scope=ECU, set at pre-compile, default-value=0  # Dynamic DAQ Buffer Size.
      integer XcpDaqCount: 0..65535, scope=ECU, set at pre-compile, default-value=0  # Indicates the number of DAQ lists for dynamic configuration.
      integer XcpOdtCount: 1..252, scope=ECU, set at pre-compile, default-value=1  # This parameter indicates the amount of ODTs of a DAQ list using dynamic DAQ list configuration.
      integer XcpMinDaq: 0..255, scope=ECU, set at pre-compile, default-value=0  # Indicates the number of predefined, read only DAQ lists on the XCP slave.(Not support predefine DAQ)
      integer XcpOdtEntrySizeStim: 0..255, scope=ECU, set at pre-compile, default-value=8  # Indicates the size of an element described by an ODT entry to the DaqListType for a stim.
      integer XcpOdtEntrySizeDaq: 0..255, scope=ECU, set at pre-compile, default-value=8  # Indicates the size of an element described by an ODT entry to the DaqListType for a DAQ.
      enumeration Tool: {CanApe, INCA}, scope=ECU, set at pre-compile, default-value=CanApe  # Sets the DAQ_CONFIG_TYPE bit within the DAQ_PROPERTIES parameter to "static" or to "dynamic". If DAQ_STATIC is selected, the DAQ_CONFIG_TYPE bit is set to "0". If DAQ_DYNAMIC is selected, the DAQ_CONFIG_TYPE bit is set to "1".
      enumeration Byte_Order: {MSB_FIRST, MSB_LAST}, scope=ECU, set at pre-compile, default-value=MSB_FIRST  # Sets the DAQ_CONFIG_TYPE bit within the DAQ_PROPERTIES parameter to "static" or to "dynamic". If DAQ_STATIC is selected, the DAQ_CONFIG_TYPE bit is set to "0". If DAQ_DYNAMIC is selected, the DAQ_CONFIG_TYPE bit is set to "1".
      float XcpMainFunctionPeriod: 0..Inf, set at pre-compile, default-value=0  # The XCP does not require this information but the BSW scheduler, which invokes the main function, needs it in order to plan its tasks.
      integer XcpMaxCto: 8..255, set at pre-compile, default-value=8  # MAX_CTO shows the maximum length of a CTO packet in bytes.
      integer XcpMaxDto: 8..65535, set at pre-compile, default-value=8  # MAX_DTO shows the maximum length of a DTO packet in bytes.
      integer XcpMaxEventChannel: 1..65535, scope=ECU, set at pre-compile, default-value=1
      integer XcpTimestampTicks: 0..65535, set at pre-compile, default-value=0  # This parameter defines the timestamp that will increment based TIMESTAMP_TICKS per unit and wrap around if an overflow occurs.
      enumeration XcpTimestampType: {FOUR_BYTE, NO_TIME_STAMP, ONE_BYTE, TWO_BYTE}, set at pre-compile, default-value=NO_TIME_STAMP, default-value=FOUR_BYTE  # This parameter indicates the number of bytes used for the timestamp field. In case No_TIME_STAMP is selected the timestamp field is not available.
      enumeration XcpTimestampUnit: {TIMESTAMP_UNIT_100MS, TIMESTAMP_UNIT_100NS, TIMESTAMP_UNIT_100PS, TIMESTAMP_UNIT_100US, TIMESTAMP_UNIT_10MS, TIMESTAMP_UNIT_10NS, TIMESTAMP_UNIT_10PS, TIMESTAMP_UNIT_10US, TIMESTAMP_UNIT_1MS, TIMESTAMP_UNIT_1NS, TIMESTAMP_UNIT_1PS, TIMESTAMP_UNIT_1S, TIMESTAMP_UNIT_1US}, set at pre-compile, default-value=TIMESTAMP_UNIT_100MS  # This parameter indicates the resolution of the data acquisition clock of the slave when transferring data to master.
      enumeration XcpDaqOverloadIndication: {XCP_DAQ_OVL_NO_INDIC, XCP_DAQ_OVL_PID, XCP_DAQ_OVL_EV}, set at pre-compile, default-value=XCP_DAQ_OVL_NO_INDIC
      boolean Resume_Mode: set at pre-compile  # Resume Mode must be selected with (SET_REQUEST = ON)
      reference XcpNvRamBlockIdRef [0..1]: multiplicity set at post-build in variant post-build / pre-compile in variant pre-compile, post-build-variant-multiplicity=true, post-build-variant-value=true, set at post-build in variant post-build / pre-compile in variant pre-compile, destination=NvMBlockDescriptor  # This reference contains the link to a non-volatile memory block to be used in the feature "RESUME MODE" so this information has to be stored non volatile to be available directly after start-up of the ECU.
    container XcpCommand  # user defined
      boolean Max_Dlc_Required: set at pre-compile
      boolean Slave_Block_Mode: set at pre-compile, default-value=true
      boolean Master_Block_Mode: set at pre-compile, default-value=true
      boolean Interleaved_Mode: set at pre-compile, default-value=false
      integer Queue_Size: 0..255, set at pre-compile, default-value=1
      integer Queue_Size_PGM: 0..255, set at pre-compile, default-value=1
      integer Max_BS: 0..65535, set at pre-compile, default-value=8
      integer Min_ST: 0..65535, set at pre-compile, default-value=10
      integer Max_BS_PGM: 0..65535, set at pre-compile, default-value=22
      integer Min_ST_PGM: 0..65535, set at pre-compile, default-value=10
      boolean GET_COMM_MODE_INFO: set at pre-compile
      boolean GET_ID: set at pre-compile
      boolean SET_REQUEST: set at pre-compile
      boolean SET_MTA: set at pre-compile, default-value=true
      boolean UPLOAD: set at pre-compile, default-value=true
      boolean SHORT_UPLOAD: set at pre-compile, default-value=true
      boolean BUILD_CHECKSUM: set at pre-compile
      boolean TRANSPORT_LAYER_CMD: set at pre-compile
      boolean GET_SLAVE_ID: set at pre-compile
      boolean Seed_Unlock: set at pre-compile, default-value=true
      boolean CAL_ENABLE: set at pre-compile
      boolean DOWNLOAD_NEXT: set at pre-compile
      boolean DOWNLOAD_MAX: set at pre-compile
      boolean SHORT_DOWNLOAD: set at pre-compile
      boolean MODIFY_BITS: set at pre-compile
      boolean Page_Switching: set at pre-compile
      boolean DAQ_ENABLE: set at pre-compile, default-value=true
      boolean READ_DAQ: set at pre-compile
      boolean GET_DAQ_CLOCK: set at pre-compile
      boolean GET_DAQ_PROCESSOR_INFO: set at pre-compile
      boolean GET_DAQ_RESOLUTION_INFO: set at pre-compile
      boolean GET_DAQ_LIST_MODE: set at pre-compile
      boolean GET_DAQ_EVENT_INFO: set at pre-compile
      boolean GET_DAQ_LIST_INFO: set at pre-compile
      boolean PGM_ENABLE: set at pre-compile
      boolean GET_SECTOR_INFO: set at pre-compile
      boolean PROGRAM_PREPARE: set at pre-compile
      boolean PROGRAM_FORMAT: set at pre-compile
      boolean PROGRAM_NEXT: set at pre-compile
      boolean PROGRAM_MAX: set at pre-compile
      boolean PROGRAM_VERIFY: set at pre-compile
      boolean XcpEditFlsMsg: set at pre-compile
      string FlashHeader: scope=ECU, multiplicity set at pre-compile, set at pre-compile, default-value=Fls.h  # Multiplicity shall be equal to parameter DcmDspDataConditionCheckReadFnc. Only relevant if * DcmDspDataConditionCheckReadFncUsed is set to 'TRUE' and * DcmDspDataUsePort=="USE_DATA_SYNCH_FNC or * DcmDspDataUsePort==USE_DATA_ASYNCH_FNC" or * DcmDspDataUsePort==USE_DATA_ASYNCH_FNC_ERROR". This parameter is related to the interface Xxx_ReadData.
      function name Fls_WriteApi: scope=ECU, multiplicity set at pre-compile, set at pre-compile, default-value=Fls_Write  # Multiplicity shall be equal to parameter DcmDspDataConditionCheckReadFnc. Only relevant if * DcmDspDataConditionCheckReadFncUsed is set to 'TRUE' and * DcmDspDataUsePort=="USE_DATA_SYNCH_FNC or * DcmDspDataUsePort==USE_DATA_ASYNCH_FNC" or * DcmDspDataUsePort==USE_DATA_ASYNCH_FNC_ERROR". This parameter is related to the interface Xxx_ReadData.
      function name Fls_EraseApi: scope=ECU, multiplicity set at pre-compile, set at pre-compile, default-value=Fls_Erase  # Multiplicity shall be equal to parameter DcmDspDataConditionCheckReadFnc. Only relevant if * DcmDspDataConditionCheckReadFncUsed is set to 'TRUE' and * DcmDspDataUsePort=="USE_DATA_SYNCH_FNC or * DcmDspDataUsePort==USE_DATA_ASYNCH_FNC" or * DcmDspDataUsePort==USE_DATA_ASYNCH_FNC_ERROR". This parameter is related to the interface Xxx_ReadData.
      function name Fls_GetStatusApi: scope=ECU, multiplicity set at pre-compile, set at pre-compile, default-value=Fls_GetJobResult  # Multiplicity shall be equal to parameter DcmDspDataConditionCheckReadFnc. Only relevant if * DcmDspDataConditionCheckReadFncUsed is set to 'TRUE' and * DcmDspDataUsePort=="USE_DATA_SYNCH_FNC or * DcmDspDataUsePort==USE_DATA_ASYNCH_FNC" or * DcmDspDataUsePort==USE_DATA_ASYNCH_FNC_ERROR". This parameter is related to the interface Xxx_ReadData.
      integer XcpSectorPageSize: 0..4294967295, symbolic-name-value=true, default-value=1024
      integer FlsBaseAddr: 0..4294967295, symbolic-name-value=true, default-value=2936012800  # Depends on the hardware, such as 0xaf000000 for Tricore-Tc39x.
    container XcpConfig  # This container contains the configuration parameters and sub containers of the AUTOSAR Xcp module.
      container XcpDaqList [1..*]  # This container contains the configuration of the DAQs.
        integer XcpDaqListNumber: 0..65534, scope=ECU, set at pre-compile, symbolic-name-value=true, default-value=0  # Index number of the DAQ list
        enumeration XcpDaqListType: {DAQ, DAQ_STIM, STIM}, scope=ECU, set at pre-compile, default-value=DAQ  # This indicates whether this DAQ list represents a DAQ or a STIM.
        integer XcpMaxOdt: 0..252, scope=ECU, set at pre-compile, default-value=0  # MAX_ODT indicates the maximum amount of ODTs in this DAQ list | (STATIC configuration)
        integer XcpMaxOdtEntries: 0..255, scope=ECU, set at pre-compile, default-value=0  # This parameter indicates the maximum amount of entries in an ODT of this DAQ list (STATIC configuration).
        container XcpDto [0..1]  # This container collects data transfer object specific parameters for the DAQ list.
          integer XcpDtoPid: 0..251, scope=ECU, set at pre-compile, symbolic-name-value=true, default-value=0  # Packet identifier (PID) of the DTO that identifies the ODT the content of the DTO.
          choice reference XcpDto2PduMapping: scope=ECU, set at pre-compile, destination=[XcpRxPdu, XcpTxPdu]  # This reference specifies the mapping of the DTO to the PDUs from the lower-layer interfaces (CanIf, FrIf, SoAd and Cdd). | A reference to a XcpRxPdu is only feasible if the the DaqListType is DAQ_STIM. A reference to a XcpTxPdu is only feasible if the DaqListType is DAQ.
        container XcpOdt [0..*]  # This container contains ODT-specific parameter for the DAQ list.
          integer XcpOdtEntryMaxSize: 0..254, scope=ECU, set at pre-compile, default-value=0  # This parameter indicates the upper limit for the size of the element described by an ODT entry. Depending on the DaqListType this ODT belongs to it describes the limit for a DAQ (MAX_ODT_ENTRY_SIZE_DAQ) or a STIM (MAX_ODT_ENTRY_SIZE_STIM).
          integer XcpOdtNumber [0..1]: 0..251, scope=ECU, multiplicity set at pre-compile, set at pre-compile, symbolic-name-value=true, default-value=0  # Index number of this ODT within the DAQ list.
          reference XcpOdt2DtoMapping [0..1]: scope=ECU, set at pre-compile, destination=XcpDto  # This reference maps the ODT to the according DTO in which it will be transmitted.
          container XcpOdtEntry [1..*]  # This container collects all configuration parameters that comprise an ODT entry.
            linker symbol XcpOdtEntryAddress: scope=ECU, multiplicity set at pre-compile, set at pre-compile, default-value=0  # Memory address that the ODT entry is referencing to.
            integer XcpOdtEntryBitOffset: 0..31, scope=ECU, multiplicity set at pre-compile, set at pre-compile, default-value=0  # Represent the bit offset in case of the element represents status bit.
            integer XcpOdtEntryLength: 0..255, scope=ECU, multiplicity set at pre-compile, set at pre-compile, default-value=0  # Length of the referenced memory area that is referenced by the ODT entry.
            integer XcpOdtEntryNumber: 0..254, scope=ECU, multiplicity set at pre-compile, set at pre-compile, default-value=0  # Index number of the ODT entry
      container XcpEventChannel [1..*]  # This container contains the configuration of event channels on the XCP slave.
        enumeration XcpEventChannelConsistency: {DAQ, EVENT, ODT}, set at pre-compile, default-value=ODT, default-value=DAQ  # Type of consistency used by event channel
        integer XcpEventChannelMaxDaqList: 0..255, scope=ECU, set at pre-compile, default-value=0  # Maximum amount of DAQ lists that are handled by this event channel.
        integer XcpEventChannelNumber: 0..65534, scope=ECU, set at pre-compile, symbolic-name-value=true, default-value=0  # Index number of the event channel.
        integer XcpEventChannelPriority: 0..255, scope=ECU, set at pre-compile, default-value=0  # Priority of the event channel
        integer XcpEventChannelTimeCycle: 0..255, set at pre-compile, default-value=0  # The event channel time cycle indicates which sampling period is used to process this event channel. A value of 0 means 'Not cyclic'.
        enumeration XcpEventChannelTimeUnit: {TIMESTAMP_UNIT_100MS, TIMESTAMP_UNIT_100NS, TIMESTAMP_UNIT_100PS, TIMESTAMP_UNIT_100US, TIMESTAMP_UNIT_10MS, TIMESTAMP_UNIT_10NS, TIMESTAMP_UNIT_10PS, TIMESTAMP_UNIT_10US, TIMESTAMP_UNIT_1MS, TIMESTAMP_UNIT_1NS, TIMESTAMP_UNIT_1PS, TIMESTAMP_UNIT_1S, TIMESTAMP_UNIT_1US}, multiplicity set at pre-compile, set at pre-compile, default-value=TIMESTAMP_UNIT_100MS  # This configuration parameter indicates the unit of the event channel time cycle.
        enumeration XcpEventChannelType: {DAQ, DAQ_STIM, STIM}, set at pre-compile, default-value=DAQ, default-value=DAQ  # This configuration parameter indicates what kind of DAQ list can be allocated to this event channel.
        reference XcpEventChannelTriggeredDaqListRef [0..*]: scope=ECU, multiplicity set at pre-compile, set at pre-compile, destination=XcpDaqList  # References all DAQ lists that are trigged by this event channel.
      choice container XcpPdu [1..*]  # Contains PDU information. A PDU may be either a transmission PDU or a reception PDU.
        container XcpRxPdu [0..1]  # This container specifies received PDUs.
          string XcpRxPduId: scope=ECU, set at pre-compile, symbolic-name-value=true  # ID of the PDU that will be received via a Xcp_<module>RxIndication.
          reference XcpRxPduRef: scope=ECU, post-build-variant-value=true, set at post-build in variant post-build / pre-compile in variant pre-compile, destination=Pdu
        container XcpTxPdu [0..1]  # This container specifies transmission PDUs.
          string XcpTxPduId: scope=ECU, set at pre-compile, symbolic-name-value=true  # The PDU identifier, which has to be used by the lower layer BSW module for TxConfirmations or TriggerTransmits.
          reference XcpTxPduRef: scope=ECU, post-build-variant-value=true, set at post-build in variant post-build / pre-compile in variant pre-compile, destination=Pdu  # Reference to the external PDU definition.
    container XcpSegmentInfo [0..1]  # Segment info.
      integer XcpMeasuremenAddr [0..1]: 1..4294967295, symbolic-name-value=true, default-value=2936012800, default-value=1  # Address of measurement
      container XcpPageInfo  # Page Info
        integer XcpPageInfoSize: 0..4294967295, symbolic-name-value=true, default-value=114688  # Size of page.
        integer XcpPageInfoRamStart: 0..4294967295, symbolic-name-value=true, default-value=3489660928  # Start address of RAM.
        integer XcpPageInfoRamEnd: 0..4294967295, symbolic-name-value=true, default-value=0  # End address of RAM.
        integer XcpPageInfoRomStart: 0..4294967295, symbolic-name-value=true, default-value=2936012800  # Start address of ROM.
        integer XcpPageInfoRomEnd: 0..4294967295, symbolic-name-value=true, default-value=0  # End address of ROM.
    container XcpSectorInfo [0..*]  # Sector Info
      enumeration XcpSectorInfoFlashRangeType: {CAL, CODE, NVRAM}, symbolic-name-value=true, default-value=CAL  # Flash range type of sector
      integer XcpSectorInfoStartAddress: 0..4294967295, symbolic-name-value=true, default-value=2936012800  # Start address of sector.
      integer XcpSectorInfoLength: 0..4294967295, symbolic-name-value=true, default-value=4096  # Size of sector.
      integer XcpSectorInfoEndAddress: 0..4294967295, symbolic-name-value=true, default-value=0  # End address of sector.
      integer XcpSectorInfoProgStartAddress: 0..4294967295, symbolic-name-value=true, default-value=2936012800  # Start address of Prog
      integer XcpSectorInfoProgDataSize: 0..4294967295, symbolic-name-value=true, default-value=4096  # Size of Prog
      integer XcpSectorInfoProgEndAddress: 0..4294967295, symbolic-name-value=true, default-value=0  # End address of Prog
