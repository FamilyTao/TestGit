AUTOSAR XML (schema 4-2-2)
package /SystemInfo/UnitPackage
  unit NoUnit
package /SystemInfo/EcuInstances
  ecu instance ECUA: com-configuration-gw-time-base=0.005, com-configuration-rx-time-base=0.005, com-configuration-tx-time-base=0.005, sleep-mode-supported=false, wake-up-over-bus-supported=false
