AUTOSAR XML (schema 4-2-2)
package /AUTOSAR/Interfaces
  sender receiver interface SRIF_ComplexData
    4 x data:
      dataElementPrimitive: type=PrimitiveUint16
      dataElementArray: type=ArrayUint8
      dataElementStruct: type=StructA
      dataElementStructArray: type=StructArray
  sender receiver interface SRIF_Struct
    data dataElementsStructA: type=StructA
