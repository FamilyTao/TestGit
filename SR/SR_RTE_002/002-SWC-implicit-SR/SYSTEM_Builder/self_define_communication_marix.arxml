AUTOSAR XML (schema 4-2-2)
package /SystemInfo/CanClusters
  can cluster CanCluster_0: protocol-name=CAN
    can physical channel CanChannel_0: comm-connectors=[CanChannel_0_ECUA_conn, CanChannel_0_ECUB_conn]
      frame Msg_StructA: id 0x302, from ECUA, to ECUB, frame-length=8, can-addressing-mode=STANDARD
        pdu Msg_StructA: length=8, transmission-mode-conditions=[Signal_DATA8_Msg_StructA, Signal_DATA16_Msg_StructA, Signal_Counter_Msg_StructA, Signal_CRC_Msg_StructA], transmission-mode-true-timing=cyclic-timing=time-period=0.1
          signal Signal_DATA8_Msg_StructA: start 32, 8 bit, little-endian, base-type=sint8, update-indication-bit-position=-1, to ECUB
          signal Signal_DATA16_Msg_StructA: start 24, 16 bit, big-endian, base-type=uint16, update-indication-bit-position=-1, to ECUB
          signal Signal_Counter_Msg_StructA: start 12, 4 bit, big-endian, base-type=uint8, update-indication-bit-position=-1, to ECUB
          signal Signal_CRC_Msg_StructA: start 0, 8 bit, big-endian, base-type=uint8, update-indication-bit-position=-1, to ECUB
          mapping Group_StructA_Msg_StructA: i-signal-group=Group_StructA_Msg_StructA, update-indication-bit-position=-1
package /SystemInfo/ISignals
  i signal group Group_StructA_Msg_StructA: i-signal=[Signal_DATA8_Msg_StructA, Signal_Counter_Msg_StructA, Signal_CRC_Msg_StructA, Signal_DATA16_Msg_StructA], system-signal-group=Group_StructA_Msg_StructA
package /SystemInfo/UnitPackage
  unit NoUnit
package /SystemInfo/EcuInstances
  ecu instance ECUA: com-configuration-gw-time-base=0.005, com-configuration-rx-time-base=0.005, com-configuration-tx-time-base=0.005, sleep-mode-supported=false, wake-up-over-bus-supported=false
    can communication controller CanChannel_0_ECUA: wake-up-by-controller-supported=false, can-controller-attributes=can-controller-configuration={sync-jump-width=0, time-seg-1=20, time-seg-2=10}
    can communication connector CanChannel_0_ECUA_conn: comm-controller=CanChannel_0_ECUA
  ecu instance ECUB: com-configuration-gw-time-base=0.005, com-configuration-rx-time-base=0.005, com-configuration-tx-time-base=0.005, sleep-mode-supported=false, wake-up-over-bus-supported=false
    can communication controller CanChannel_0_ECUB: wake-up-by-controller-supported=false, can-controller-attributes=can-controller-configuration={sync-jump-width=0, time-seg-1=20, time-seg-2=10}
    can communication connector CanChannel_0_ECUB_conn: comm-controller=CanChannel_0_ECUB
