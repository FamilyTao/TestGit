AUTOSAR XML (schema 4-2-2)
package /AUTOSAR/System
  system system_0
    system mapping SystemMapping_0
      sw-impl-mappings:
        swc to impl mapping CptReceiverPrototypeImplMapping: component-implementation=swcImplementation_CptObs, component=rootSwCompositionPrototype_0.BottomComposition.CptObsPrototype.CptObsPrototype
        swc to impl mapping CptSenderPrototypeImplMapping: component-implementation=swcImplementation_CptCtrl, component=rootSwCompositionPrototype_0.BottomComposition.CptCtrlPrototype.CptCtrlPrototype
      sw-mappings:
        swc to ecu mapping ECUA_SwcToEcuMapping: component=rootSwCompositionPrototype_0.BottomComposition.BottomComposition, ecu-instance=ECUA
        swc to ecu mapping ECUB_SwcToEcuMapping: component=rootSwCompositionPrototype_0.BottomComposition.CptObsPrototype.CptObsPrototype
    root-software-compositions:
      root sw composition prototype rootSwCompositionPrototype_0: software-composition=TopComposition
package /AUTOSAR/Compositions
  composition sw component type BottomComposition
    component CptObsPrototype: type=CptObs
    component CptCtrlPrototype: type=CptCtrl
    connect CptCtrlPrototype.PpAllDataTypeExplicit -> CptObsPrototype.RpAllDataTypeExplicit
    connect CptCtrlPrototype.PpAllDataTypeImplicit -> CptObsPrototype.RpAllDataTypeImplicit
  composition sw component type TopComposition
    component BottomComposition: type=BottomComposition
package /AUTOSAR/SwcImplementations
  swc implementation swcImplementation_CptCtrl: behavior=IbCtrl
  swc implementation swcImplementation_CptObs: behavior=IbObs
