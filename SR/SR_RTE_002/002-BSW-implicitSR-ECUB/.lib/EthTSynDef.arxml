AUTOSAR XML (schema 00048)
package /AUTOSAR
  module definition EthTSyn [0..1]: post-build-variant-support=true, variants pre-compile  # Configuration of the Synchronized Time-base Manager (StbM) module with respect to global time handling on Ethernet.
    container EthTSynGeneral  # This container holds the general parameters of the Ethernet-specific Synchronized Time-base Manager
      string EthTSynDestPhyAddr: set at pre-compile, default-value=01:80:C2:00:00:0E  # Destination Physical Address (MAC-Address). | Destination Physical Hardware Address (MAC-Address) of EthTSyn-gPTP Frames. Input format has to match xx:xx:xx:xx:xx:xx, where x stands for a hex value between 0 and F.
      boolean EthTSynDevErrorDetect: set at pre-compile, default-value=true  # Switches the development error detection and notification on or off. | * true: detection and notification is enabled. * false: detection and notification is disabled.
      boolean EthTSynHardwareTimestampSupport: set at pre-compile  # Activate/Deactivate the hardware time stamping functionality of the Ethernet hardware. | True: Timestamp is retrieved from the Ethernet hardware False: Timestamp is retrieved from the StbM
      float EthTSynMainFunctionPeriod: 0..INF, set at pre-compile, default-value=0  # Schedule period of the main function EthTSyn_MainFunction. | Unit: seconds.
      boolean EthTSynMasterSlaveConflictDetection: set at pre-compile, default-value=false  # Enables master / slave conflict detection and notification. | * true: detection and notification is enabled. * false: detection and notification is disabled.
      boolean EthTSynMessageCompliance: set at pre-compile  # * true: IEEE 802.1AS compliant message format will be used. * false: IEEE 802.1AS message format with AUTOSAR extension will be used. | * false: IEEE 802.1AS message format with AUTOSAR extension will be used.
      boolean EthTSynVersionInfoApi: set at pre-compile, default-value=false  # Activate/Deactivate the version information API (EthTSyn_GetVersionInfo). True: version information API activated False: version information API deactivated.
      float EthTSynTxConfirmation: 0..4, multiplicity set at pre-compile, set at pre-compile, default-value=0  # The time for TX confirmation.
    container EthTSynGlobalTimeDomain [1..*]  # This represents the existence of a global time domain on Ethernet. The EthTSyn module can administrate several global time domains at the same time that in itself form a hierarchy of domains and sub-domains. | If the EthTSyn exists it is assumed that at least one global time domain exists.
      integer EthTSynGlobalTimeDomainId: 0..31, set at pre-compile, default-value=0  # The global time domain ID.
      reference EthTSynSynchronizedTimeBaseRef: set at pre-compile, requires-symbolic-name-value=true, destination=StbMSynchronizedTimeBase  # Mandatory reference to the required synchronized time-base.
      container EthTSynGlobalTimeFollowUpDataIDList [0..1]: multiplicity set at pre-compile, post-build-variant-multiplicity=true  # The DataIDList for Follow_Up message ensures the identification of data elements due to CRC calculation and message authentication process.
        container EthTSynGlobalTimeFollowUpDataIDListElement [16..16]  # Element of the DataIDList for Follow_Up message ensures the identification of data elements due to CRC calculation and message authentication process.
          integer EthTSynGlobalTimeFollowUpDataIDListIndex: 0..15, post-build-variant-value=true, set at pre-compile, default-value=0  # Index of the DataIDList for Follow_Up message ensures the identification of data elements due to CRC calculation and message authentication process.
          integer EthTSynGlobalTimeFollowUpDataIDListValue: 0..255, post-build-variant-value=true, set at pre-compile, default-value=100  # Value of the DataIDList for Follow_Up message ensures the identification of data elements due to CRC calculation and message authentication process.
      container EthTSynPortConfig [1..*]: multiplicity set at pre-compile, post-build-variant-multiplicity=true  # Configuration of the EthTSyn-Ports within the TimeDomain.
        integer EthTSynFramePrio [0..1]: 0..7, multiplicity set at pre-compile, post-build-variant-multiplicity=true, post-build-variant-value=true, set at pre-compile, default-value=0  # This optional parameter, if present, indicates the priority of outgoing EthTSyn messages, if sent via VLAN (used for the 3-bit PCP field of the VLAN tag). If this optional parameter is not present, frames are sent without a priority and VLAN field.
        float EthTSynGlobalTimeDebounceTime: 0..4, post-build-variant-value=true, set at pre-compile, default-value=0  # This represents the configuration of a TX debounce time for Sync and Follow_Up messages compared to a message before with the same PDU. Unit: seconds
        reference EthTSynGlobalTimeEthIfRef: set at pre-compile, requires-symbolic-name-value=true, destination=EthIfController  # This represents the reference to the Ethernet interface taken to fetch the global time information.
        container EthTSynPdelayConfig: multiplicity set at pre-compile, post-build-variant-multiplicity=true  # Configuration of cyclic propagation delay measurement.
          boolean EthTSynGlobalTimePdelayRespEnable: post-build-variant-value=true, set at pre-compile, default-value=true  # This parameter allows disabling Pdelay_Resp / Pdelay_Resp_Follow_Up transmission, if no Pdelay_Req messages are expected. | FALSE: No Pdelay requests expected. Pdelay_Resp / Pdelay_Resp_Follow_Up transmission is disabled. TRUE: Pdelay requests expected. Pdelay_Resp / Pdelay_Resp_Follow_Up transmission is enabled.
          float EthTSynGlobalTimePropagationDelay: 0..4, post-build-variant-value=true, set at pre-compile, default-value=0  # If cyclic propagation delay measurement is enabled, this parameter represents the default value of the propagation delay until the first actually measured propagation delay is available. | If cyclic propagation delay measurement is disabled, this parameter replaces a measured propagation delay by a fixed value. Unit: seconds
          float EthTSynGlobalTimeTxPdelayReqPeriod: 0..INF, post-build-variant-value=true, set at pre-compile, default-value=0  # This represents configuration of the TX period for Pdelay_Req messages. | A value of 0 disables the cyclic Pdelay measurement. Unit: seconds
          float EthTSynPdelayLatencyThreshold [0..1]: 0..INF, post-build-variant-value=true, set at pre-compile, default-value=1E-5, default-value=0  # Threshold for calculated Pdelay. If a measured Pdelay exceeds EthTSynPdelayLatencyThreshold, this value is discarded. | Unit: seconds
          float EthTSynPdelayRespAndRespFollowUpTimeout: 0..4, post-build-variant-value=true, set at pre-compile, default-value=0  # Timeout value for Pdelay_Resp and Pdelay_Resp_Follow_Up after a Pdelay_Req has been transmitted resp. a Pdelay_Resp has been received. | A value of 0 deactivates this timeout observation. Unit: seconds
        choice container EthTSynPortRole: multiplicity set at pre-compile, post-build-variant-multiplicity=true  # Specifying the Role of the EthTSyn-Port (Master or Slave).
          container EthTSynGlobalTimeMaster [0..1]: multiplicity set at pre-compile, post-build-variant-multiplicity=true  # Configuration of the global time master. Each global time domain is required to have exactly one global time master. This master may or may not exist on the configured ECU.
            float EthTSynCyclicMsgResumeTime: 0..INF, post-build-variant-value=true, set at pre-compile, default-value=0  # Defines the time where the 1st regular cycle time based message transmission takes place, after an immediate transmission before. Unit: seconds
            enumeration EthTSynGlobalTimeTxCrcSecured: {CRC_NOT_SUPPORTED, CRC_SUPPORTED}, post-build-variant-value=true, set at pre-compile, default-value=CRC_NOT_SUPPORTED  # This represents the configuration of whether or not CRC is supported.
            float EthTSynGlobalTimeTxPeriod: 0..INF, post-build-variant-value=true, set at pre-compile, default-value=0  # This represents configuration of the TX period. Unit: seconds
            boolean EthTSynImmediateTimeSync: post-build-variant-value=true, set at pre-compile  # Enables/Disables the cyclic polling of StbM_GetTimeBaseUpdateCounter() within EthTSyn_MainFunction().
            boolean EthTSynTLVFollowUpOFSSubTLV: post-build-variant-value=true, set at pre-compile  # This represents the configuration of whether an AUTOSAR Follow_Up TLV OFS Sub-TLV is used or not. | * true: This represents a configuration where an AUTOSAR Follow_Up TLV OFS Sub-TLV is used. * false: This represents a configuration where an AUTOSAR Follow_Up TLV OFS Sub-TLV is not used.
            boolean EthTSynTLVFollowUpStatusSubTLV: post-build-variant-value=true, set at pre-compile  # This represents the configuration of whether an AUTOSAR Follow_Up TLV Status Sub-TLV is used or not. | * true: This represents a configuration where an AUTOSAR Follow_Up TLV Status Sub-TLV is used. * false: This represents a configuration where an AUTOSAR Follow_Up TLV Status Sub-TLV is not used.
            boolean EthTSynTLVFollowUpTimeSubTLV: post-build-variant-value=true, set at pre-compile  # This represents the configuration of whether an AUTOSAR Follow_Up TLV Time Sub-TLV is used or not. | * true: This represents a configuration where an AUTOSAR Follow_Up TLV Time Sub-TLV is used. * false: This represents a configuration where an AUTOSAR Follow_Up TLV Time Sub-TLV is not used.
            boolean EthTSynTLVFollowUpUserDataSubTLV: post-build-variant-value=true, set at pre-compile  # This represents the configuration of whether an AUTOSAR Follow_Up TLV UserData Sub-TLV is used or not. | * true: This represents a configuration where an AUTOSAR Follow_Up TLV UserData Sub-TLV is used. * false: This represents a configuration where an AUTOSAR Follow_Up TLV UserData Sub-TLV is not used.
            container EthTSynCrcTimeFlagsTxSecured [0..1]: multiplicity set at pre-compile, post-build-variant-multiplicity=true  # This container collects definitions which parts of the Follow_Up message elements shall be used for CRC calculation.
              boolean EthTSynCrcCorrectionField: post-build-variant-value=true, set at pre-compile, default-value=false  # correctionField from the Follow_Up Message Header shall be included in CRC calculation.
              boolean EthTSynCrcDomainNumber: post-build-variant-value=true, set at pre-compile, default-value=false  # domainNumber from the Follow_Up Message Header shall be included in CRC calculation.
              boolean EthTSynCrcMessageLength: post-build-variant-value=true, set at pre-compile, default-value=false  # messageLength from the Follow_Up Message Header shall be included in CRC calculation.
              boolean EthTSynCrcPreciseOriginTimestamp: post-build-variant-value=true, set at pre-compile, default-value=true  # preciseOriginTimestamp from the Follow_Up Message Field shall be included in CRC calculation.
              boolean EthTSynCrcSequenceId: post-build-variant-value=true, set at pre-compile, default-value=false  # sequenceId from the Follow_Up Message Header shall be included in CRC calculation.
              boolean EthTSynCrcSourcePortIdentity: post-build-variant-value=true, set at pre-compile, default-value=false  # sourcePortIdentity from the Follow_Up Message Header shall be included in CRC calculation.
          container EthTSynGlobalTimeSlave [0..1]: multiplicity set at pre-compile, post-build-variant-multiplicity=true  # Configuration of a time slave. Each global time domain is required to have at least one time slave. The configured ECU may or may not represent a time slave.
            float EthTSynGlobalTimeFollowUpTimeout: 0..4, post-build-variant-value=true, set at pre-compile, default-value=0  # Timeout value of the Follow_Up message (of the subsequent Sync message). | A value of 0 deactivates this timeout observation. Unit: seconds
            enumeration EthTSynRxCrcValidated: {CRC_IGNORED, CRC_NOT_VALIDATED, CRC_OPTIONAL, CRC_VALIDATED}, post-build-variant-value=true, set at pre-compile, default-value=CRC_IGNORED  # Definition of whether or not validation of the CRC takes place.
            container EthTSynCrcFlagsRxValidated [0..1]: multiplicity set at pre-compile, post-build-variant-multiplicity=true  # This container collects definitions which parts of the Follow_Up message elements shall be included in CRC validation.
              boolean EthTSynCrcCorrectionField: post-build-variant-value=true, set at pre-compile, default-value=false  # correctionField from the Follow_Up Message Header shall be included in CRC calculation.
              boolean EthTSynCrcDomainNumber: post-build-variant-value=true, set at pre-compile, default-value=false  # domainNumber from the Follow_Up Message Header shall be included in CRC calculation.
              boolean EthTSynCrcMessageLength: post-build-variant-value=true, set at pre-compile, default-value=false  # messageLength from the Follow_Up Message Header shall be included in CRC calculation.
              boolean EthTSynCrcPreciseOriginTimestamp: post-build-variant-value=true, set at pre-compile, default-value=true  # preciseOriginTimestamp from the Follow_Up Message Field shall be included in CRC calculation.
              boolean EthTSynCrcSequenceId: post-build-variant-value=true, set at pre-compile, default-value=false  # sequenceId from the Follow_Up Message Header shall be included in CRC calculation.
              boolean EthTSynCrcSourcePortIdentity: post-build-variant-value=true, set at pre-compile, default-value=false  # sourcePortIdentity from the Follow_Up Message Header shall be included in CRC calculation.
