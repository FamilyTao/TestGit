AUTOSAR XML (schema 4-2-2)
package /AUTOSAR/System
  system system_0
    system mapping SystemMapping_0: sender-receiver-to-signal-group-mapping{data-element=BottomComposition.CptObs_BPrototype.rootSwCompositionPrototype_0.RpExplicit.dataElementStruct, signal-group=SignalGroupStructA36_MsgStructA, type-mapping=sender-rec-record-type-mapping=record-element-mappings=[{implementation-record-element=Data_Uint8, system-signal=SignalData8_MsgStructA}, {implementation-record-element=Counter_Uint8, system-signal=SignalCounter4_MsgStructA}, {implementation-record-element=Crc_Uint8, system-signal=SignalCrc8_MsgStructA}, {implementation-record-element=Data_Uint16, system-signal=SignalData16_MsgStructA}]}
      sw-impl-mappings:
        swc to impl mapping CptReceiverPrototypeImplMapping: component-implementation=swcImplementation_CptObs_A, component=rootSwCompositionPrototype_0.BottomComposition.CptObs_APrototype.CptObs_APrototype
        swc to impl mapping CptSenderPrototypeImplMapping: component-implementation=swcImplementation_CptCtrl_A, component=rootSwCompositionPrototype_0.BottomComposition.CptCtrl_APrototype.CptCtrl_APrototype
        swc to impl mapping CptObs_BPrototypeImplMapping: component-implementation=swcImplementation_CptObs_B, component=rootSwCompositionPrototype_0.BottomComposition.CptObs_BPrototype.CptObs_BPrototype
      sw-mappings:
        swc to ecu mapping ECUA_SwcToEcuMapping: ecu-instance=ECUA
          component:
            rootSwCompositionPrototype_0.BottomComposition.CptObs_APrototype.CptObs_APrototype
            rootSwCompositionPrototype_0.BottomComposition.CptCtrl_APrototype.CptCtrl_APrototype
        swc to ecu mapping ECUB_SwcToEcuMapping: component=rootSwCompositionPrototype_0.BottomComposition.CptObs_APrototype.CptObs_APrototype
        swc to ecu mapping ECUB_SwcToEcuMapping: component=rootSwCompositionPrototype_0.BottomComposition.CptObs_BPrototype.CptObs_BPrototype, ecu-instance=ECUB
    root-software-compositions:
      root sw composition prototype rootSwCompositionPrototype_0: software-composition=TopComposition
package /AUTOSAR/Compositions
  composition sw component type BottomComposition
    component CptObs_APrototype: type=CptObs_A
    component CptCtrl_APrototype: type=CptCtrl_A
    component CptObs_BPrototype: type=CptObs_B
    connect CptCtrl_APrototype.PpExplict -> CptObs_APrototype.RpExplicit
    connect CptCtrl_APrototype.PpExplict -> CptObs_BPrototype.RpExplicit
  composition sw component type TopComposition
    component BottomComposition: type=BottomComposition
package /AUTOSAR/SwcImplementations
  swc implementation swcImplementation_CptCtrl_A: behavior=IbCtrl_A
  swc implementation swcImplementation_CptObs_A: behavior=IbObs_A
  swc implementation swcImplementation_CptObs_B: behavior=IbObs_B
