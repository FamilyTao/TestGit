AUTOSAR XML (schema 4-2-2)
package /AUTOSAR
  module definition Xfrm [0..*]: post-build-variant-support=true, variants link-time/post-build/pre-compile
    container Combasedxfrm [0..1]
      container ComXfGeneral  # Contains the general configuration parameters of the module.
        boolean ComXfDevErrorDetect: set at pre-compile, default-value=true  # Switches the Default Error Tracer (Det) detection and notification ON or OFF. | * true: enabled (ON). * false: disabled (OFF).
        boolean ComXfVersionInfoApi: multiplicity set at pre-compile, set at pre-compile, default-value=false  # Switches the version info API on or off. | true: enabled false: disabled
      container ComXf_Transformer [0..*]  # Contains the general configuration parameters of the module.
        string API_Name: multiplicity set at pre-compile, set at pre-compile  # This represents a unique numerical identiﬁer
        string DataElement_Type: multiplicity set at pre-compile, set at pre-compile  # This represents a unique numerical identiﬁer
        reference XfrmSignalGroupRef: multiplicity set at link in variant link-time / post-build in variant post-build / pre-compile in variant pre-compile, post-build-variant-multiplicity=true, post-build-variant-value=true, set at link in variant link-time / post-build in variant post-build / pre-compile in variant pre-compile, destination=ComSignalGroup  # References to all signal groups contained in this I-Pdu
        reference XfrmGroupSignalRef [1..256]: multiplicity set at post-build in variant post-build / pre-compile in variant pre-compile, post-build-variant-multiplicity=true, post-build-variant-value=true, set at post-build in variant post-build / pre-compile in variant pre-compile, destination=ComGroupSignal  # Reference to the ComGroupSignal that is required for this ComSignalGroup.
    container E2EXfrmGeneral [0..1]
      container E2EXfrmGeneral  # This container holds the general, pre-compile configuration parameters.
        boolean E2EXfVersionInfoApi: multiplicity set at pre-compile, set at pre-compile, default-value=false  # Switches the version info API on or off. | true: enabled false: disabled
        boolean E2EXfDevErrorDetect: multiplicity set at pre-compile, set at pre-compile, default-value=true  # Enable or Disable the switch of development error detect. | true: enabled false: disabled
      container E2ETransformer [0..*]
        reference E2EISignalProp: multiplicity set at link in variant link-time / post-build in variant post-build / pre-compile in variant pre-compile, post-build-variant-multiplicity=true, post-build-variant-value=true, set at link in variant link-time / post-build in variant post-build / pre-compile in variant pre-compile, destination=EndToEndTransformationISignalProps
        reference E2EComSpecProp [0..1]: multiplicity set at link in variant link-time / post-build in variant post-build / pre-compile in variant pre-compile, post-build-variant-multiplicity=true, post-build-variant-value=true, set at link in variant link-time / post-build in variant post-build / pre-compile in variant pre-compile, destination=EndToEndTransformationComSpecProps
      container EndToEndTransformationISignalProps [0..*]  # ETransformationISignalProps holds all the attributes for the different TransformationTechnologies that are ISignal speciﬁc.
        reference Transformer: multiplicity set at link in variant link-time / post-build in variant post-build / pre-compile in variant pre-compile, post-build-variant-multiplicity=true, post-build-variant-value=true, set at link in variant link-time / post-build in variant post-build / pre-compile in variant pre-compile, destination=TransformationTechnology  # References to TransformationTechnology
        string dataId: multiplicity set at pre-compile, set at pre-compile, default-value=0  # This represents a unique numerical identiﬁer(decimal)
        integer dataLength: 0..65535, multiplicity set at link in variant link-time+post-build / pre-compile in variant pre-compile, set at link in variant link-time+post-build / pre-compile in variant pre-compile, symbolic-name-value=true, default-value=0  # Length of Data in bits .
        integer maxDataLength: 0..65535, multiplicity set at link in variant link-time+post-build / pre-compile in variant pre-compile, set at link in variant link-time+post-build / pre-compile in variant pre-compile, symbolic-name-value=true, default-value=0  # Maximum length of Data in bits .
        integer minDataLength: 0..65535, multiplicity set at link in variant link-time+post-build / pre-compile in variant pre-compile, set at link in variant link-time+post-build / pre-compile in variant pre-compile, symbolic-name-value=true, default-value=0  # Minimum length of Data in bits .
      container EndToEndTransformationComSpecProps [0..*]  # EndToEndTransformationIComSpecProps speciﬁes port speciﬁc conﬁguration properties for EndToEnd transformer attributes.
        boolean disabelEndToEndCheck: set at pre-compile, symbolic-name-value=true  # Disables/Enables the E2E check. | * true: enabled (ON). * false: disabled (OFF).
        integer maxDeltaCounter: 1..4294967295, multiplicity set at link in variant link-time+post-build / pre-compile in variant pre-compile, set at link in variant link-time+post-build / pre-compile in variant pre-compile, symbolic-name-value=true, default-value=1  # Maximum allowed gap between two counter values of two consecutive checks .
        integer maxErrorStateInit: 0..255, multiplicity set at link in variant link-time+post-build / pre-compile in variant pre-compile, set at link in variant link-time+post-build / pre-compile in variant pre-compile, symbolic-name-value=true, default-value=0  # Maximal number of checks in which ProﬁleStatus equal to E2E_P_ERROR was determined, within the last WindowSize checks, for the state E2E_SM_INIT .
        integer maxErrorStateInvalid: 0..255, multiplicity set at link in variant link-time+post-build / pre-compile in variant pre-compile, set at link in variant link-time+post-build / pre-compile in variant pre-compile, symbolic-name-value=true, default-value=0  # Maximal number of checks in which ProﬁleStatus equal to E2E_P_ERROR was determined, within the last WindowSize checks, for the state E2E_SM_INVALID.
        integer maxErrorStateValid: 0..255, multiplicity set at link in variant link-time+post-build / pre-compile in variant pre-compile, set at link in variant link-time+post-build / pre-compile in variant pre-compile, symbolic-name-value=true, default-value=0  # Maximal number of checks in which ProﬁleStatus equal to E2E_P_ERROR was determined, within the last WindowSize checks, for the state E2E_SM_VALID.
        integer maxNoNewOrRepeatedData: 0..255, multiplicity set at link in variant link-time+post-build / pre-compile in variant pre-compile, set at link in variant link-time+post-build / pre-compile in variant pre-compile, symbolic-name-value=true, default-value=0  # The maximum allowed amount of consecutive failed counter checks.
        integer minOkStateInit: 0..255, multiplicity set at link in variant link-time+post-build / pre-compile in variant pre-compile, set at link in variant link-time+post-build / pre-compile in variant pre-compile, symbolic-name-value=true, default-value=1  # Minimal number of checks in which ProﬁleStatus equal to E2E_P_OK was determined, within the last WindowSize checks, for the state E2E_SM_INIT.
        integer minOkStateInvalid: 0..255, multiplicity set at link in variant link-time+post-build / pre-compile in variant pre-compile, set at link in variant link-time+post-build / pre-compile in variant pre-compile, symbolic-name-value=true, default-value=1  # Minimal number of checks in which ProﬁleStatus equal to E2E_P_OK was determined, within the last WindowSize checks, for the state E2E_SM_INVALID.
        integer minOkStateValid: 0..255, multiplicity set at link in variant link-time+post-build / pre-compile in variant pre-compile, set at link in variant link-time+post-build / pre-compile in variant pre-compile, symbolic-name-value=true, default-value=1  # Minimal number of checks in which ProﬁleStatus equal to E2E_P_OK was determined, within the last WindowSize checks, for the state E2E_SM_VALID.
        integer syncCounterInit: 0..255, multiplicity set at link in variant link-time+post-build / pre-compile in variant pre-compile, set at link in variant link-time+post-build / pre-compile in variant pre-compile, symbolic-name-value=true, default-value=0  # Number of checks required for validating the consistency of the counter that must be received with a valid counter.
        integer windowSizeInit: 0..255, multiplicity set at link in variant link-time+post-build / pre-compile in variant pre-compile, set at link in variant link-time+post-build / pre-compile in variant pre-compile, default-value=1  # Size of the monitoring window for the E2E state machine.
        integer windowSizeValid: 1..255, multiplicity set at link in variant link-time+post-build / pre-compile in variant pre-compile, set at link in variant link-time+post-build / pre-compile in variant pre-compile, default-value=1  # Size of the monitoring window for the E2E state machine.
        integer windowSizeInvalid: 0..255, multiplicity set at link in variant link-time+post-build / pre-compile in variant pre-compile, set at link in variant link-time+post-build / pre-compile in variant pre-compile, default-value=1  # Size of the monitoring window for the E2E state machine.
        boolean clearFromValidToInvalid: multiplicity set at pre-compile, set at pre-compile, default-value=true  # If set, the transformer uses the input buffer as output buffer. | true: enabled false: disabled
    container TransformationSet [0..*]  # For each transformer (TransformationTechnology) in a transformer chain (DataTransformation) which is applied to an ISignal it is necessary to specify the BswModuleEntry which implements it. This is the container to hold these mappings.
      container Transformation [0..*]  # A Transformation represents a transformer chain. It is an ordered list of transformers.
        string TransformerId: multiplicity set at pre-compile, set at pre-compile  # Used for transformer module API naming.
        choice reference TransformChains [0..*]: multiplicity set at link in variant link-time / post-build in variant post-build / pre-compile in variant pre-compile, post-build-variant-multiplicity=true, post-build-variant-value=true, set at link in variant link-time / post-build in variant post-build / pre-compile in variant pre-compile, destination=[ComXf_Transformer, E2ETransformer, SomeIpXfConfig]  # References to all transformer(i.e. ComXf_Transformer,E2ETransformer,SomeIpXfConfig)
      container TransformationTechnology [0..*]  # A TransformationTechnology is a transformer inside a transformer chain.
        boolean NeedsOriginalData: multiplicity set at pre-compile, set at pre-compile, default-value=false  # Speciﬁes whether this transformer gets access to the SWC's original data. | true: enabled false: disabled
        string Protocol: multiplicity set at pre-compile, set at pre-compile, default-value=E2E  # Speciﬁes the protocol that is implemented by this transformer.
        enumeration TransformerClass: {CUSTOM, SAFETY, SECURITY, SERIALIZER}, scope=ECU, set at pre-compile, default-value=SAFETY  # Speciﬁes to which transformer class this transformer belongs.
        string Version: multiplicity set at pre-compile, set at pre-compile, default-value=1.0.0  # Version of the implemented protocol.
        container EndToEndTransformationDescription [0..1]: multiplicity set at link in variant link-time / post-build in variant post-build / pre-compile in variant pre-compile, post-build-variant-multiplicity=true  # EndToEndTransformationDescription holds these attributes which are profile specific and have the same value for all E2E transformers.
          integer counterOffset: 0..65535, multiplicity set at link in variant link-time+post-build / pre-compile in variant pre-compile, set at link in variant link-time+post-build / pre-compile in variant pre-compile, default-value=8  # Offset of the counter in the Data[] array in bits .
          integer crcOffset: 0..65535, multiplicity set at link in variant link-time+post-build / pre-compile in variant pre-compile, set at link in variant link-time+post-build / pre-compile in variant pre-compile, default-value=0  # Offset of the CRC in the Data[] array in bits.
          enumeration dataIdMode [0..1]: {ALL16BIT, ALTERNATING8BIT, LOWER8BIT, LOWER12BIT, NOTUSED}, multiplicity set at link in variant link-time+post-build / pre-compile in variant pre-compile, set at link in variant link-time+post-build / pre-compile in variant pre-compile, default-value=ALL16BIT  # This attribute describes the inclusion mode that is used to include the implicit two-byte Data ID in the one-byte CRC. | On receiver side: Name of Com_CbkRxAck callback function to be called. If this parameter is omitted no notification shall take place.
          integer dataIdNibbleOffset: 0..65535, multiplicity set at link in variant link-time+post-build / pre-compile in variant pre-compile, set at link in variant link-time+post-build / pre-compile in variant pre-compile, default-value=12  # Offset of the Data ID nibble in the Data[] array in bits.
          integer maxDeltaCounter: 1..4294967295, multiplicity set at link in variant link-time+post-build / pre-compile in variant pre-compile, set at link in variant link-time+post-build / pre-compile in variant pre-compile, default-value=1  # Maximum allowed gap between two counter values of two consecutive checks.
          integer maxErrorStateInit: 0..255, multiplicity set at link in variant link-time+post-build / pre-compile in variant pre-compile, set at link in variant link-time+post-build / pre-compile in variant pre-compile, default-value=0  # Maximal number of checks in which ProfileStatus equal to E2E_P_ERROR was determined, within the last WindowSize checks, for the state E2E_SM_INIT.
          integer maxErrorStateInvalid: 0..255, multiplicity set at link in variant link-time+post-build / pre-compile in variant pre-compile, set at link in variant link-time+post-build / pre-compile in variant pre-compile, default-value=0  # Maximal number of checks in which ProfileStatus equal to E2E_P_ERROR was determined, within the last WindowSize checks, for the state E2E_SM_INVALID.
          integer maxErrorStateValid: 0..255, multiplicity set at link in variant link-time+post-build / pre-compile in variant pre-compile, set at link in variant link-time+post-build / pre-compile in variant pre-compile, default-value=0  # Maximal number of checks in which ProfileStatus equal to E2E_P_ERROR was determined, within the last WindowSize checks, for the state E2E_SM_VALID.
          integer maxNoNewOrRepeatedData: 0..255, multiplicity set at link in variant link-time+post-build / pre-compile in variant pre-compile, set at link in variant link-time+post-build / pre-compile in variant pre-compile, default-value=0  # The maximum allowed amount of consecutive failed counter checks.
          integer minOkStateInit: 0..255, multiplicity set at link in variant link-time+post-build / pre-compile in variant pre-compile, set at link in variant link-time+post-build / pre-compile in variant pre-compile, default-value=1  # Minimal number of checks in which ProfileStatus equal to E2E_P_OK was determined, within the last WindowSize checks, for the state E2E_SM_INIT.
          integer minOkStateInvalid: 0..255, multiplicity set at link in variant link-time+post-build / pre-compile in variant pre-compile, set at link in variant link-time+post-build / pre-compile in variant pre-compile, default-value=1  # Minimal number of checks in which ProfileStatus equal to E2E_P_OK was determined, within the last WindowSize checks, for the state E2E_SM_INVALID.
          integer minOkStateValid: 0..255, multiplicity set at link in variant link-time+post-build / pre-compile in variant pre-compile, set at link in variant link-time+post-build / pre-compile in variant pre-compile, default-value=1  # Minimal number of checks in which ProfileStatus equal to E2E_P_OK was determined, within the last WindowSize checks, for the state E2E_SM_VALID.
          integer offset: 0..65535, multiplicity set at link in variant link-time+post-build / pre-compile in variant pre-compile, set at link in variant link-time+post-build / pre-compile in variant pre-compile, default-value=0  # Offset of the E2E header in the Data[] array in bits.
          enumeration profileBehavior: 0..65535, {R4_2}, multiplicity set at link in variant link-time+post-build / pre-compile in variant pre-compile, set at link in variant link-time+post-build / pre-compile in variant pre-compile, default-value=R4_2  # Behavior of the check functionality | On receiver side: Name of Com_CbkRxAck callback function to be called. If this parameter is omitted no notification shall take place.
          enumeration profileName: {PROFILE_01, PROFILE_02, PROFILE_04, PROFILE_05, PROFILE_06, PROFILE_07, PROFILE_11, PROFILE_22}, multiplicity set at link in variant link-time+post-build / pre-compile in variant pre-compile, set at link in variant link-time+post-build / pre-compile in variant pre-compile, default-value=PROFILE_01  # Definition of the E2E profile.
          integer syncCounterInit: 0..255, multiplicity set at link in variant link-time+post-build / pre-compile in variant pre-compile, set at link in variant link-time+post-build / pre-compile in variant pre-compile, default-value=0  # Number of checks required for validating the consistency of the counter that must be received with a valid counter (i.e. counter within the allowed lock-in range) after the detection of an unexpected behavior of a received counter.
          integer upperHeaderBitsToShift [0..1]: 0..65535, multiplicity set at link in variant link-time+post-build / pre-compile in variant pre-compile, set at link in variant link-time+post-build / pre-compile in variant pre-compile, default-value=0  # This attribute describes the number of upper-header bits to be shifted.
          integer windowSizeInit: 0..255, multiplicity set at link in variant link-time+post-build / pre-compile in variant pre-compile, set at link in variant link-time+post-build / pre-compile in variant pre-compile, default-value=1  # Size of the monitoring window for the E2E state machine.
          integer windowSizeValid: 1..255, multiplicity set at link in variant link-time+post-build / pre-compile in variant pre-compile, set at link in variant link-time+post-build / pre-compile in variant pre-compile, default-value=1  # Size of the monitoring window for the E2E state machine.
          integer windowSizeInvalid: 0..255, multiplicity set at link in variant link-time+post-build / pre-compile in variant pre-compile, set at link in variant link-time+post-build / pre-compile in variant pre-compile, default-value=1  # Size of the monitoring window for the E2E state machine.
          boolean clearFromValidToInvalid: multiplicity set at pre-compile, set at pre-compile, default-value=true  # If set, the transformer uses the input buffer as output buffer. | true: enabled false: disabled
        container SOMEIPTransformationDescription [0..1]: multiplicity set at link in variant link-time / post-build in variant post-build / pre-compile in variant pre-compile, post-build-variant-multiplicity=true
          integer alignment: 1..255, multiplicity set at link in variant link-time+post-build / pre-compile in variant pre-compile, set at link in variant link-time+post-build / pre-compile in variant pre-compile
          enumeration byteOrder: {MostSignificantByteFirst, MostSignificantByteLast, Opaque}, set at pre-compile
          integer interfaceVersion: 0..65535, multiplicity set at link in variant link-time+post-build / pre-compile in variant pre-compile, set at link in variant link-time+post-build / pre-compile in variant pre-compile
        container BufferProperty: multiplicity set at link in variant link-time / post-build in variant post-build / pre-compile in variant pre-compile, post-build-variant-multiplicity=true  # BufferProperty.
          string BufferName [0..1]: multiplicity set at pre-compile, set at pre-compile  # Deﬁnes the transformerchain buffer name。
          integer BufferLength [0..1]: 0..65535, multiplicity set at link in variant link-time+post-build / pre-compile in variant pre-compile, set at link in variant link-time+post-build / pre-compile in variant pre-compile  # Deﬁnes the transformerchain buffer length.
          integer HeaderLength: 0..65535, multiplicity set at link in variant link-time+post-build / pre-compile in variant pre-compile, set at link in variant link-time+post-build / pre-compile in variant pre-compile, default-value=16  # Deﬁnes the length of the header (in bits) this transformer will add in front of the data..
          boolean InPlace: multiplicity set at pre-compile, set at pre-compile, default-value=false  # If set, the transformer uses the input buffer as output buffer. | true: enabled false: disabled
    container DataTypeDescription [0..*]: multiplicity set at pre-compile  # Used to define data types.
      enumeration Type: {VALUE, ARRAY, DYNAMIC ARRAY, STRING, DYNAMIC STRING, STRUCT, UNION}, scope=ECU, multiplicity set at link in variant link-time+post-build / pre-compile in variant pre-compile, set at link in variant link-time+post-build / pre-compile in variant pre-compile
      enumeration ValueType: {boolean, uint8, uint16, uint32, uint64, sint8, sint16, sint32, sint64, float32, float64}, scope=ECU, multiplicity set at link in variant link-time+post-build / pre-compile in variant pre-compile, set at link in variant link-time+post-build / pre-compile in variant pre-compile, default-value=boolean
      integer ArrayLength: 1..65535, post-build-variant-value=true, set at link in variant link-time / post-build in variant post-build / pre-compile in variant pre-compile, default-value=1
      enumeration StringEncoding: {UTF-8, UTF-16}, scope=ECU, multiplicity set at link in variant link-time+post-build / pre-compile in variant pre-compile, set at link in variant link-time+post-build / pre-compile in variant pre-compile, default-value=UTF-8
      integer StringLength: 1..65535, post-build-variant-value=true, set at link in variant link-time / post-build in variant post-build / pre-compile in variant pre-compile, default-value=1
      integer TypeLength: 0..65535, multiplicity set at link in variant link-time+post-build / pre-compile in variant pre-compile, set at link in variant link-time+post-build / pre-compile in variant pre-compile, symbolic-name-value=true, default-value=0
      reference ArrayElementType [0..1]: multiplicity set at link in variant link-time / post-build in variant post-build / pre-compile in variant pre-compile, post-build-variant-multiplicity=true, post-build-variant-value=true, set at link in variant link-time / post-build in variant post-build / pre-compile in variant pre-compile, destination=DataTypeDescription
      reference ReferencedDataType [0..1]: multiplicity set at link in variant link-time / post-build in variant post-build / pre-compile in variant pre-compile, post-build-variant-multiplicity=true, post-build-variant-value=true, set at link in variant link-time / post-build in variant post-build / pre-compile in variant pre-compile, destination=DataTypeDescription
      container UnionElement [0..1]: multiplicity set at pre-compile
        container MemberSelector: multiplicity set at pre-compile
          enumeration MemberSelectorType: {uint8, uint16, uint32}, scope=ECU, multiplicity set at link in variant link-time+post-build / pre-compile in variant pre-compile, set at link in variant link-time+post-build / pre-compile in variant pre-compile
        container UnionMember [1..*]: multiplicity set at pre-compile
          reference ReferenceType: multiplicity set at link in variant link-time / post-build in variant post-build / pre-compile in variant pre-compile, post-build-variant-multiplicity=true, post-build-variant-value=true, set at link in variant link-time / post-build in variant post-build / pre-compile in variant pre-compile, destination=DataTypeDescription
      container SubElement [0..*]: multiplicity set at pre-compile
        reference ReferenceType: multiplicity set at link in variant link-time / post-build in variant post-build / pre-compile in variant pre-compile, post-build-variant-multiplicity=true, post-build-variant-value=true, set at link in variant link-time / post-build in variant post-build / pre-compile in variant pre-compile, destination=DataTypeDescription
      container SizeIndicator [0..*]: multiplicity set at pre-compile
        enumeration SizeIndicatorType: {uint8, uint16, uint32}, scope=ECU, multiplicity set at link in variant link-time+post-build / pre-compile in variant pre-compile, set at link in variant link-time+post-build / pre-compile in variant pre-compile
      container StorageArray [0..*]: multiplicity set at pre-compile
        integer ArrayMaxLength: 1..65535, post-build-variant-value=true, set at link in variant link-time / post-build in variant post-build / pre-compile in variant pre-compile
    container SomeIpXfPublic [0..*]
      boolean XfrmDevErrorDetect: scope=ECU, set at link in variant link-time+post-build / pre-compile in variant pre-compile, default-value=true
      string SomeIpXfPublicCddHeaderFile [0..*]: scope=ECU, multiplicity set at pre-compile, set at pre-compile, max-length=32, min-length=1  # Defines header files for callback functions which shall be included in case of CDDs. Range of characters is 1.. 32.
      integer SomeipxfMaxNestingLayerNum: 0..65535, post-build-variant-value=true, set at link in variant link-time / post-build in variant post-build / pre-compile in variant pre-compile, default-value=15
      container SOMEIPTransformationISignalProp [0..*]: multiplicity set at link in variant link-time / post-build in variant post-build / pre-compile in variant pre-compile, post-build-variant-multiplicity=true
        integer InterfaceVersion [0..1]: 0..65535, post-build-variant-value=true, set at link in variant link-time / post-build in variant post-build / pre-compile in variant pre-compile, default-value=0  # The interface version the SOME/IP transformer shall use.
        enumeration MessageType [0..1]: {Error, Notification, Request, RequestNoReturn, Response}, scope=ECU, multiplicity set at link in variant link-time+post-build / pre-compile in variant pre-compile, set at link in variant link-time+post-build / pre-compile in variant pre-compile  # The Message Type which shall be placed into the SOME/IP header.
        enumeration SessionHandlingSR [0..1]: {SessionHandlingActive, SessionHandlingInactive}, scope=ECU, multiplicity set at link in variant link-time+post-build / pre-compile in variant pre-compile, set at link in variant link-time+post-build / pre-compile in variant pre-compile  # Defines whether the SOME/IP transformer shall use session handling for Sender/Receiver communication.
        integer SizeOfArrayLengthFields [0..1]: 0..65535, post-build-variant-value=true, set at link in variant link-time / post-build in variant post-build / pre-compile in variant pre-compile, default-value=0  # The size of all length fields (in Bytes) of fixed-size arrays in the SOME/IP message.
        integer SizeOfStructLengthFields [0..1]: 0..65535, post-build-variant-value=true, set at link in variant link-time / post-build in variant post-build / pre-compile in variant pre-compile, default-value=0  # The size of all length fields (in Bytes) of structs in the SOME/IP message.
        integer SizeOfUnionLengthFields [0..1]: 0..65535, post-build-variant-value=true, set at link in variant link-time / post-build in variant post-build / pre-compile in variant pre-compile, default-value=0  # The size of all length fields (in Bytes) of unions in the SOME/IP message.
      container SenderReceiverInterface [0..*]: multiplicity set at link in variant link-time / post-build in variant post-build / pre-compile in variant pre-compile, post-build-variant-multiplicity=true
        reference DataElement: post-build-variant-value=true, set at link in variant link-time / post-build in variant post-build / pre-compile in variant pre-compile, destination=DataTypeDescription  # The data elements of this SenderReceiverInterface.
      container ClientServerInterface [0..*]: multiplicity set at post-build in variant post-build / pre-compile in variant pre-compile, post-build-variant-multiplicity=true
        container ClientServerOperation [0..*]: multiplicity set at post-build in variant post-build / pre-compile in variant pre-compile, post-build-variant-multiplicity=true
          container argument [1..*]: multiplicity set at post-build in variant post-build / pre-compile in variant pre-compile, post-build-variant-multiplicity=true
            enumeration Direction: {IN, INOUT, OUT}, multiplicity set at post-build in variant post-build / pre-compile in variant pre-compile, post-build-variant-multiplicity=true, post-build-variant-value=true, set at post-build in variant post-build / pre-compile in variant pre-compile, default-value=PDUR_DIRECT  # This attribute specifies the direction of the argument prototype.
            reference Type: post-build-variant-value=true, set at post-build in variant post-build / pre-compile in variant pre-compile, destination=DataTypeDescription  # This allows to denote the intended type within blueprints. It shall be replaced by a proper type when deriving Interfaces from the Blueprint.
          container possibleError [0..*]
            integer ErrorCode: 0..65535, multiplicity set at pre-compile, set at pre-compile  # The RTE generator is forced to assign this value to the corresponding error symbol. Note that for error codes certain ranges are predefined (see RTE specification).
      container SomeIpXfConfig [1..*]
        enumeration ServiceType [0..1]: {Client, Server}, set at pre-compile
        enumeration CommunicationType: {Client-Server, Sender-Receiver, Trigger}, set at pre-compile, default-value=Client-Server
        enumeration Direction: {RECEIVE, SEND}, set at pre-compile, default-value=RECEIVE
        enumeration csErrorReaction [0..1]: {applicationOnly, autonomous}, set at pre-compile, default-value=LINEAR
        symbolic name reference SOMEIPTransformationISignalPropsRef: multiplicity set at link in variant link-time / post-build in variant post-build / pre-compile in variant pre-compile, post-build-variant-multiplicity=true, post-build-variant-value=true, set at link in variant link-time / post-build in variant post-build / pre-compile in variant pre-compile, destination=SOMEIPTransformationISignalProp
        reference ClientServerInterfaceRef [0..1]: multiplicity set at post-build in variant post-build / pre-compile in variant pre-compile, post-build-variant-multiplicity=true, post-build-variant-value=true, set at post-build in variant post-build / pre-compile in variant pre-compile, destination=ClientServerInterface
        reference SenderReceiverInterfaceRef [0..1]: multiplicity set at post-build in variant post-build / pre-compile in variant pre-compile, post-build-variant-multiplicity=true, post-build-variant-value=true, set at post-build in variant post-build / pre-compile in variant pre-compile, destination=SenderReceiverInterface
        reference XfrmTransformationTechnologyRef: multiplicity set at post-build in variant post-build / pre-compile in variant pre-compile, post-build-variant-multiplicity=true, post-build-variant-value=true, set at post-build in variant post-build / pre-compile in variant pre-compile, destination=TransformationTechnology
        container XfrmDemEventParameterRefs [0..1]
          symbolic name reference XFRMEMALFORMEDMESSAGE: multiplicity set at link in variant link-time / post-build in variant post-build / pre-compile in variant pre-compile, post-build-variant-multiplicity=true, post-build-variant-value=true, set at link in variant link-time / post-build in variant post-build / pre-compile in variant pre-compile, destination=DemEventParameter
