AUTOSAR XML (schema 4-2-2)
package /AUTOSAR/System
  system system_0
    system mapping SystemMapping_0
      sw-impl-mappings:
        swc to impl mapping CptReceiverPrototypeImplMapping: component-implementation=swcImplementation_CptObs, component=rootSwCompositionPrototype_0.BottomComposition.CptReceiverPrototype.CptReceiverPrototype
        swc to impl mapping CptSenderPrototypeImplMapping: component-implementation=swcImplementation_CptCtrl, component=rootSwCompositionPrototype_0.BottomComposition.CptSenderPrototype.CptSenderPrototype
        swc to impl mapping CptObs2PrototypeImplMapping: component-implementation=swcImplementation_CptObs2, component=rootSwCompositionPrototype_0.BottomComposition.CptObs2Prototype.CptObs2Prototype
      sw-mappings:
        swc to ecu mapping ECUA_SwcToEcuMapping: component=rootSwCompositionPrototype_0.BottomComposition.BottomComposition, ecu-instance=ECUA
        swc to ecu mapping ECUB_SwcToEcuMapping: component=rootSwCompositionPrototype_0.BottomComposition.CptReceiverPrototype.CptReceiverPrototype
    root-software-compositions:
      root sw composition prototype rootSwCompositionPrototype_0: software-composition=TopComposition
package /AUTOSAR/Compositions
  composition sw component type BottomComposition
    component CptReceiverPrototype: type=CptObs
    component CptSenderPrototype: type=CptCtrl
    component CptObs2Prototype: type=CptObs2
    connect CptSenderPrototype.PpExplict -> CptReceiverPrototype.RpExplicit
    connect CptSenderPrototype.PpExplict -> CptObs2Prototype.RpExplicit
  composition sw component type TopComposition
    component BottomComposition: type=BottomComposition
package /AUTOSAR/SwcImplementations
  swc implementation swcImplementation_CptCtrl: behavior=IbCtrl
  swc implementation swcImplementation_CptObs: behavior=IbObs
  swc implementation swcImplementation_CptObs2: behavior=IbObs2
