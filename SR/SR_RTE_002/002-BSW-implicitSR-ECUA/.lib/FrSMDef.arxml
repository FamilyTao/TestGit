AUTOSAR XML (schema 4-2-2)
package /AUTOSAR
  module definition FrSM [0..1]: post-build-variant-support=true, variants link-time/post-build/pre-compile  # Configuration of the FlexRay State Manager
    container FrSMGeneral  # This container contains the general configuration parameters of the FlexRay State Manager.
      boolean FrSMAllSlotsSupport: multiplicity set at pre-compile, set at pre-compile  # Configuration parameter to enable/disable FrSM support to enable/disable the switching from key-slot/single-slot mode to all-slot mode.
      boolean FrSMDevErrorDetect: set at pre-compile, default-value=false  # Switches the development error detection and notification on or off. | * true: detection and notification is enabled. * false: detection and notification is disabled.
      function name FrSMSyncLossErrorIndicationName [0..1]: multiplicity set at link in variant link-time+post-build / pre-compile in variant pre-compile, set at link in variant link-time+post-build / pre-compile in variant pre-compile  # Name of <Cdd>_SyncLossErrorIndication function that shall be called on loss of synchronization. If this parameter is omitted no indication shall take place.
      function name FrSMSyncLossErrorIndicationHeaderName [0..1]: multiplicity set at link in variant link-time+post-build / pre-compile in variant pre-compile, set at link in variant link-time+post-build / pre-compile in variant pre-compile  # Configuration of the header file name that defines the FrSMSyncLossErrorIndicationName.
      boolean FrSMVersionInfoApi: set at pre-compile, default-value=false  # Enables and disables the version info API
    container FrSMConfig  # This container comprises the cluster specific configuration of the FlexRay State Manager.
      container FrSMCluster [1..*]  # This container specifies a FlexRay cluster and all related data. A FlexRay cluster may consist of more than one controller per ECU.
        boolean FrSMCheckWakeupReason: post-build-variant-value=true, set at link in variant link-time / post-build in variant post-build / pre-compile in variant pre-compile  # If FrSMCheckWakeupReason is true, the FrSM will check the wakeup reason in order to skip the wakeup in case of wakeup by bus. If FrSMCheckWakeupReason is false, the FrSM will always try to perform a wakeup.
        boolean FrSMDelayStartupWithoutWakeup: post-build-variant-value=true, set at link in variant link-time / post-build in variant post-build / pre-compile in variant pre-compile  # If true, timer t1 shall be started instead of immediately calling FrIf_AllowColdstart in case of a startup without wakeup.
        float FrSMDurationT1: 0..INF, post-build-variant-value=true, set at link in variant link-time / post-build in variant post-build / pre-compile in variant pre-compile  # The duration of timer t1 in seconds. | A value of 0 shall imply that the timer is not used.
        float FrSMDurationT2: 0..INF, post-build-variant-value=true, set at link in variant link-time / post-build in variant post-build / pre-compile in variant pre-compile  # The duration of timer t2 in seconds. | A value of 0 shall imply that the timer is not used. The value of this parameter shall be larger than the value of FrSMDurationT1 parameter.
        float FrSMDurationT3: 0..INF, post-build-variant-value=true, set at link in variant link-time / post-build in variant post-build / pre-compile in variant pre-compile  # The duration of timer t3 in seconds. The value of this parameter shall be larger than the value of FrSMDurationT1 parameter. | A value of 0 shall imply that the timer is not used. It shall only be possible to configure a value 0 if no FrNm is used.
        float FrSMDurationT4: 0..INF, post-build-variant-value=true, set at link in variant link-time / post-build in variant post-build / pre-compile in variant pre-compile  # The timer t4 ensures that a dual channel node will eventually clear its coldstart inhibit bit and become a leading coldstarter.
        boolean FrSMIsColdstartEcu: post-build-variant-value=true, set at link in variant link-time / post-build in variant post-build / pre-compile in variant pre-compile  # True: The ECU is a coldstart node for this FlexRay cluster. | False: The ECU is no coldstart node for this FlexRay cluster.
        boolean FrSMIsWakeupEcu: post-build-variant-value=true, set at link in variant link-time / post-build in variant post-build / pre-compile in variant pre-compile  # True: FrSM shall perform a wakeup for this cluster. | False: FrSM shall never perform a wakeup for this FlexRay cluster.
        float FrSMMainFunctionCycleTime: 0..INF, set at link in variant link-time+post-build / pre-compile in variant pre-compile  # This parameter defines the cycle time in seconds of the periodic calling of FrSM main function.
        integer FrSMMinNumberOfColdstarter [0..1]: 0..255, multiplicity set at link in variant link-time / post-build in variant post-build / pre-compile in variant pre-compile, post-build-variant-multiplicity=true, post-build-variant-value=true, set at link in variant link-time / post-build in variant post-build / pre-compile in variant pre-compile  # This parameter defines the number of coldstarter that should not be underrun. If this parameter is not configured the mainfunction shall not check the number of startup frames.
        integer FrSMNumWakeupPatterns: 0..65535, post-build-variant-value=true, set at link in variant link-time / post-build in variant post-build / pre-compile in variant pre-compile  # Maximum number of Wakeup Patterns the node may send before going to FRSM_STARTUP.
        integer FrSMStartupRepetitions [0..1]: 0..65535, multiplicity set at link in variant link-time / post-build in variant post-build / pre-compile in variant pre-compile, post-build-variant-multiplicity=true, post-build-variant-value=true, set at link in variant link-time / post-build in variant post-build / pre-compile in variant pre-compile  # The number of times an ECU may repeat the startup procedure for a FlexRay cluster.
        integer FrSMStartupRepetitionsWithWakeup [0..1]: 0..65535, multiplicity set at link in variant link-time / post-build in variant post-build / pre-compile in variant pre-compile, post-build-variant-multiplicity=true, post-build-variant-value=true, set at link in variant link-time / post-build in variant post-build / pre-compile in variant pre-compile  # The number of times an ECU may repeat the startup procedure including a wakeup for a FlexRay cluster.
        float FrSMTrcvStdbyDelay [0..1]: 0..INF, multiplicity set at link in variant link-time / post-build in variant post-build / pre-compile in variant pre-compile, post-build-variant-multiplicity=true, post-build-variant-value=true, set at link in variant link-time / post-build in variant post-build / pre-compile in variant pre-compile  # The duration of timer t_TrcvStdbyDelay in seconds. The granularity of this parameter shall be restricted to full FlexRay cycles (FrIfGdCycle). | A value of 0 shall imply that the timer is not used.
        reference FrSMComMNetworkHandleRef: set at link in variant link-time+post-build / pre-compile in variant pre-compile, requires-symbolic-name-value=true, destination=ComMChannel  # Reference to the unique handle to identify one certain FlexRay network correspond to one of the network handles of the ComM configuration.
        reference FrSMFrIfClusterRef: post-build-variant-value=true, set at link in variant link-time+post-build / pre-compile in variant pre-compile, requires-symbolic-name-value=true, destination=FrIfCluster  # References the cluster configuration in the FlexRay Interface configuration. | Note that the assigned controllers and transceivers are defined in the FrIf configuration and can be accessed via this reference.
        container FrSMClusterDemEventParameterRefs [0..1]  # Container for the references to DemEventParameter elements which shall be invoked using the API Dem_SetEventStatus in case the corresponding error occurs. The EventId is taken from the referenced DemEventParameter's DemEventId symbolic value. The standardized errors are provided in this container and can be extended by vendor-specific error references.
          reference FRSM_E_CLUSTER_STARTUP: set at link in variant link-time+post-build / pre-compile in variant pre-compile, requires-symbolic-name-value=true, destination=DemEventParameter  # Reference to the DemEventParameter which shall be issued when the error "FRSM_E_CLUSTER_STARTUP" has occurred. If the reference is not configured the error shall be reported as DET error.
          reference FRSM_E_CLUSTER_SYNC_LOSS: set at link in variant link-time+post-build / pre-compile in variant pre-compile, requires-symbolic-name-value=true, destination=DemEventParameter  # Reference to the DemEventParameter which shall be issued when the error "FRSM_E_CLUSTER_SYNC_LOSS" has occurred. If the reference is not configured the error shall be reported as DET error.
