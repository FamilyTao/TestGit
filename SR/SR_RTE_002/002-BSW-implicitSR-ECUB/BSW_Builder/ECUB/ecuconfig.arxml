AUTOSAR XML (schema 4-2-2)
package /ECUB
  ecuc value collection ECUB: ecu-extract=system_0, ecuc-values=[EcuC, Can, CanIf, ComM, CanSM, Nm, CanNm, Com, BswM, Xfrm, PduR, Os, Rte]
  module config EcuC
    EcuCGeneral: ByteOrder=LITTLE_ENDIAN
    EcucConfigSet
      EcucPduCollection: PduIdTypeEnum=UINT8, PduLengthTypeEnum=UINT8
        Msg_StructA (Pdu): PduLength=8
        COM_Msg_StructA (Pdu): PduLength=8
    EcucPartitionCollection
  module config Can
    CanConfigSet
      CanController_0 (CanController):
        CanBusoffProcessing = 
        CanControllerActivation = false
        CanControllerBaseAddress = 
        CanControllerId = 
        CanRxProcessing = 
        CanTxProcessing = 
        CanWakeupFunctionalityAPI = false
        CanWakeupProcessing = 
        CanWakeupSupport = false
        CanControllerDefaultBaudrate = (unset)
        CanCpuClockRef = (unset)
        CanControllerBaudrateConfig_0 (CanControllerBaudrateConfig): CanControllerBaudRate=, CanControllerBaudRateConfigID=0, CanControllerPropSeg=, CanControllerSeg1=, CanControllerSeg2=, CanControllerSyncJumpWidth=
      CanHardwareObject_0 (CanHardwareObject): CanHandleType=, CanHwObjectCount=1, CanIdType=, CanObjectId=, CanObjectType=, CanControllerRef=(unset)
      CanChannel_0_ECUB (CanController):
        CanBusoffProcessing = 
        CanControllerActivation = false
        CanControllerBaseAddress = 
        CanControllerId = 0
        CanRxProcessing = 
        CanTxProcessing = 
        CanWakeupFunctionalityAPI = false
        CanWakeupProcessing = 
        CanWakeupSupport = false
        CanControllerDefaultBaudrate = CanChannel_0_ECUB/CanControllerBaudrateConfig_0
        CanCpuClockRef = (unset)
        CanControllerBaudrateConfig_0 (CanControllerBaudrateConfig): CanControllerBaudRate=, CanControllerBaudRateConfigID=0, CanControllerPropSeg=, CanControllerSeg1=, CanControllerSeg2=, CanControllerSyncJumpWidth=
      CanHardwareObject_Msg_StructA (CanHardwareObject): CanHandleType=, CanHwObjectCount=0, CanIdType=, CanObjectId=, CanObjectType=RECEIVE, CanControllerRef=(unset)
    Can (CanGeneral):
      CanDevErrorDetection = false
      CanIndex = 
      CanMainFunctionModePeriod = 
      CanMultiplexedTransmission = false
      CanPublicIcomSupport = false
      CanTimeoutDuration = 
      CanVersionInfoApi = false
      CanSupportTTCANRef = (unset)
  module config CanIf
    CanIfCtrlDrvCfg: CanIfCtrlDrvInitHohConfigRef=CanIfInitHohCfg, CanIfCtrlDrvNameRef=Can
      CanChannel_0_ECUB_conn (CanIfCtrlCfg): CanIfCtrlId=CANIF_CANDRV_0_CanChannel_0_ECUB_conn, CanIfCtrlWakeupSupport=true, CanIfCtrlCanCtrlRef=CanChannel_0_ECUB
    CanIfDispatchCfg:
      CanIfDispatchUserCtrlBusOffName = CanSM_ControllerBusOff
      CanIfDispatchUserCtrlBusOffUL = CAN_SM
      CanIfDispatchUserCtrlModeIndicationName = CanSM_ControllerModeIndication
      CanIfDispatchUserCtrlModeIndicationUL = CAN_SM
    CanIfInitCfg: CanIfInitCfgSet=CanIfInitCfgSet
      CanIfInitHohCfg
        HRH_Msg_StructA (CanIfHrhCfg): CanIfHrhSoftwareFilter=true, CanIfHrhCanCtrlIdRef=CanIfCtrlDrvCfg/CanChannel_0_ECUB_conn, CanIfHrhIdSymRef=CanHardwareObject_Msg_StructA
      RX_PDU_Msg_StructA (CanIfRxPduCfg):
        CanIfRxPduCanId = 770
        CanIfRxPduCanIdType = STANDARD_CAN
        CanIfRxPduDlc = 8
        CanIfRxPduId = CANIF_RXPDU_Msg_StructA
        CanIfRxPduReadData = false
        CanIfRxPduReadNotifyStatus = false
        CanIfRxPduUserRxIndicationName = PduR_CanIfRxIndication
        CanIfRxPduUserRxIndicationUL = PDUR
        CanIfRxPduHrhIdRef = HRH_Msg_StructA
        CanIfRxPduRef = Msg_StructA
    CanIfPrivateCfg: CanDriverAutosarVersion=AUTOSAR422, CanIfPrivateDlcCheck=true, CanIfPrivateSoftwareFilterType=LINEAR, CanIfSupportTTCAN=false
    CanIfPublicCfg:
      CanIfMetaDataSupport = false
      CanIfPublicCancelTransmitSupport = false
      CanIfPublicDevErrorDetect = false
      CanIfPublicHandleTypeEnum = UINT16
      CanIfPublicIcomSupport = false
      CanIfPublicMultipleDrvSupport = true
      CanIfPublicPnSupport = false
      CanIfPublicReadRxPduDataApi = false
      CanIfPublicReadRxPduNotifyStatusApi = false
      CanIfPublicReadTxPduNotifyStatusApi = false
      CanIfPublicSetDynamicTxIdApi = false
      CanIfPublicTxBuffering = false
      CanIfPublicTxConfirmPollingSupport = true
      CanIfPublicVersionInfoApi = true
      CanIfPublicWakeupCheckValidByNM = false
      CanIfPublicWakeupCheckValidSupport = false
      CanIfSetBaudrateApi = false
      CanIfTriggerTransmitSupport = false
      CanIfTxOfflineActiveSupport = false
      CanIfWakeupSupport = true
  module config ComM
    ComMGeneral:
      ComM0PncVectorAvoidance = false
      ComMDevErrorDetect = true
      ComMDirectUserMapping = false
      ComMEcuGroupClassification = 3
      ComMModeLimitationEnabled = true
      ComMPncGatewayEnabled = false
      ComMNmPassiveModeEnable = false
      ComMPncSupport = false
      ComMResetAfterForcingNoComm = true
      ComMSynchronizedPncShutdownEnabled = false
      ComMSynchronousWakeUp = true
      ComMTMinFullComModeDuration = 5
      ComMVersionInfoApi = true
      ComMWakeupInhibitionEnabled = false
      ComMPncPrepareSleepTimer = 0.025
    ComMConfigSet: ComMPncEnabled=false
      ComMChannel_0 (ComMChannel):
        ComMBusType = 
        ComMChannelId = ComMChannel_0
        ComMFullCommRequestNotificationEnabled = false
        ComMMainFunctionPeriod = 0.005
        ComMNoCom = false
        ComMNoWakeUpInhibitionNvmStorage = false
        ComMNoWakeup = false
        ComMNetworkManagement: ComMNmVariant=FULL, ComMPncNmRequest=false
      ComMUser_0 (ComMUser): ComMUserIdentifier=ComMUser_0, ComMUserModeNotification=false
      CanChannel_0_ECUB_conn (ComMChannel):
        ComMBusType = COMM_BUS_TYPE_CAN
        ComMChannelId = CanChannel_0_ECUB_conn
        ComMFullCommRequestNotificationEnabled = false
        ComMMainFunctionPeriod = 0.005
        ComMNoCom = false
        ComMNoWakeUpInhibitionNvmStorage = false
        ComMNoWakeup = false
        ComMNetworkManagement: ComMNmVariant=NONE, ComMPncNmRequest=false
        ComMUserPerChannel_CanChannel_0_ECUB_conn (ComMUserPerChannel): ComMUserChannel=ComMUser_CanChannel_0_ECUB_conn
      ComMUser_CanChannel_0_ECUB_conn (ComMUser): ComMUserIdentifier=ComMUser_CanChannel_0_ECUB_conn, ComMUserModeNotification=false
  module config CanSM
    CanSMGeneral:
      CanSMDevErrorDetect = true
      CanSMIcomSupport = false
      CanSMMainFunctionTimePeriod = 0.005
      CanSMPncSupport = false
      CanSMSetBaudrateApi = false
      CanSMTxOfflineActiveSupport = false
      CanSMVersionInfoApi = false
    CanSMConfiguration: CanSMModeRequestRepetitionMax=10, CanSMModeRequestRepetitionTime=0.1
      CanSM_CanChannel_0_ECUB_conn (CanSMManagerNetwork):
        CanSMBorCounterL1ToL2 = 32
        CanSMBorTimeL1 = 0.01
        CanSMBorTimeL2 = 60.0
        CanSMBorTimeTxEnsured = 1.0
        CanSMBorTxConfirmationPolling = false
        CanSMEnableBusOffDelay = false
        CanSMComMNetworkHandleRef = ComMConfigSet/CanChannel_0_ECUB_conn
        CanSM_Controller_CanChannel_0_ECUB_conn (CanSMController): CanSMControllerId=CanIfCtrlDrvCfg/CanChannel_0_ECUB_conn
  module config Nm
    NmGlobalConfig
      NmGlobalConstants: NmNumberOfChannels=0
      NmGlobalFeatures:
        NmBusSynchronizationEnabled = false
        NmCarWakeUpRxEnabled = false
        NmComControlEnabled = false
        NmComUserDataSupport = false
        NmCoordinatorSupportEnabled = false
        NmCoordinatorSyncSupport = false
        NmNodeDetectionEnabled = true
        NmNodeIdEnabled = true
        NmPassiveModeEnabled = false
        NmPduRxIndicationEnabled = false
        NmRemoteSleepIndEnabled = false
        NmRepeatMsgIndEnabled = false
        NmStateChangeIndEnabled = false
        NmUserDataEnabled = false
      NmGlobalProperties: NmCycletimeMainFunction=0, NmDevErrorDetect=true, NmVersionInfoApi=false
  module config CanNm
    CanNmGlobalConfig:
      CanNmGlobalPnSupport = false
      CanNmBusLoadReductionEnabled = false
      CanNmBusSynchronizationEnabled = false
      CanNmComControlEnabled = false
      CanNmComUserDataSupport = false
      CanNmCoordinatorSyncSupport = false
      CanNmDevErrorDetect = true
      CanNmImmediateRestartEnabled = false
      CanNmImmediateTxconfEnabled = false
      CanNmMainFunctionPeriod = 0.005
      CanNmNodeDetectionEnabled = false
      CanNmNodeIdEnabled = true
      CanNmPassiveModeEnabled = false
      CanNmPduRxIndicationEnabled = false
      CanNmRemoteSleepIndEnabled = false
      CanNmRepeatMsgIndEnabled = false
      CanNmStateChangeIndEnabled = false
      CanNmUserDataEnabled = false
      CanNmVersionInfoApi = false
      CanNmPnEiraCalcEnabled = false
      CanNmPnResetTime = 2.95
      CanNmChannelConfig_0 (CanNmChannelConfig):
        CanNmStayInPbsEnabled = false
        CanNmBusLoadReductionActive = false
        CanNmCarWakeUpRxEnabled = false
        CanNmImmediateNmTransmissions = 0
        CanNmMsgCycleOffset = 0
        CanNmMsgCycleTime = 0.001
        CanNmMsgReducedTime = 65
        CanNmNodeId = 0
        CanNmPduCbvPosition = CANNM_PDU_BYTE_1
        CanNmPduNidPosition = CANNM_PDU_BYTE_0
        CanNmRepeatMessageTime = 
        CanNmTimeoutTime = 
        CanNmWaitBusSleepTime = 
        CanNmComMNetworkHandleRef = (unset)
        CanNmRxPdu_0 (CanNmRxPdu): CanNmRxPduId=CANNM_RX_PDU_0, CanNmRxPduRef=(unset)
      CanNmPnInfo: CanNmPnInfoLength=0, CanNmPnInfoOffset=0
  module config Com
    ComGeneral:
      ComCancellationSupport = false
      ComConfigurationUseDet = true
      ComVersionInfoApi = false
      ComEnableMDTForCyclicTransmission = true
      ComEnableSignalGroupArrayApi = false
      ComMetaDataSupport = false
      ComRetryFailedTransmitRequests = false
      ComSupportedIPduGroups = 2
    ComConfig
      ComTimeBase: ComGwTimeBase=0.005, ComRxTimeBase=0.005, ComTxTimeBase=0.005
      IPDU_COM_Msg_StructA (ComIPdu):
        ComIPduCancellationSupport = false
        ComIPduDirection = RECEIVE
        ComIPduHandleId = COM_RXPDU_COM_Msg_StructA
        ComIPduSignalProcessing = DEFERRED
        ComIPduType = NORMAL
        ComPduIdRef = COM_Msg_StructA
        ComIPduSignalGroupRef = Group_StructA_Msg_StructA
        ComIPduGroupRef = Com_RxPduGroup_CONTROLLER_0
      Group_StructA_Msg_StructA (ComSignalGroup):
        ComHandleId = Group_StructA_Msg_StructA
        ComSignalGroupArrayAccess = false
        ComDataInvalidAction = NOTIFY
        ComInvalidNotification = NULL_PTR
        ComRxDataTimeoutAction = NONE
        ComInitialValueOnly = false
        ComTransferProperty = TRIGGERED
        ComNotification = Rte_COMCbk
        ComSystemTemplateSignalGroupRef = Group_StructA_Msg_StructA
        ArcSystemSignalGroupRef = Group_StructA_Msg_StructA
        4 x ComGroupSignal, all with ComSignalInitValue=0x0, ComSignalLength=0:
          Signal_DATA8_IPDU_COM_Msg_StructA: ComBitPosition=32, ComBitSize=8, ComHandleId=Group_StructA_Msg_StructA_Signal_DATA8_IPDU_COM_Msg_StructA, ComSignalEndianness=LITTLE_ENDIAN, ComSignalType=UINT8, ComSystemTemplateSystemSignalRef=Signal_DATA8_Msg_StructA, ArcSystemSignalRef=Signal_DATA8_Msg_StructA
          Signal_Counter_IPDU_COM_Msg_StructA: ComBitPosition=12, ComBitSize=4, ComHandleId=Group_StructA_Msg_StructA_Signal_Counter_IPDU_COM_Msg_StructA, ComSignalEndianness=BIG_ENDIAN, ComSignalType=UINT8, ComSystemTemplateSystemSignalRef=Signal_Counter_Msg_StructA, ArcSystemSignalRef=Signal_Counter_Msg_StructA
          Signal_CRC_IPDU_COM_Msg_StructA: ComBitPosition=0, ComBitSize=8, ComHandleId=Group_StructA_Msg_StructA_Signal_CRC_IPDU_COM_Msg_StructA, ComSignalEndianness=BIG_ENDIAN, ComSignalType=UINT8, ComSystemTemplateSystemSignalRef=Signal_CRC_Msg_StructA, ArcSystemSignalRef=Signal_CRC_Msg_StructA
          Signal_DATA16_IPDU_COM_Msg_StructA: ComBitPosition=24, ComBitSize=16, ComHandleId=Group_StructA_Msg_StructA_Signal_DATA16_IPDU_COM_Msg_StructA, ComSignalEndianness=BIG_ENDIAN, ComSignalType=UINT16, ComSystemTemplateSystemSignalRef=Signal_DATA16_Msg_StructA, ArcSystemSignalRef=Signal_DATA16_Msg_StructA
      Com_RxPduGroup_CONTROLLER_0 (ComIPduGroup): ComIPduGroupHandleId=Com_RxPduGroup_CONTROLLER_0
      Com_TxPduGroup_CONTROLLER_0 (ComIPduGroup): ComIPduGroupHandleId=Com_TxPduGroup_CONTROLLER_0
  module config BswM
    BswMGeneral:
      BswMCanSMEnabled = false
      BswMCanSMIcomEnabled = false
      BswMComMEnabled = false
      BswMComMPncEnabled = false
      BswMDcmEnabled = false
      BswMDevErrorDetect = false
      BswMEcuMEnabled = false
      BswMEthIfEnabled = false
      BswMEthSMEnabled = false
      BswMFrSMEnabled = false
      BswMGenericRequestEnabled = false
      BswMJ1939DcmEnabled = false
      BswMJ1939NmEnabled = false
      BswMLinSMEnabled = false
      BswMLinTPEnabled = false
      BswMNmEnabled = false
      BswMNvMEnabled = false
      BswMSchMEnabled = false
      BswMSdEnabled = false
      BswMVersionInfoApi = false
      BswMWdgMEnabled = false
      BswMTimerEnabled = false
    BswMConfig
      BswMArbitration
      BswMModeControl
  module config Xfrm
  module config PduR
    PduRGeneral: PduRConfigType=PC_CONFIG, PduRDevErrorDetect=true, PduRMetaDataSupport=false, PduRVersionInfoApi=false, PduRZeroCostOperation=false
    PduRRoutingTables: PduRConfigurationId=0, PduRMaxRoutingPathCnt=20, PduRMaxRoutingPathGroupCnt=0, PduRMaxRoutingTableCnt=1
      PduRRoutingTable
        PDUR_ROUTING_Msg_StructA (PduRRoutingPath): PduRRouteType=IF
          PduRDestPdu_0 (PduRDestPdu):
            PduRDestPduDataProvision = PDUR_DIRECT
            PduRDestPduHandleId = PDUR_DESTPDU_COM_Msg_StructA
            PduRTransmissionConfirmation = true
            PduRDestPduRef = COM_Msg_StructA
          PduRSrcPdu_0 (PduRSrcPdu): PduRSourcePduHandleId=PDUR_SRCPDU_Msg_StructA, PduRSrcPduUpTxConf=true, PduRSrcPduRef=Msg_StructA
    PduRBswModules_COM (PduRBswModules):
      PduRCancelReceive = false
      PduRCancelTransmit = false
      PduRChangeParameterApi = false
      PduRCommunicationInterface = true
      PduRCopyRxData = true
      PduRCopyTxData = true
      PduRLowerModule = false
      PduRRetransmission = true
      PduRRxIndication = true
      PduRStartOfReception = true
      PduRTpRxIndication = true
      PduRTpTransmit = true
      PduRTpTxConfirmation = true
      PduRTransmit = true
      PduRTransportProtocol = true
      PduRTriggertransmit = false
      PduRTxConfirmation = true
      PduRUpperModule = true
      PduRUseTag = true
      PduRBswModuleRef = Com
    PduRBswModules_CANIF (PduRBswModules):
      PduRCancelReceive = false
      PduRCancelTransmit = false
      PduRChangeParameterApi = false
      PduRCommunicationInterface = true
      PduRCopyRxData = false
      PduRCopyTxData = false
      PduRLowerModule = true
      PduRRetransmission = false
      PduRRxIndication = true
      PduRStartOfReception = false
      PduRTpRxIndication = false
      PduRTpTransmit = false
      PduRTpTxConfirmation = false
      PduRTransmit = true
      PduRTransportProtocol = false
      PduRTriggertransmit = false
      PduRTxConfirmation = true
      PduRUpperModule = false
      PduRUseTag = true
      PduRBswModuleRef = CanIf
  module config Os
    OsOS:
      OsNumberOfCores = 1
      OsScalabilityClass = SC1
      OsSystemStackSize = 1024
      OsStackMonitoring = false
      OsStatus = STANDARD
      OsUseGetServiceId = false
      OsUseParameterAccess = false
      OsUseResScheduler = true
      OsHooks: OsErrorHook=false, OsPostTaskHook=false, OsPreTaskHook=false, OsShutdownHook=false, OsStartupHook=false
    OSDEFAULTAPPMODE (OsAppMode)
    OsTask_10ms (OsTask): OsTaskActivation=1, OsTaskPriority=1, OsTaskSchedule=, OsTaskStackSize=100
    OsAlarm_10ms (OsAlarm): OsAlarmCounterRef=(unset)
      OsAlarmAction
        OsAlarmActivateTask: OsAlarmActivateTaskRef=OsTask_10ms
  module config Rte
    RteGeneration:
      RteBypassSupport = NONE
      RteCalibrationSupport = NONE
      RteCodeVendorId = 
      RteDevErrorDetect = false
      RteDevErrorDetectUninit = false
      RteGenerationMode = COMPATIBILITY_MODE
      RteInExclusiveAreaCheckEnabled = true
      RteIocInteractionReturnValue = RTE_IOC
      RteMeasurementSupport = false
      RteOptimizationMode = RUNTIME
      RteValueRangeCheckEnabled = false
      RteVfbTraceEnabled = false
      ArcGenerateWeakRunnableStubs = false
      ArcCalibrationFlashStartAddress = 
      RteVfbTrace = 
    RteInitializationBehavior: RteInitializationStrategy=, RteSectionInitializationPolicy=
    RteOsInteraction
    RteBswGeneral: RteSchMVersionInfoApi=false, RteUseComShadowSignalApi=false
    Cpt_Obs1B_PrototypeInstance (RteSwComponentInstance): ArcGenerationEnabled=true, RteSoftwareComponentInstanceRef=Cpt_Obs1B_Prototype, RteImplementationRef=swcImplementation_CptObs1B
      timingEvent_10_Runnable_Obs1B_RunnableMapping (RteEventToTaskMapping): RteImmediateRestart=false, RtePositionInTask=0, RteEventRef=timingEvent_10, RteMappedToTaskRef=OsTask_10ms
