AUTOSAR XML (schema 4-2-2)
package /AUTOSAR/System
  system system_0
    system mapping SystemMapping_0: sender-receiver-to-signal-group-mapping{data-element=BottomComposition.Cpt_Obs1B_Prototype.rootSwCompositionPrototype_0.RpStruct.dataElementsStructA, signal-group=Group_StructA_Msg_StructA, type-mapping=sender-rec-record-type-mapping=record-element-mappings=[{implementation-record-element=Crc_Uint8, system-signal=Signal_DATA8_Msg_StructA}, {implementation-record-element=Data_Uint16, system-signal=Signal_Counter_Msg_StructA}, {implementation-record-element=Counter_Uint8, system-signal=Signal_CRC_Msg_StructA}, {implementation-record-element=Data_Uint8, system-signal=Signal_DATA16_Msg_StructA}]}
      sw-impl-mappings:
        swc to impl mapping CptReceiverPrototypeImplMapping: component-implementation=swcImplementation_CptObs, component=rootSwCompositionPrototype_0.BottomComposition.Cpt_Obs1A_Prototype.Cpt_Obs1A_Prototype
        swc to impl mapping CptSenderPrototypeImplMapping: component-implementation=swcImplementation_CptCtrl, component=rootSwCompositionPrototype_0.BottomComposition.Cpt_Ctrl1A_Prototype.Cpt_Ctrl1A_Prototype
        swc to impl mapping CptObs1PrototypeImplMapping: component-implementation=swcImplementation_CptObs1B, component=rootSwCompositionPrototype_0.BottomComposition.Cpt_Obs1B_Prototype.Cpt_Obs1B_Prototype
      sw-mappings:
        swc to ecu mapping ECUA_SwcToEcuMapping: ecu-instance=ECUA
          component:
            rootSwCompositionPrototype_0.BottomComposition.Cpt_Obs1A_Prototype.Cpt_Obs1A_Prototype
            rootSwCompositionPrototype_0.BottomComposition.Cpt_Ctrl1A_Prototype.Cpt_Ctrl1A_Prototype
        swc to ecu mapping ECUB_SwcToEcuMapping: component=rootSwCompositionPrototype_0.BottomComposition.Cpt_Obs1A_Prototype.Cpt_Obs1A_Prototype
        swc to ecu mapping ECUB_SwcToEcuMapping: component=rootSwCompositionPrototype_0.BottomComposition.Cpt_Obs1B_Prototype.Cpt_Obs1B_Prototype, ecu-instance=ECUB
    root-software-compositions:
      root sw composition prototype rootSwCompositionPrototype_0: software-composition=TopComposition
package /AUTOSAR/Compositions
  composition sw component type BottomComposition
    component Cpt_Obs1A_Prototype: type=Cpt_Obs1A
    component Cpt_Ctrl1A_Prototype: type=Cpt_Ctrl1A
    component Cpt_Obs1B_Prototype: type=Cpt_Obs1B
    connect Cpt_Ctrl1A_Prototype.PpComplexData -> Cpt_Obs1A_Prototype.RpData
    connect Cpt_Ctrl1A_Prototype.PpStructA -> Cpt_Obs1B_Prototype.RpStruct
    connect Cpt_Ctrl1A_Prototype.PpStructA -> Cpt_Obs1A_Prototype.RpStruct
  composition sw component type TopComposition
    component BottomComposition: type=BottomComposition
package /AUTOSAR/SwcImplementations
  swc implementation swcImplementation_CptCtrl: behavior=IbCtrl
  swc implementation swcImplementation_CptObs: behavior=IbObs
  swc implementation swcImplementation_CptObs1B: behavior=IbObs1B
