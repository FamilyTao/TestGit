AUTOSAR XML (schema 4-2-2)
package /AUTOSAR/Interfaces
  sender receiver interface Explicit_SrIF
    data structDE: type=StructA
