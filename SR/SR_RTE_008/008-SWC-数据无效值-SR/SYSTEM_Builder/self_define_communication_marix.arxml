AUTOSAR XML (schema 4-2-2)
package /SystemInfo/CanClusters
  can cluster CanCluster_0: protocol-name=CAN
    can physical channel CanChannel_0: comm-connectors=[CanChannel_0_ECUA_conn, CanChannel_0_ECUB_conn]
      frame MsgStructA: id 0x302, from ECUA, to ECUB, frame-length=8, can-addressing-mode=STANDARD
        pdu MsgStructA: length=8, transmission-mode-conditions=[SignalData8_MsgStructA, SignalData16_MsgStructA, SignalCounter4_MsgStructA, SignalCrc8_MsgStructA], transmission-mode-true-timing=cyclic-timing=time-period=0.1
          signal SignalData8_MsgStructA: start 32, 8 bit, little-endian, base-type=sint8, update-indication-bit-position=-1, to ECUB
          signal SignalData16_MsgStructA: start 24, 16 bit, big-endian, base-type=uint16, update-indication-bit-position=-1, to ECUB
          signal SignalCounter4_MsgStructA: start 12, 4 bit, big-endian, base-type=uint8, update-indication-bit-position=-1, to ECUB
          signal SignalCrc8_MsgStructA: start 0, 8 bit, big-endian, base-type=uint8, update-indication-bit-position=-1, to ECUB
          mapping SignalGroupStructA36_MsgStructA: i-signal-group=SignalGroupStructA36_MsgStructA, update-indication-bit-position=-1
package /SystemInfo/ISignals
  i signal group SignalGroupStructA36_MsgStructA: i-signal=[SignalData8_MsgStructA, SignalCounter4_MsgStructA, SignalCrc8_MsgStructA, SignalData16_MsgStructA], system-signal-group=SignalGroupStructA36_MsgStructA
package /SystemInfo/UnitPackage
  unit NoUnit
package /SystemInfo/EcuInstances
  ecu instance ECUA: com-configuration-gw-time-base=0.005, com-configuration-rx-time-base=0.005, com-configuration-tx-time-base=0.005, sleep-mode-supported=false, wake-up-over-bus-supported=false
    can communication controller CanChannel_0_ECUA: wake-up-by-controller-supported=false, can-controller-attributes=can-controller-configuration={sync-jump-width=0, time-seg-1=20, time-seg-2=10}
    can communication connector CanChannel_0_ECUA_conn: comm-controller=CanChannel_0_ECUA
  ecu instance ECUB: com-configuration-gw-time-base=0.005, com-configuration-rx-time-base=0.005, com-configuration-tx-time-base=0.005, sleep-mode-supported=false, wake-up-over-bus-supported=false
    can communication controller CanChannel_0_ECUB: wake-up-by-controller-supported=false, can-controller-attributes=can-controller-configuration={sync-jump-width=0, time-seg-1=20, time-seg-2=10}
    can communication connector CanChannel_0_ECUB_conn: comm-controller=CanChannel_0_ECUB
