AUTOSAR XML (schema 4-2-2)
package /AUTOSAR
  module definition IoHwAb [0..1]: variants pre-compile/link-time/post-build  # Configuration if IO Hardware Abstraction
    container IoHwAbGeneral
      boolean IoHwAbUseDioDev: default-value=false  # Switch used to enable or disable I/O hardware abstraction for DIO component.
      boolean IoHwAbUseAdcDev: default-value=false  # Switch used to enable or disable I/O hardware abstraction for ADC component.
      boolean IoHwAbUsePwmDev: default-value=false  # Switch used to enable or disable I/O hardware abstraction for PWM component.
      boolean IoHwAbUseIcuDev: default-value=false  # Switch used to enable or disable I/O hardware abstraction for ICU component.
      boolean IoHwAbUseOcuDev: default-value=false  # Switch used to enable or disable I/O hardware abstraction for OCU component.
      boolean IoHwAbUseSpiDev: default-value=false  # Switch used to enable or disable I/O hardware abstraction for SPI component.
      boolean IoHwAbUseGptDev: default-value=false  # Switch used to enable or disable I/O hardware abstraction for GPT component.
      boolean IoHwAbUseExtDev: default-value=false  # Switch used to enable or disable I/O hardware abstraction for CDD(Extern Device)component.
      boolean IoHwAbVersionInfoApi: default-value=false  # Switch used to enable or disable API of read software version information.
      boolean IoHwAbDevErrorDetect: default-value=true  # Switch used to enable or disable API of report development error.
      boolean IoHwAb_CfgUseServiceComponent: default-value=false  # Switch used to enables or disallows API of create I/O hardware abstraction service.
      enumeration McuPlatformAdaptationType: {UNKNOWN, TRICORE_TC3XX, ARM_S32K14X, ARM_S32K324, RES_RH850, RES_RL78, SEM_G9X, SEM_E3110}, set at link in variant link-time+post-build / pre-compile in variant pre-compile, default-value=UNKNOWN  # Switch used to adapt the specified processor platform from the drop - down dialog box.
      container AdcConfig: multiplicity set at link in variant link-time / post-build in variant post-build / pre-compile in variant pre-compile, post-build-variant-multiplicity=true
        boolean AdcGrpNotifCapablity: default-value=false  # Switch used to allow or disallow access Interrupt notification of ADC component by IoHwAb.
      container PwmConfig: multiplicity set at link in variant link-time / post-build in variant post-build / pre-compile in variant pre-compile, post-build-variant-multiplicity=true
        boolean PWMEnableNotification: default-value=false  # Switch used to allow access enable Interrupt notification of PWM component by IoHwAb.
        boolean PWMDisableNotification: default-value=false  # Switch used to disallow access disable Interrupt notification of PWM component by IoHwAb.
        boolean PWMSetOutPutToIdle: default-value=false  # Switch used to disallow access set output is idle of PWM component by IoHwAb.
        boolean PWMGetOutPutState: default-value=false  # Switch used to disallow access get output state of PWM component by IoHwAb.
        boolean PWMSetDutycycle: default-value=false  # Switch used to disallow access set duty cycle of PWM component by IoHwAb.
        boolean PWMGetPeriodAndDuty: default-value=false  # Switch used to disallow access set period and duty cycle of PWM component by IoHwAb.
    container IoHwAbConfigSet
      container IoHwAb_AnalogGroupDescriptor [0..*]: multiplicity set at link in variant link-time / post-build in variant post-build / pre-compile in variant pre-compile, post-build-variant-multiplicity=true  # Used to I/O hardware abstract configuration container in ADC component.
        string IoHwAb_SignalChannelKind: set at pre-compile, symbolic-name-value=true, default-value=IOHWAB_ANALOG_INPUT_SIGNAL  # Used to configure the signal type of the given signal description channel in the ADC component.
        string IoHwAb_AdcGroupTriggSrc: set at pre-compile, symbolic-name-value=true  # Used to configure the trigger source type of the given scan group in the ADC component.
        string IoHwAb_AdcGroupConversionMode: set at pre-compile, symbolic-name-value=true  # Used to configure the conversion type of the given scan group in the ADC component.
        enumeration AdcConvResultHandlingMode: {INTERRUPT, DMA, POLLING}, set at link in variant link-time+post-build / pre-compile in variant pre-compile, default-value=POLLING  # Used to configure the conversion result handling mode of the given scan group in the ADC component.
        integer IoHwAb_AdcEstimatedConvTime [0..1]: 0..4294967295, set at pre-compile, default-value=0  # Used to configure the conversion estimated threshold value of the given scan group in the ADC component.
        reference IoHwAb_AdcGroupId: destination=AdcGroup  # Used to configure the associated identifier of the given scan group in the ADC component.
        reference IoHwAb_AdcChannelId: destination=AdcChannel  # Used to configure the associated identifier of the given the signal description channel in the ADC component.
      container IoHwAb_IcuChannelDescriptor [0..*]: multiplicity set at link in variant link-time / post-build in variant post-build / pre-compile in variant pre-compile, post-build-variant-multiplicity=true  # Used to I/O hardware abstract configuration container in ICU component.
        string IoHwAb_SignalChannelKind: set at pre-compile, symbolic-name-value=true, default-value=IOHWAB_INPUT_CAPTURE_SIGNAL  # Used to configure the signal type of the given channel in the ICU component.
        integer IoHwAb_InputCaptureSamplingFrequency: 0..65535, set at pre-compile, default-value=0  # Used to configure the sampling frequency of the given signal description channel in the ICU component.
        string IoHwAb_MeasurementMode  # Used to configure the measurement mode of the given signal description channel in the ICU component.
        string IoHwAb_DefaultStartEdge  # Used to configure the default start edge of the given signal description channel in the ICU component.
        reference IoHwAb_InputCaptureChannel: destination=IcuChannel  # Used to configure the associated identifier of the given signal description channel in the ICU component.
      container IoHwAb_DioChannelDescriptor [0..*]: multiplicity set at link in variant link-time / post-build in variant post-build / pre-compile in variant pre-compile, post-build-variant-multiplicity=true  # Used to I/O hardware abstract configuration container in DIO component.
        string IoHwAb_SignalChannelKind: set at pre-compile, symbolic-name-value=true, default-value=IOHWAB_DIGITAL_INOUT_SIGNAL  # Used to configure the signal type of the given channel in the DIO component.
        enumeration IoHwAb_PinControlDirection: {IOHWAB_INPUT, IOHWAB_OUTPUT}  # Used to configure the PIN control direction of the given signal description channel in the DIO component.
        enumeration IoHwAb_DefaultLevelOutput: {IOHWAB_LOW, IOHWAB_HIGH}  # Used to configure the default level output of the given signal description channel in the DIO component.
        integer IoHwAb_DioGroupOffsetPosition: 0..255, set at pre-compile, default-value=0  # Used to configure the group offset position of the given signal description channel in the DIO component.
        integer IoHwAb_DioChannelGroupPositionMask: 0..255, set at pre-compile, default-value=0  # Used to configure the group-channel position mask of the given signal description channel in the DIO component.
        reference IoHwAb_DigitalChannelGroupPortId: destination=DioPort  # Used to configure the associated port identifier of the given channel group in the DIO component.
        reference IoHwAb_DigitalInputOutputChannel: destination=DioChannel  # Used to configure the associated identifier of the given the signal description channel in the DIO component.
      container IoHwAb_PwmChannelDescriptor [0..*]: multiplicity set at link in variant link-time / post-build in variant post-build / pre-compile in variant pre-compile, post-build-variant-multiplicity=true  # Used to I/O hardware abstract configuration container in PWM component.
        string IoHwAb_SignalChannelKind: set at pre-compile, symbolic-name-value=true, default-value=IOHWAB_PWM_OUTPUT_SIGNAL  # Used to configure the signal type of the given channel in the PWM component.
        string IoHwAb_PwmOutputPeriodPolicy  # Used to configure the output period policy of the given signal description channel in the PWM component.
        enumeration IoHwAb_PwmOutputEdgeNotify: {PWM_NONE_EDGE, PWM_RISING_EDGE, PWM_FALLING_EDGE, PWM_BOTH_EDGE}  # Used to configure the output edge notify of the given signal description channel in the PWM component.
        reference IoHwAb_PwmChannel: destination=PwmChannel  # Used to configure the associated identifier of the given the signal description channel in the PWM component.
