AUTOSAR XML (schema 4-2-2)
package /AUTOSAR
  module definition EthSwt [0..*]: post-build-variant-support=true, variants link-time/post-build/pre-compile  # Configuration of the EthSwt (Ethernet Switch Driver) module.
    container EthSwtConfig: multiplicity set at link in variant link-time / post-build in variant post-build / pre-compile in variant pre-compile, post-build-variant-multiplicity=true  # Configuration of one Ethernet Switch.
      float EthSwtArlTableEntryTimeout [0..1]: 1..65535, multiplicity set at pre-compile, set at pre-compile, default-value=300  # If present, this parameter specifies the timeout in seconds for removing unused entries from the ARL table of the Ethernet switch. Otherwise, entries are not removed automatically.
      container EthSwtDemEventParameterRefs [0..0]: multiplicity set at pre-compile, post-build-variant-multiplicity=true  # Container for the references to DemEventParameter elements which shall be invoked using the API Dem_SetEventStatus in case the corresponding error occurs. The EventId is taken from the referenced DemEventParameter's DemEventId symbolic value. The standardized errors are provided in this container and can be extended by vendor-specific error references.
        reference ETHSWT_E_ACCESS [0..1]: multiplicity set at link in variant link-time / post-build in variant post-build / pre-compile in variant pre-compile, post-build-variant-multiplicity=true, post-build-variant-value=true, set at link in variant link-time / post-build in variant post-build / pre-compile in variant pre-compile, requires-symbolic-name-value=true, destination=DemEventParameter  # Reference to the DemEventParameter which shall be issued when the error "Ethernet Switch Access Failure" has occurred.
        reference ETHSWT_E_SYNCPORT2PHY [0..1]: multiplicity set at link in variant link-time / post-build in variant post-build / pre-compile in variant pre-compile, post-build-variant-multiplicity=true, post-build-variant-value=true, set at link in variant link-time / post-build in variant post-build / pre-compile in variant pre-compile, requires-symbolic-name-value=true, destination=DemEventParameter  # Reference to the DemEventParameter which shall be issued when the error "Ethernet switch port and the referenced Ethernet transceiver are in contradicting modes" has occurred.
      container EthSwtNvm [0..1]: multiplicity set at pre-compile, post-build-variant-multiplicity=true  # Configuration of one Ethernet Switch Nvm usage in case the module requires non volatile memory in the Ecu to store switch configuration.
        reference EthSwtConfigurationNvmBlockDescriptorRef: set at pre-compile, requires-symbolic-name-value=true, destination=NvMBlockDescriptor  # Reference to the Nvm block description in the Nvm module configuration to store e.g. the port mirror configurations
        reference EthSwtTableNvmBlockDescriptorRef: scope=ECU, post-build-variant-value=true, set at pre-compile, requires-symbolic-name-value=true, destination=NvMBlockDescriptor  # Reference to the Nvm block description in the Nvm module configuration to store e.g. the learned ARL table
      container EthSwtPort [1..*]: multiplicity set at link in variant link-time / post-build in variant post-build / pre-compile in variant pre-compile, post-build-variant-multiplicity=true  # Configuration of one Ethernet Switch Port.
        integer EthSwtPortIdx: 0..8, scope=ECU, set at pre-compile, symbolic-name-value=true, default-value=0  # Specifies the instance ID of the configured Ethernet Switch Port.
        enumeration EthSwtPortMacLayerSpeed [0..1]: {ETH_MAC_LAYER_SPEED_100M, ETH_MAC_LAYER_SPEED_10G, ETH_MAC_LAYER_SPEED_10M, ETH_MAC_LAYER_SPEED_1G, ETH_MAC_LAYER_SPEED_2500M}, scope=ECU, multiplicity set at link in variant link-time+post-build / pre-compile in variant pre-compile, post-build-variant-multiplicity=true, post-build-variant-value=true, set at link in variant link-time+post-build / pre-compile in variant pre-compile  # Defines the baud rate of the MAC layer.
        enumeration EthSwtPortMacLayerSubType [0..1]: {REDUCED, REVERSED, SERIAL, STANDARD, UNIVERSAL_SERIAL}, scope=ECU, multiplicity set at link in variant link-time+post-build / pre-compile in variant pre-compile, post-build-variant-multiplicity=true, post-build-variant-value=true, set at link in variant link-time+post-build / pre-compile in variant pre-compile  # Defines the MAC layer subtype of this EthSwtPort.
        enumeration EthSwtPortMacLayerType [0..1]: {ETHSWT_PORT_MAC_LAYER_TYPE_XGMII, ETHSWT_PORT_MAC_LAYER_TYPE_XMII, ETHSWT_PORT_MAC_LAYER_TYPE_XXGMII}, scope=ECU, multiplicity set at link in variant link-time+post-build / pre-compile in variant pre-compile, post-build-variant-multiplicity=true, post-build-variant-value=true, set at link in variant link-time+post-build / pre-compile in variant pre-compile  # Defines the MAC layer type of this EthSwtPort.
        enumeration EthSwtPortPhysicalLayerType [0..1]: {ETHSWT_PORT_1000BASE_T, ETHSWT_PORT_1000BASE_T1, ETHSWT_PORT_100BASE_T1, ETHSWT_PORT_100BASE_TX}, scope=ECU, multiplicity set at link in variant link-time+post-build / pre-compile in variant pre-compile, post-build-variant-multiplicity=true, post-build-variant-value=true, set at link in variant link-time+post-build / pre-compile in variant pre-compile  # Defines the physical layer type of this EthSwtPort.
        string EthSwtPortPredefinedMacAddresses [0..*]: multiplicity set at link in variant link-time / post-build in variant post-build / pre-compile in variant pre-compile, post-build-variant-multiplicity=true, post-build-variant-value=true, set at link in variant link-time / post-build in variant post-build / pre-compile in variant pre-compile, regular-expression=[0-9a-fA-F]{2}[[:-][0-9a-fA-F]{2}]{5}  # Specifies a list of 48-bit physical addresses (MAC addresses) which can be reached via this port in network byte order. | Note that further addresses can be learned during runtime.
        enumeration EthSwtPortRole [0..1]: {ETHSWT_HOST_PORT, ETHSWT_UP_LINK_PORT}, multiplicity set at link in variant link-time / post-build in variant post-build / pre-compile in variant pre-compile, post-build-variant-multiplicity=true, post-build-variant-value=true, set at link in variant link-time / post-build in variant post-build / pre-compile in variant pre-compile  # Set a special role of the Ethernet switch port. It is either a host port or a up link port. If not configured it is a standard port.
        boolean EthSwtPortTimeStampSupport: post-build-variant-value=true, set at link in variant link-time / post-build in variant post-build / pre-compile in variant pre-compile  # Enables/Disables the Switch-port specific timestamping.
        reference EthSwtPortTrcvRef [0..1]: scope=ECU, multiplicity set at link in variant link-time+post-build / pre-compile in variant pre-compile, post-build-variant-multiplicity=true, post-build-variant-value=true, set at link in variant link-time / post-build in variant post-build / pre-compile in variant pre-compile, requires-symbolic-name-value=true, destination=EthTrcvConfig  # Reference to the Ethernet transceiver driver this EthSwtPort is connected with.
        container EthSwtPortEgress [0..0]  # Configuration of one Ethernet Switch Port Egress behavior.
          reference EthSwtPortEgressLastSchedulerRef: post-build-variant-value=true, set at link in variant link-time / post-build in variant post-build / pre-compile in variant pre-compile, destination=EthSwtPortScheduler  # Reference to the port scheduler which is the last in the egress port structure.
          container EthSwtPortFifo [1..*]: multiplicity set at link in variant link-time / post-build in variant post-build / pre-compile in variant pre-compile, post-build-variant-multiplicity=true  # Represents a Fifo in the egress port.
            integer EthSwtPortEgressFifoIdx: 0..18446744073709551615, scope=ECU, post-build-variant-value=true, set at pre-compile  # Specifies the instance ID of the fifo of the configured Ethernet switch egress port
            integer EthSwtPortFifoMinimumLength [0..1]: 0..18446744073709551615, scope=ECU, multiplicity set at link in variant link-time / post-build in variant post-build / pre-compile in variant pre-compile, post-build-variant-multiplicity=true, post-build-variant-value=true, set at link in variant link-time / post-build in variant post-build / pre-compile in variant pre-compile  # FIFO minimum length in Byte. This assignment is used to configure a guaranteed size of a configured FIFO.
            integer EthSwtPortFifoTrafficClassAssignment [0..8]: 0..7, scope=ECU, post-build-variant-value=true, set at link in variant link-time / post-build in variant post-build / pre-compile in variant pre-compile  # Defines which traffic classes are assigned to this Fifo.
          container EthSwtPortScheduler [1..*]: multiplicity set at link in variant link-time / post-build in variant post-build / pre-compile in variant pre-compile, post-build-variant-multiplicity=true  # Represents a Scheduler in the egress port.
            enumeration EthSwtPortSchedulerAlgorithm: {ETHSWT_SCHEDULER_DEFICIT_ROUND_ROBIN, ETHSWT_SCHEDULER_STRICT_PRIORITY, ETHSWT_SCHEDULER_WEIGHTED_ROUND_ROBIN}, post-build-variant-value=true, set at link in variant link-time / post-build in variant post-build / pre-compile in variant pre-compile  # Defines the scheduler algorithm.
            container EthSwtPortSchedulerPredecessor [1..*]: multiplicity set at link in variant link-time / post-build in variant post-build / pre-compile in variant pre-compile, post-build-variant-multiplicity=true  # Defines an ordered list of predecessors for this scheduler.
              integer EthSwtPortSchedulerPredecessorOrder: 0..18446744073709551615, scope=ECU, post-build-variant-value=true, set at link in variant link-time / post-build in variant post-build / pre-compile in variant pre-compile  # Defines the order of the scheduler predecessors. | This value has to be understood as a relative value, i.e. the value shows only the relative ordering of the elements. The highest value has the highest priority and gaps are allowed (not dense based). The values need to be unique within one EthSwtPortScheduler.
              choice reference EthSwtPortEgressPredecessorRef: post-build-variant-value=true, set at link in variant link-time / post-build in variant post-build / pre-compile in variant pre-compile, destination=[EthSwtPortFifo, EthSwtPortScheduler, EthSwtPortShaper]  # Choice reference to the scheduler predecessor.
          container EthSwtPortShaper [0..*]: multiplicity set at link in variant link-time / post-build in variant post-build / pre-compile in variant pre-compile, post-build-variant-multiplicity=true  # Represents a Shaper in the egress port.
            integer EthSwtPortShaperIdleSlope [0..1]: 0..18446744073709551615, post-build-variant-value=true, set at link in variant link-time / post-build in variant post-build / pre-compile in variant pre-compile  # Defines the increase of credit in bits per second for the AVB shaper.
            reference EthSwtPortEgressPredecessorFifoRef: post-build-variant-value=true, set at link in variant link-time / post-build in variant post-build / pre-compile in variant pre-compile, destination=EthSwtPortFifo  # Reference to the fifo which is the predecessor for this shaper.
        container EthSwtPortIngress  # Configuration of one Ethernet Switch Port ingress behavior.
          integer EthSwtPortIngressDefaultPriority [0..1]: 0..7, multiplicity set at link in variant link-time / post-build in variant post-build / pre-compile in variant pre-compile, post-build-variant-multiplicity=true, post-build-variant-value=true, set at link in variant link-time / post-build in variant post-build / pre-compile in variant pre-compile, default-value=0  # Default priority for ingress.
          integer EthSwtPortIngressDefaultVlan [0..1]: 0..4094, multiplicity set at link in variant link-time / post-build in variant post-build / pre-compile in variant pre-compile, post-build-variant-multiplicity=true, post-build-variant-value=true, set at link in variant link-time / post-build in variant post-build / pre-compile in variant pre-compile, default-value=1  # Default VLAN for ingress.
          boolean EthSwtPortIngressDropUntagged: post-build-variant-value=true, set at link in variant link-time / post-build in variant post-build / pre-compile in variant pre-compile, default-value=false  # Defines the ingress behavior for untagged frames.
          integer EthSwtPortIngressVlanModification [0..1]: 0..4095, scope=ECU, multiplicity set at link in variant link-time / post-build in variant post-build / pre-compile in variant pre-compile, post-build-variant-multiplicity=true, post-build-variant-value=true, set at link in variant link-time / post-build in variant post-build / pre-compile in variant pre-compile  # If this parameter is defined all messages which arrive at this ingress port will be tagged with this VLAN Id. This tagging happen also if the arriving message already has a VLAN Id, it will be overwritten by the defined one. | If this parameter is not defined no changes to the VLAN Id shall happen at this ingress port.
          integer EthSwtPortTrafficClassAssignment [0..1]: 0..7, scope=ECU, multiplicity set at link in variant link-time / post-build in variant post-build / pre-compile in variant pre-compile, post-build-variant-multiplicity=true, post-build-variant-value=true, set at link in variant link-time / post-build in variant post-build / pre-compile in variant pre-compile  # If this parameter is defined all arriving messages at this ingress port shall be assigned this traffic class. | If this parameter is not defined no general port based traffic class assignment is done.
          container EthSwtPortPolicer [0..0]: multiplicity set at link in variant link-time / post-build in variant post-build / pre-compile in variant pre-compile, post-build-variant-multiplicity=true  # Definition of Rate Policing parameters.
            integer EthSwtPortRatePolicedByteCount: 1..18446744073709551615, post-build-variant-value=true, set at link in variant link-time / post-build in variant post-build / pre-compile in variant pre-compile  # Amount of Byte Counts (excluding Header information) which can be received in a configured EthSwtPortRatePolicedTimeInterval.
            integer EthSwtPortRatePolicedPriority [0..1]: 0..7, multiplicity set at link in variant link-time / post-build in variant post-build / pre-compile in variant pre-compile, post-build-variant-multiplicity=true, post-build-variant-value=true, set at link in variant link-time / post-build in variant post-build / pre-compile in variant pre-compile  # Defines the priority which this rate policy shall be limited on. If no priority is given this rate policy is not considering priority.
            float EthSwtPortRatePolicedTimeInterval: 0..INF, post-build-variant-value=true, set at link in variant link-time / post-build in variant post-build / pre-compile in variant pre-compile  # Time interval in seconds where a configured EthSwtPortRatePolicedByteCount can be received without a rate limitation.
            enumeration EthSwtPortRateViolationAction: {BLOCK_SOURCE, DROP_FRAME}, post-build-variant-value=true, set at link in variant link-time / post-build in variant post-build / pre-compile in variant pre-compile  # Action to be taken when the rate policy criteria defined for this EthSwtPortPolicer are met.
            reference EthSwtPortRateVlanMembershipRef [0..4095]: multiplicity set at link in variant link-time / post-build in variant post-build / pre-compile in variant pre-compile, post-build-variant-multiplicity=true, post-build-variant-value=true, set at link in variant link-time / post-build in variant post-build / pre-compile in variant pre-compile, destination=EthSwtPortVlanMembership  # References the Vlans this rate policy shall apply to. | If no EthSwtPortRateVlanMembershipRef is configured the rate policing applies only on the configured EthSwtPortRatePolicedPriority.
          container EthSwtPriorityRegeneration [0..0]: multiplicity set at link in variant link-time / post-build in variant post-build / pre-compile in variant pre-compile, post-build-variant-multiplicity=true  # Defines a priority regeneration where the EthSwtPriorityRegenerationIngressPriority is replaced by EthSwtPriorityRegenerationRegeneratedPriority. | The EthSwtPriorityRegeneration is optional in case no priority regeneration shall be performed. In case a EthSwtPriorityRegeneration is defined it shall have 8 mappings, one for each priority.
            integer EthSwtPriorityRegenerationIngressPriority: 0..7, scope=ECU, post-build-variant-value=true, set at link in variant link-time / post-build in variant post-build / pre-compile in variant pre-compile  # Message priority of the incoming message.
            integer EthSwtPriorityRegenerationRegeneratedPriority: 0..7, scope=ECU, post-build-variant-value=true, set at link in variant link-time / post-build in variant post-build / pre-compile in variant pre-compile  # Message priority the incoming message will be tagged with.
          container EthSwtPriorityTrafficClassAssignment [0..0]: multiplicity set at link in variant link-time / post-build in variant post-build / pre-compile in variant pre-compile, post-build-variant-multiplicity=true  # Defines a priority based traffic class assignment. All messages with a specific priority (EthSwtPriorityTrafficClassAssignmentPriority) arriving at this ingress port or, if enabled regenerated priorities (EthSwtPriorityRegeneration), shall be assigned to a traffic class (EthSwtPriorityTrafficClassAssignmentTrafficClass).
            integer EthSwtPriorityTrafficClassAssignmentPriority: 0..7, scope=ECU, post-build-variant-value=true, set at link in variant link-time / post-build in variant post-build / pre-compile in variant pre-compile  # Message priority.
            integer EthSwtPriorityTrafficClassAssignmentTrafficClass: 0..7, scope=ECU, post-build-variant-value=true, set at link in variant link-time / post-build in variant post-build / pre-compile in variant pre-compile  # Traffic Class value.
        container EthSwtPortVlanMembership [0..4095]: multiplicity set at link in variant link-time / post-build in variant post-build / pre-compile in variant pre-compile, post-build-variant-multiplicity=true  # Description Determines the membership of this port to the virtual network, i.e. frames with this VID can be received and transmitted via this port.
          integer EthSwtPortVlanDefaultPriority: 0..7, scope=ECU, post-build-variant-value=true, set at link in variant link-time / post-build in variant post-build / pre-compile in variant pre-compile  # Determines the standard output-priority outgoing messages will be tagged with.
          enumeration EthSwtPortVlanForwardingType: {ETHSWT_NOT_SENT, ETHSWT_SENT_TAGGED, ETHSWT_SENT_UNTAGGED}, scope=ECU, post-build-variant-value=true, set at link in variant link-time / post-build in variant post-build / pre-compile in variant pre-compile  # Defines how the message with a specific VLAN Id shall be handled.
          integer EthSwtPortVlanMembershipId: 0..4094, scope=ECU, post-build-variant-value=true, set at link in variant link-time / post-build in variant post-build / pre-compile in variant pre-compile  # Determines the VID of the virtual network this port belongs to.
      container EthSwtSpi [0..0]: multiplicity set at pre-compile, post-build-variant-multiplicity=true  # Configuration of one Ethernet Switch SPI access (if SPI is used).
        container EthSwtSpiSequence [1..*]: multiplicity set at pre-compile, post-build-variant-multiplicity=true  # Container gives EthSwt driver information about one SPI sequence. | One SPI sequence used by EthSwt driver is in exclusive use for it. No other driver is allowed to access this sequence. EthSwt driver may use one sequence to access n EthSwt hardware chips of the same type or n sequences are used to access one single EthSwt hardware chip. If a EthSwt hardware has no SPI interface, there is no instance of this container.
          boolean EthSwtSpiAccessSynchronous [0..1]: scope=ECU, multiplicity set at pre-compile, post-build-variant-multiplicity=true, post-build-variant-value=true, set at pre-compile  # This parameter is used to define whether the access to the Spi sequence is synchronous or asynchronous. | true: SPI access is synchronous. false: SPI access is asynchronous.
          reference EthSwtSpiSequenceName [0..*]: scope=ECU, multiplicity set at pre-compile, post-build-variant-multiplicity=true, post-build-variant-value=true, set at pre-compile, requires-symbolic-name-value=true, destination=SpiSequence  # Reference to a Spi sequence configuration container.
    container EthSwtGeneral  # General configuration of Ethernet Switch Driver module.
      integer EthSwtIndex: 0..255, set at pre-compile, default-value=0  # Specifies the InstanceId of this module instance. If only one instance is present it shall have the Id 0.
      boolean EthSwtCheckWakeupApi: set at pre-compile  # Enables / Disables EthSwt_CheckWakeup API. Tags: atp.Status=draft
      boolean EthSwtDeletePortMirrorConfigurationApi: set at pre-compile  # Enables / Disables EthSwt_DeletePortMirrorConfiguration API
      boolean EthSwtDevErrorDetect: set at pre-compile, default-value=true  # Switches the development error detection and notification on or off. | * true: detection and notification is enabled. * false: detection and notification is disabled.
      boolean EthSwtEnableCableDiagnosticApi: set at pre-compile  # Enable/disable the APIs for cable diagnostic: EthSwt_RunPortCableDiagnostic, EthSwt_GetPortCableDiagnosticsResult
      boolean EthSwtEnableVlanApi: set at pre-compile  # Enables / Disables EthSwt_EnableVLAN API.
      boolean EthSwtGetArlTableApi: set at pre-compile  # Enables / Disables EthSwt_GetArlTable API.
      boolean EthSwtGetBaudRateApi: set at pre-compile  # Enables / Disables EthSwt_GetBaudRate API
      function name EthSwtGetCfgDataRawDone [0..1]: multiplicity set at pre-compile, set at pre-compile  # Defines the function name for <GetCfgDataRawDone>
      boolean EthSwtGetCfgRaw: set at pre-compile  # Disable /Enable support of reading raw data from switch memory
      boolean EthSwtGetCounterValuesApi: set at pre-compile  # Enables / Disables EthSwt_GetCounterValues API
      boolean EthSwtGetDuplexModeApi: set at pre-compile  # Enables / Disables EthSwt_GetDuplexMode API
      boolean EthSwtGetLinkStateApi: set at pre-compile  # Enables / Disables EthSwt_GetLinkState API
      boolean EthSwtGetMacLearningModeApi: set at pre-compile  # Enables / Disables EthSwt_GetMacLearningMode API.
      boolean EthSwtGetMaxFIFOBufferFillLevelApi: set at pre-compile  # Enables / Disables EthSwt_GetMaxFIFOBufferFillLevel API.
      boolean EthSwtGetPortCableDiagnosticsResultApi: set at pre-compile  # Enables / Disables EthSwt_GetPortCableDiagnosticsResult API
      boolean EthSwtGetPortIdentifierApi: set at pre-compile  # Enables / Disables EthSwt_GetPortIdentifier API
      boolean EthSwtGetPortMacAddrApi: set at pre-compile  # Enables / Disables EthSwt_GetPortMacAddr API.
      boolean EthSwtGetPortMirrorStateApi: set at pre-compile  # Enables / Disables EthSwt_GetPortMirrorState API
      boolean EthSwtGetPortSignalQualityApi: set at pre-compile  # Enables / Disables EthSwt_GetPortSignalQuality API
      boolean EthSwtGetRxStatsApi: set at pre-compile  # Enables / Disables EthSwt_GetRxStats API.
      boolean EthSwtGetSwitchIdentifierApi: set at pre-compile  # Enables / Disables EthSwt_GetSwitchIdentifier API
      boolean EthSwtGetSwitchPortModeApi: set at pre-compile  # Enables / Disables EthSwt_GetSwitchPortMode API
      boolean EthSwtGetSwitchPortWakeupReasonApi: set at pre-compile  # Enables / Disables EthSwt_GetSwitchPortWakeupReason API. Tags: atp.Status=draft
      boolean EthSwtGetSwitchRegApi: set at pre-compile  # Enables / Disables EthSwt_GetSwitchReg API.
      boolean EthSwtGetTxErrorCounterValuesApi: set at pre-compile, default-value=false  # Enables/Disables Eth_GetTxErrorCounterValues API.
      boolean EthSwtGetTxStatsApi: set at pre-compile, default-value=false  # Enables/Disables Eth_GetTxStats API.
      boolean EthSwtGlobalTimeSupportApi: set at pre-compile  # Enables/Disables the Global Time APIs used amongst others by Global Time Synchronization over Ethernet.
      function name EthSwtLinkDownCallout [0..1]: multiplicity set at pre-compile, set at pre-compile  # Defines the function name for the <EthSwtLinkDownCallout> callout.
      function name EthSwtLinkUpCallout [0..1]: multiplicity set at pre-compile, set at pre-compile  # Defines the function name for the <EthSwtLinkUpCallout> callout.
      boolean EthSwtLowPowerModeSupport: multiplicity set at pre-compile, set at pre-compile, default-value=false  # Disable / Enable support of low power mode.
      float EthSwtMainFunctionPeriod: 0.001..INF, set at pre-compile  # The cycle time of the periodic main function of EthSwt. Defined in seconds .
      boolean EthSwtManagementSupportApi: set at pre-compile  # Enables/Disables the Switch management APIs to support a Switch-port specific communication attribute access.
      float EthSwtMgmtInfoIndicationTimeout: 0..INF, set at pre-compile  # This parameter specifies the timeout while the Switch driver is waiting for management information out of the Switch for reception. | The value 0 deactivates the timeout supervision. Unit: seconds
      boolean EthSwtPersistentConfigurationResult: set at pre-compile  # Enables / Disables the callback API <User>_PersistentConfigurationResult.
      function name EthSwtPersistentConfigurationResultCallback [0..1]: multiplicity set at pre-compile, set at pre-compile  # Defines the function name for <EthSwtPersistentConfigurationResultCallback>.
      string EthSwtPublicCddHeaderFile [0..*]: multiplicity set at pre-compile, set at pre-compile, max-length=32, min-length=1  # Defines header files for callback functions which shall be included in case of CDDs.
      boolean EthSwtReadPortMirrorConfigurationApi: set at pre-compile  # Enables / Disables EthSwt_ReadPortMirrorConfiguration API
      boolean EthSwtReadTrcvRegisterApi: set at pre-compile  # Enables / Disables EthSwt_ReadTrcvRegister API.
      boolean EthSwtResetConfigurationApi: set at pre-compile  # Enables / Disables EthSwt_ResetConfiguration API.
      boolean EthSwtSetForwardingModeApi: set at pre-compile, default-value=false  # Enables /disables EthSwt_SetForwardingMode API.
      boolean EthSwtSetMacLearningModeApi: set at pre-compile  # Enables / Disables EthSwt_SetMacLearningMode API.
      boolean EthSwtSetPortLoopbackModeApi: set at pre-compile  # Enables / Disables EthSwt_SetPortLoopbackModeApi API
      boolean EthSwtSetPortMirrorStateApi: set at pre-compile  # Enables / Disables EthSwt_SetPortMirrorState API
      boolean EthSwtSetPortTestModeApi: set at pre-compile  # Enables / Disables EthSwt_SetPortTestMode API
      boolean EthSwtSetPortTxModeApi: set at pre-compile  # Enables / Disables EthSwt_SetPortTxModeApi API
      boolean EthSwtSetSwitchPortModeApi: set at pre-compile  # Enables / Disables EthSwt_SetSwitchPortMode API
      boolean EthSwtSetSwitchRegApi: set at pre-compile  # Enables / Disables EthSwt_SetSwitchReg API.
      boolean EthSwtStartSwitchPortAutoNegotiationApi: set at pre-compile  # Enables / Disables EthSwt_StartSwitchPortAutoNegotiation API
      boolean EthSwtStoreConfigurationApi: set at pre-compile  # Enables / Disables EthSwt_StoreConfiguration API.
      boolean EthSwtVerifyConfigApi: set at pre-compile, default-value=false  # Enables /disables EthSwt_VerifyConfig API.
      boolean EthSwtVersionInfoApi: set at pre-compile, default-value=false  # Enables / Disables version info API.
      boolean EthSwtWritePortMirrorConfigurationApi: set at pre-compile  # Enables / Disables EthSwt_WritePortMirrorConfiguration API
      boolean EthSwtWriteTrcvRegisterApi: set at pre-compile  # Enables / Disables EthSwt_WriteTrcvRegister API.
      reference EthSwtEcucPartitionRef [0..*]: scope=ECU, multiplicity set at pre-compile, post-build-variant-multiplicity=true, post-build-variant-value=true, set at pre-compile, destination=EcucPartition  # Maps the Ethernet switch driver to zero or multiple ECUC partitions to make the modules API available in this partition. The Ethernet switch driver will operate as an independent instance in each of the partitions.
