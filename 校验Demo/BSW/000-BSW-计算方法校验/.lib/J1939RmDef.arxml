AUTOSAR XML (schema 4-2-2)
package /AUTOSAR
  module definition J1939Rm [0..1]: post-build-variant-support=true, variants link-time/post-build/pre-compile  # Configuration of the J1939 Request Manager.
    container J1939RmGeneral  # Contains the general configuration parameters of the module.
      boolean J1939RmDevErrorDetect: set at pre-compile, default-value=true  # Switches the Default Error Tracer (Det) detection and notification ON or OFF. | * true: enabled (ON). * false: disabled (OFF).
      float J1939RmMainFunctionPeriod: 0..Inf, scope=ECU, set at link in variant link-time+post-build / pre-compile in variant pre-compile, default-value=0.01  # Execution cycle of J1939Rm_MainFunction in seconds.
      boolean J1939RmSupportAckIndication: set at pre-compile  # Pre-processor switch for enabling support of acknowledgement indications.
      boolean J1939RmSupportAckTransmission: set at pre-compile  # Pre-processor switch for enabling support of acknowledgement transmission.
      boolean J1939RmSupportRequest2: set at pre-compile  # Pre-processor switch for enabling support of the Request2 PG. | Please note: Transfer is not supported.
      boolean J1939RmSupportRequestIndication: set at pre-compile  # Pre-processor switch for enabling support of request indications.
      boolean J1939RmSupportRequestTransmission: set at pre-compile  # Pre-processor switch for enabling support of request transmission.
      boolean J1939RmSupportTimeoutSupervision: set at pre-compile  # Pre-processor switch for enabling support of request timeout supervision.
      float J1939RmTxConfirmationTimeout: 0..65.535, set at link in variant link-time+post-build / pre-compile in variant pre-compile  # Time in seconds to wait for a confirmation after transmission of a message. The behaviour when the time elapses depends on the transmitted message.
      boolean J1939RmVersionInfoApi: set at pre-compile  # Pre-processor switch for enabling version info API support.
    container J1939RmConfigSet  # This container contains the configuration parameters and sub containers of the AUTOSAR J1939Rm module.
      container J1939RmChannel [1..*]: multiplicity set at link in variant link-time / post-build in variant post-build / pre-compile in variant pre-compile, post-build-variant-multiplicity=true  # Contains the parameters for a CAN channel supported by the J1939 Request Manager.
        integer J1939RmAckQueueSize: 0..255, set at link in variant link-time+post-build / pre-compile in variant pre-compile, default-value=1  # Number of transmitted acknowledgements that can be stored.
        integer J1939RmRequestQueue2Size: 0..255, set at link in variant link-time+post-build / pre-compile in variant pre-compile, default-value=1  # Number of transmitted Request2 messages that can be stored.
        integer J1939RmRequestQueueSize: 0..255, set at link in variant link-time+post-build / pre-compile in variant pre-compile, default-value=1  # Number of transmitted requests that can be stored.
        integer J1939RmRequestTimeoutMonitors: 0..255, set at link in variant link-time+post-build / pre-compile in variant pre-compile, default-value=1  # Number of transmitted requests that can be monitored for timeout.
        symbolic name reference J1939RmComMNetworkHandleRef: set at link in variant link-time+post-build / pre-compile in variant pre-compile, destination=ComMChannel  # Reference to the channel defined by the ComMChannel providing access to the unique channel index ComMChannelId.
        container J1939RmAckmRxPdu [0..1]  # Contains the configuration of the I-PDU used to receive the Acknowledgement PG.
          string J1939RmAckmRxPduId: scope=ECU, set at pre-compile, symbolic-name-value=true  # The I-PDU identifier used for RxIndication from PduR.
          reference J1939RmAckmRxPduRef: set at link in variant link-time+post-build / pre-compile in variant pre-compile, destination=Pdu  # Reference to the Pdu object representing the I-PDU.
        container J1939RmAckmTxPdu [0..1]  # Contains the configuration of the I-PDU used to transmit the Acknowledgement PG.
          string J1939RmAckmTxPduId: scope=ECU, set at pre-compile, symbolic-name-value=true  # The I-PDU identifier used for TxConfirmation from PduR.
          reference J1939RmAckmTxPduRef: set at link in variant link-time+post-build / pre-compile in variant pre-compile, destination=Pdu  # Reference to the Pdu object representing the I-PDU.
        container J1939RmRqstRxPdu [0..1]  # Contains the configuration of the I-PDU used to receive the Request PG.
          string J1939RmRqstRxPduId: scope=ECU, set at pre-compile, symbolic-name-value=true  # The I-PDU identifier used for RxIndication from PduR.
          reference J1939RmRqstRxPduRef: set at link in variant link-time+post-build / pre-compile in variant pre-compile, destination=Pdu  # Reference to the Pdu object representing the I-PDU.
        container J1939RmRqstTxPdu [0..1]  # Contains the configuration of the I-PDU used to transmit the Request PG.
          string J1939RmRqstTxPduId: scope=ECU, set at pre-compile, symbolic-name-value=true  # The I-PDU identifier used for TxConfirmation from PduR.
          reference J1939RmRqstTxPduRef: set at link in variant link-time+post-build / pre-compile in variant pre-compile, destination=Pdu  # Reference to the Pdu object representing the I-PDU.
        container J1939RmRqst2RxPdu [0..1]  # Contains the configuration of the I-PDU used to receive the Request2 PG. This PDU consumes a meta data item of type CAN_ID_32.
          string J1939RmRqst2RxPduId: scope=ECU, set at pre-compile, symbolic-name-value=true  # The I-PDU identifier used for RxIndication from PduR.
          reference J1939RmRqst2RxPduRef: set at link in variant link-time+post-build / pre-compile in variant pre-compile, destination=Pdu  # Reference to the Pdu object representing the I-PDU.
        container J1939RmRqst2TxPdu [0..1]  # Contains the configuration of the I-PDU used to transmit the Request2 PG. This PDU produces a meta data item of type CAN_ID_32.
          string J1939RmRqst2TxPduId: scope=ECU, set at pre-compile, symbolic-name-value=true  # The I-PDU identifier used for TxConfirmation from PduR.
          reference J1939RmRqst2TxPduRef: set at link in variant link-time+post-build / pre-compile in variant pre-compile, destination=Pdu  # Reference to the Pdu object representing the I-PDU.
      container J1939RmNode [1..*]: multiplicity set at link in variant link-time / post-build in variant post-build / pre-compile in variant pre-compile, post-build-variant-multiplicity=true  # Contains the parameters for the support of a logical J1939 node (identified by an ECU address).
        symbolic name reference J1939RmNmNodeRef: set at link in variant link-time+post-build / pre-compile in variant pre-compile, destination=J1939NmNode  # Reference to the corresponding J1939Nm node.
        reference J1939RmNodeChannelRef [1..*]: multiplicity set at link in variant link-time+post-build / pre-compile in variant pre-compile, set at link in variant link-time+post-build / pre-compile in variant pre-compile, destination=J1939RmChannel  # Reference to the channels this node has access to.
        container J1939RmUser [1..*]: multiplicity set at link in variant link-time / post-build in variant post-build / pre-compile in variant pre-compile, post-build-variant-multiplicity=true  # Contains the configuration of a module that uses the request and acknowledgement interfaces of J1939Rm.
          boolean J1939RmUserAckIndication: set at pre-compile  # Enable AckIndication for this module. In case of CDD, the name is <apiServicePrefix>_AckIndication. In case of RTE, the operation AckIndication of the required port J1939Rm_AckIndication_{user} is called. | This parameter shall not be set for J1939RmUserType J1939RM_USER_J1939NM, J1939RM_USER_J1939DCM, or J1939RM_USER_COM.
          integer J1939RmUserId: 0..65535, scope=ECU, multiplicity set at pre-compile, set at pre-compile, symbolic-name-value=true  # Identifier used by a module using J1939Rm. This parameter is only required when the module uses transmission of requests or acknowledgements.
          boolean J1939RmUserRequestIndication: set at pre-compile  # Enable RequestIndication for this module. In case of J1939Nm or J1939Dcm, the name is fixed. In case of CDD, the name is <apiServicePrefix>_RequestIndication. In case of RTE, J1939Rm will call the operation RequestIndication of the required port J1939Rm_RequestIndication_{user}. | This parameter shall not be set for J1939RmUserType J1939RM_USER_COM.
          boolean J1939RmUserSendAck: set at pre-compile  # Enable the SendAck API for this module. In case of RTE, the operation SendAck of the provided port J1939Rm_SendAck_{user} is called. | This parameter shall not be set for J1939RmUserType J1939RM_USER_J1939NM or J1939RM_USER_COM.
          boolean J1939RmUserSendRequest: set at pre-compile  # Enable the SendRequest API for this module. In case of RTE, the operation SendRequest of the provided port J1939Rm_SendRequest_{user} is called. | This parameter shall not be set for J1939RmUserType J1939RM_USER_J1939NM, J1939RM_USER_J1939DCM, or J1939RM_USER_COM.
          boolean J1939RmUserTimeoutSupervision: set at pre-compile  # Enable RequestTimeoutIndication and CancelRequestTimeout for this module. | RequestTimeoutIndication: In case of CDD, the name is <apiServicePrefix>_RequestTimeoutIndication. In case of RTE, the operation RequestTimeoutIndication of the required port J1939Rm_RequestTimeoutIndication_{user} is called. CancelRequestTimeout: In case of RTE, the operation CancelRequestTimeout of the provided port J1939Rm_CancelRequestTimeout_{user} is called. This parameter shall not be set for J1939RmUserType J1939RM_USER_J1939NM, J1939RM_USER_J1939DCM, or J1939RM_USER_COM.
          enumeration J1939RmUserType: {J1939RM_USER_CDD, J1939RM_USER_COM, J1939RM_USER_J1939DCM, J1939RM_USER_J1939NM, J1939RM_USER_RTE}, set at pre-compile  # Type of module using J1939Rm.
          integer J1939RmUserAckPGN [0..*]: 0..262143, multiplicity set at link in variant link-time / post-build in variant post-build / pre-compile in variant pre-compile, post-build-variant-multiplicity=true, post-build-variant-value=true, set at link in variant link-time / post-build in variant post-build / pre-compile in variant pre-compile  # PGN supported to be acknowledged to this module. The PGNs supported by different modules should usually be disjunctive. | This parameter shall not be set for J1939RmUserType J1939RM_USER_J1939NM, J1939RM_USER_J1939DCM, and J1939RM_USER_COM.
          integer J1939RmUserPGN [0..*]: 0..262143, multiplicity set at link in variant link-time / post-build in variant post-build / pre-compile in variant pre-compile, post-build-variant-multiplicity=true, post-build-variant-value=true, set at link in variant link-time / post-build in variant post-build / pre-compile in variant pre-compile  # PGN supported to be requested from this module. The PGNs supported by different modules should usually be disjunctive. | This parameter is predefined to AC (0x0EE00) for J1939RmUserType J1939RM_USER_J1939NM and is derived from the J1939Dcm PDUs in the system description for J1939RmUserType J1939RM_USER_J1939DCM. It shall not be set for J1939RmUserType J1939RM_USER_COM.
          foreign reference J1939RmUserCddRef [0..1]: multiplicity set at pre-compile, set at pre-compile, destination-type=ECUC-MODULE-CONFIGURATION-VALUES  # Reference to the CDD module description. | This parameter is only required for J1939RmUserType J1939RM_USER_CDD.
          container J1939RmComIPdu [0..*]: multiplicity set at link in variant link-time / post-build in variant post-build / pre-compile in variant pre-compile, post-build-variant-multiplicity=true  # Contains the configuration of an I-PDU that is to be transmitted on request by COM. This configuration container is only relevant for J1939RmUserType J1939RM_USER_COM.
            integer J1939RmComIPduPGN: 0..262143, post-build-variant-value=true, set at link in variant link-time / post-build in variant post-build / pre-compile in variant pre-compile  # PGN of the COM I-PDU.
            integer J1939RmComIPduExtId1: 0..255, post-build-variant-value=true, set at link in variant link-time / post-build in variant post-build / pre-compile in variant pre-compile, default-value=0xFF  # First extended identifier byte of the COM I-PDU.
            integer J1939RmComIPduExtId2: 0..255, post-build-variant-value=true, set at link in variant link-time / post-build in variant post-build / pre-compile in variant pre-compile, default-value=0xFF  # Second extended identifier byte of the COM I-PDU.
            integer J1939RmComIPduExtId3: 0..255, post-build-variant-value=true, set at link in variant link-time / post-build in variant post-build / pre-compile in variant pre-compile, default-value=0xFF  # Third extended identifier byte of the COM I-PDU.
            reference J1939RmComIPduRef: set at link in variant link-time+post-build / pre-compile in variant pre-compile, destination=Pdu  # Reference to the Pdu object representing the I-PDU.
