AUTOSAR XML (schema 4-2-2)
package /AUTOSAR
  module definition J1939Dcm [0..1]: post-build-variant-support=true, variants link-time/post-build/pre-compile  # The SAE J1939 Dcm module
    container J1939DcmGeneral  # Contains the general configuration parameters of the module.
      integer J1939DcmCommonBufferSize: 0..65535, set at pre-compile, default-value=1  # Size of common buffer (in Bytes). The buffer size should be as large as the longest command or response message.
      boolean J1939DcmDevErrorDetect: set at pre-compile, default-value=true  # Switches the Default Error Tracer (Det) detection and notification ON or OFF. | * true: enabled (ON). * false: disabled (OFF).
      integer J1939DcmDM01BufferSize [0..1]: 0..65535, multiplicity set at pre-compile, set at pre-compile, default-value=0  # Size of DM01 buffer (in Bytes). The buffer size should be as large as the longest DM01 response message.
      integer J1939DcmDM01MaxDTCs: 1..255, multiplicity set at pre-compile, set at pre-compile, default-value=20  # Configuration value of limitation of maximum DTCs to be reported in the DM01 message.
      float J1939DcmMainFunctionPeriod: 0..Inf, scope=ECU, set at link in variant link-time+post-build / pre-compile in variant pre-compile, default-value=0.01  # Call cycle in seconds of J1939Dcm_MainFunction.
      integer J1939DcmMaxDTCsPerMainFunction [0..1]: 1..255, multiplicity set at pre-compile, set at pre-compile, default-value=1  # Maximum threshold of DTCs filtered in a single MainFunction cycle.
      integer J1939DcmMaxFreezeFramesPerMainFunction [0..1]: 1..255, multiplicity set at pre-compile, set at pre-compile, default-value=1  # Maximum threshold of FreezeFrames filtered in a single MainFunction cycle.
      integer J1939DcmMaxRatiosPerMainFunction [0..1]: 1..255, multiplicity set at pre-compile, set at pre-compile, default-value=1  # Maximum threshold of Ratios filtered in a single MainFunction cycle.
      boolean J1939DcmVersionInfoApi: set at pre-compile  # Pre-processor switch for enabling version info API support.
    container J1939DcmConfigSet  # This container contains the configuration parameters and sub containers of the AUTOSAR J1939Dcm module.
      container J1939DcmChannel [1..*]  # Contains the J1939DcmChannel parameters.
        enumeration J1939DcmBusType: {J1939DCM_ISO9141, J1939DCM_J1587, J1939DCM_J1850, J1939DCM_J1922, J1939DCM_J1939_NETWORK_1, J1939DCM_J1939_NETWORK_2, J1939DCM_J1939_NETWORK_3, J1939DCM_J1939_NETWORK_4, J1939DCM_OTHER, J1939DCM_PROPRIETARY_NETWORK_1, J1939DCM_PROPRIETARY_NETWORK_2}, set at pre-compile  # Identifies the communication port
        reference J1939DcmComMChannelRef: scope=ECU, post-build-variant-value=true, set at link in variant link-time / post-build in variant post-build / pre-compile in variant pre-compile, destination=ComMChannel  # Reference to the ComMChannel.
      container J1939DcmNode [1..*]  # Contains the parameters for the support of a logical J1939 node.
        reference J1939DcmNmNodeRef: set at link in variant link-time+post-build / pre-compile in variant pre-compile, destination=J1939NmNode  # Reference to the corresponding J1939Nm node.
        reference J1939DcmNodeRmUserRef: post-build-variant-value=true, set at link in variant link-time / post-build in variant post-build / pre-compile in variant pre-compile, destination=J1939RmUser  # Reference to the J1939RmUser used by J1939Dcm.
        integer J1939DcmSPNsInDataStream [0..*]: 0..524287, multiplicity set at pre-compile, set at pre-compile  # Defines the SPNs available in data stream for use in DM24.
        container J1939DcmDiagnosticMessageSupport [1..*]  # Contains parameters to configure the diagnostic message support
          enumeration J1939DcmDmxSupport: {J1939DCM_DM01_SUPPORT, J1939DCM_DM02_SUPPORT, J1939DCM_DM03_SUPPORT, J1939DCM_DM04_SUPPORT, J1939DCM_DM05_SUPPORT, J1939DCM_DM06_SUPPORT, J1939DCM_DM07_SUPPORT, J1939DCM_DM08_SUPPORT, J1939DCM_DM09_SUPPORT, J1939DCM_DM10_SUPPORT, J1939DCM_DM11_SUPPORT, J1939DCM_DM12_SUPPORT, J1939DCM_DM13_SUPPORT, J1939DCM_DM14_SUPPORT, J1939DCM_DM15_SUPPORT, J1939DCM_DM16_SUPPORT, J1939DCM_DM17_SUPPORT, J1939DCM_DM18_SUPPORT, J1939DCM_DM19_SUPPORT, J1939DCM_DM20_SUPPORT, J1939DCM_DM21_SUPPORT, J1939DCM_DM22_SUPPORT, J1939DCM_DM23_SUPPORT, J1939DCM_DM24_SUPPORT, J1939DCM_DM25_SUPPORT, J1939DCM_DM26_SUPPORT, J1939DCM_DM27_SUPPORT, J1939DCM_DM28_SUPPORT, J1939DCM_DM29_SUPPORT, J1939DCM_DM30_SUPPORT, J1939DCM_DM31_SUPPORT, J1939DCM_DM32_SUPPORT, J1939DCM_DM33_SUPPORT, J1939DCM_DM34_SUPPORT, J1939DCM_DM35_SUPPORT, J1939DCM_DM36_SUPPORT, J1939DCM_DM37_SUPPORT, J1939DCM_DM38_SUPPORT, J1939DCM_DM39_SUPPORT, J1939DCM_DM40_SUPPORT, J1939DCM_DM41_SUPPORT, J1939DCM_DM42_SUPPORT, J1939DCM_DM43_SUPPORT, J1939DCM_DM44_SUPPORT, J1939DCM_DM45_SUPPORT, J1939DCM_DM46_SUPPORT, J1939DCM_DM47_SUPPORT, J1939DCM_DM48_SUPPORT, J1939DCM_DM49_SUPPORT, J1939DCM_DM50_SUPPORT, J1939DCM_DM51_SUPPORT, J1939DCM_DM52_SUPPORT, J1939DCM_DM53_SUPPORT, J1939DCM_DM54_SUPPORT, J1939DCM_DM55_SUPPORT, J1939DCM_DM56_SUPPORT, J1939DCM_DM57_SUPPORT}, set at pre-compile  # This parameter is used to identify the actual DMx message.
          reference J1939DcmDiagnosticMessageSupportChannelRef: set at link in variant link-time+post-build / pre-compile in variant pre-compile, destination=J1939DcmChannel  # Reference to J1939DcmChannel for which this diagnostic message is supported.
          container J1939DcmRxPdu [0..1]  # Contains parameters to configure the J1939DcmRxPdu.
            string J1939DcmRxPduId: scope=ECU, set at pre-compile, symbolic-name-value=true  # The I-PDU identifier used for communication with PduR.
            reference J1939DcmRxPduRef: post-build-variant-value=true, set at link in variant link-time / post-build in variant post-build / pre-compile in variant pre-compile, destination=Pdu  # Reference to the global Pdu element in the Ecuc module.
          container J1939DcmTxPdu [0..1]  # Contains parameters to configure the J1939DcmTxPdu.
            string J1939DcmTxPduId: scope=ECU, set at pre-compile, symbolic-name-value=true  # The I-PDU identifier used to identify the Tx message.
            reference J1939DcmTxPduRef: post-build-variant-value=true, set at link in variant link-time / post-build in variant post-build / pre-compile in variant pre-compile, destination=Pdu  # Reference to the global Pdu element in the Ecuc module.
