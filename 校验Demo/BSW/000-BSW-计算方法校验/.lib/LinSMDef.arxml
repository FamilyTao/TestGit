AUTOSAR XML (schema 4-2-2)
package /AUTOSAR
  module definition LinSM [0..1]: post-build-variant-support=true, variants link-time/post-build/pre-compile  # Configuration of the Lin State Manager module.
    container LinSMGeneral  # This container contains general parameters of LIN State Manager module.
      enumeration LinSMVariantCfg: {LINSM_VARIANT_PC, LINSM_VARIANT_LT, LINSM_VARIANT_PB}, scope=ECU, post-build-variant-value=true, set at link in variant link-time+post-build / pre-compile in variant pre-compile, default-value=LINSM_VARIANT_PC
      boolean LinSMDevErrorDetect: set at pre-compile, default-value=true  # Switches the Default Error Tracer (Det) detection and notification ON or OFF. | * true: enabled (ON). * false: disabled (OFF).
      float LinSMMainProcessingPeriod: 0.001..Inf, set at pre-compile, default-value=0.01  # Fixed period that the MainFunction shall be called.
      boolean LinSMVersionInfoApi: set at pre-compile  # Switches the LinSM_GetVersionInfo function ON or OFF.
      boolean LinSMTransceiverPassiveModeSupport: set at pre-compile  # Switches the LinSM_GetVersionInfo function ON or OFF.
    container LinSMConfigSet  # This container contains the configuration parameters and sub containers of the AUTOSAR LinSm module.
      integer LinSMModeRequestRepetitionMax: 0..255, post-build-variant-value=true, set at link in variant link-time / post-build in variant post-build / pre-compile in variant pre-compile, default-value=2  # Specifies the maximal amount of mode request repetitions without a respective mode indication from the LinIf module until the LinSM module reports a Default Error to the Det and tries to go back to no communication.
      container LinSMChannel [0..*]  # Describes each LIN channel the LinSM is connected to.
        float LinSMConfirmationTimeout: 0..Inf, set at link in variant link-time+post-build / pre-compile in variant pre-compile, default-value=10  # Timeout in seconds for the goto sleep, wakeup and schedule request calls to LinIf. The timeout must be longer than a goto-sleep command on the bus (i.e. it is bit rate dependent).
        enumeration LinSMNodeType: {MASTER, SLAVE}, set at pre-compile  # Specifies the LIN node type of this channel.
        float LinSMSilenceAfterWakeupTimeout [0..1]: 0..INF, set at link in variant link-time+post-build / pre-compile in variant pre-compile  # Timeout in seconds after a failed wakeup sequence until a new wakeup process is started.
        boolean LinSMTransceiverPassiveMode: multiplicity set at link in variant link-time+post-build / pre-compile in variant pre-compile, set at link in variant link-time+post-build / pre-compile in variant pre-compile  # Selects STANDBY (true) or SLEEP (false) transceiver mode when entering LINSM_NO_COM.
        symbolic name reference LinSMComMNetworkHandleRef: set at link in variant link-time+post-build / pre-compile in variant pre-compile, destination=ComMChannel  # Unique handle to identify one certain LIN network. Reference to one of the network handles configured in the ComM.
        container LinSMSchedule [0..*]  # The schedule references to a schedule that is located in the LinIf configuration. Moreover, the PDU groups are located in the COM configuration. Note that there are two references to PDU groups. The simple reason is that a PDU group is only allowed to contain one direction (TX or RX).
          string LinSMScheduleIndex: set at pre-compile, symbolic-name-value=true, default-value=NULL  # This index parameter can be used by the BswM as a SymbolicNameReference target. The LinSM just forwards the request from the BswM to LinIf. Note that the value of the LinSMScheduleIndex shall be the same as the value from the LinIf.
          boolean NullSchedule: multiplicity set at link in variant link-time+post-build / pre-compile in variant pre-compile, set at link in variant link-time+post-build / pre-compile in variant pre-compile  # Selects STANDBY (true) or SLEEP (false) transceiver mode when entering LINSM_NO_COM.
          symbolic name reference LinSMScheduleIndexRef [0..1]: post-build-variant-value=true, set at link in variant link-time / post-build in variant post-build / pre-compile in variant pre-compile, destination=LinIfScheduleTable  # Reference to a schedule table in the LinIf configuration
