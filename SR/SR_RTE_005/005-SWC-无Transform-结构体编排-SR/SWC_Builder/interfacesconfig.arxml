AUTOSAR XML (schema 4-2-2)
package /AUTOSAR/Interfaces
  sender receiver interface SRIF_AllDataType
    data dataElementPrimitive: type=PrimitiveUint16
    data dataElementArray: type=ArrayUint8
    data dataElementStruct: type=StructA
