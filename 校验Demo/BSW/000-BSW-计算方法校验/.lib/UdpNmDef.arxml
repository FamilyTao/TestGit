AUTOSAR XML (schema 4-2-2)
package /AUTOSAR
  module definition UdpNm [0..1]: variants link-time/pre-compile
    container UdpNmGlobalConfig  # This container contains all global configuration parameters of UDP NM configured from the CanTrcv Module perspective.
      boolean UdpNmBusSynchronizationEnabled: set at pre-compile  # Pre-processor switch for enabling bus synchronization support. This feature is required for gateway nodes only. It must not be defined if UdpNmPassiveModeEnabled==true. This parameter shall be derived from NmBusSynchronizationEnabled. | This feature is required for gateway nodes only. It must not be defined if UDPNM_PASSIVE_MODE_ENABLED is defined. This parameter shall be derived from NM_BUS_SYNCHRONIZATION_ENABLED.
      boolean UdpNmCarWakeUpFilterEnabled [0..1]: set at pre-compile  # If CWU filtering is supported, only the CWU bit within the NM PDU with source node identifier UdpNmCarWakeUpFilterNodeId is considered as CWU request. | FALSE - CWU filtering is not supported TRUE - CWU filtering is supported.
      integer UdpNmCarWakeUpFilterNodeId [0..1]: 0..255, set at pre-compile  # Source node identifier for CWU filtering. If CWU filtering is supported, only the CWU bit within the NM PDU with source node identifier UdpNmCarWakeUpFilterNodeId is considered as CWU request.
      boolean UdpNmCarWakeUpRxEnabled: set at pre-compile, default-value=false  # Enables or disables support of CarWakeUp bit evaluation in received NM PDUs. | FALSE - CarWakeUp not supported. TRUE - CarWakeUp supported.
      boolean UdpNmComControlEnabled: set at pre-compile  # Pre-processor switch for enabling the Communication Control support. | This parameter shall be derived from NM_COM_CONTROL_ENABLED.
      boolean UdpNmComUserDataSupport: set at pre-compile  # Enable/disable the user data support.
      boolean UdpNmCoordinatorSyncSupport: set at pre-compile  # Enables/disables the coordinator synchronization support.
      boolean UdpNmDevErrorDetect: set at pre-compile, default-value=true  # Switches the Default Error Tracer (Det) detection and notification ON or OFF. | * true: enabled (ON). * false: disabled (OFF).
      boolean UdpNmImmediateRestartEnabled [0..1]: set at pre-compile  # Pre-processor switch for enabling the asynchronous transmission of a NM PACKET upon bus-communication request in Prepare-Bus-Sleep mode. | Must not be defined if UDPNM_PASSIVE_MODE_ENABLED is defined.
      boolean UdpNmNodeDetectionEnabled: set at pre-compile  # Pre-processor switch for enabling the node detection support. | This parameter shall be derived from NM_NODE_DETECTION_ENABLED. This parameter shall only be enabled if UDPNM_NODE_ID_ENABLED is defined. If(UdpNmPduCbvPosition != UDPNM_PDU_OFF) then Equal(NmNodeDetectionEnabled) else Equal(False).
      boolean UdpNmNodeIdEnabled: set at pre-compile  # Pre-processor switch for enabling the source node identifier. | This parameter shall be derived from NM_NODE_ID_ENABLED.
      integer UdpNmNumberOfChannels: 1..255, set at pre-compile, default-value=1  # Number of NM channels allowed within one ECU.
      boolean UdpNmPassiveModeEnabled: set at pre-compile  # Pre-processor switch for enabling support of the Passive Mode. | This parameter shall be derived from NM_PASSIVE_MODE_ENABLED.
      boolean UdpNmPduRxIndicationEnabled: set at pre-compile  # Pre-processor switch for enabling the PDU Rx Indication. | This parameter shall be derived from NM_PDU_RX_INDICATION_ENABLED.
      boolean UdpNmPnEiraCalcEnabled [0..1]: multiplicity set at link in variant link-time / pre-compile in variant pre-compile, set at link in variant link-time / pre-compile in variant pre-compile, default-value=false  # Specifies if UdpNm calculates the PN request information for internal and external requests. (EIRA) true: PN request are calculated | false: PN request are not calculated
      float UdpNmPnResetTime [0..1]: 0.001..65.535, multiplicity set at link in variant link-time / pre-compile in variant pre-compile, set at link in variant link-time / pre-compile in variant pre-compile  # Specifies the runtime of the reset timer in seconds. This reset time is valid for the reset of PN requests in the EIRA and in the ERA. The value shall be the same for every channel. Thus it is a global config parameter.
      boolean UdpNmRemoteSleepIndEnabled [0..1]: set at pre-compile  # Pre-processor switch for enabling remote sleep indication support. | This feature is required for gateway nodes only. It must not be defined if UDPNM_PASSIVE_MODE_ENABLED is defined. This parameter shall be derived from NM_REMOTE_SLEEP_IND_ENABLED.
      boolean UdpNmRepeatMsgIndEnabled: set at pre-compile  # Enable/disable the notification that a RepeatMessageRequest bit has been received. | This parameter shall be derived from NM_REPEAT_MSG_IND_ENABLED.
      boolean UdpNmStateChangeIndEnabled: set at pre-compile  # Pre-processor switch for enabling the UDP NM state change notification. | This parameter shall be derived from NM_STATE_CHANGE_IND_ENABLED.
      boolean UdpNmUserDataEnabled: set at pre-compile  # Pre-processor switch for enabling user data support. | This parameter shall be derived from NM_USER_DATA_ENABLED.
      boolean UdpNmVersionInfoApi: set at pre-compile  # Pre-processor switch for enabling version info API support.
      boolean UdpNmGlobalPnEnabled: set at pre-compile  # Pre-processor switch for enabling partial networking support globally.
      reference UdpNmPnEiraRxNSduRef [0..1]: multiplicity set at link in variant link-time / pre-compile in variant pre-compile, set at link in variant link-time / pre-compile in variant pre-compile, destination=Pdu  # Reference to a Pdu in the COM-Stack. Only one SduRef is required for UdpNm because the EIRA is the aggregation over all Ethernet Channels.
      container UdpNmChannelConfig [1..*]  # This container contains the channel-specific configuration parameters of the UdpNm.
        boolean UdpNmActiveWakeupBitEnabled [0..1]: multiplicity set at link in variant link-time / pre-compile in variant pre-compile, set at link in variant link-time / pre-compile in variant pre-compile, default-value=false  # Enables/Disables the handling of the Active Wakeup Bit in the UdpNm module.
        boolean UdpNmAllNmMessagesKeepAwake [0..1]: multiplicity set at link in variant link-time / pre-compile in variant pre-compile, set at link in variant link-time / pre-compile in variant pre-compile, default-value=false  # Specifies if UdpNm drops irrelevant NM PDUs. | false: Only NM PDUs with a PNI bit = true and containing a PN request for this ECU triggers the standard RX indication handling true: Every NM PDU triggers the standard RX indication handling
        integer UdpNmCarWakeUpBitPosition [0..1]: 0..7, multiplicity set at link in variant link-time / pre-compile in variant pre-compile, set at link in variant link-time / pre-compile in variant pre-compile, default-value=0  # Specifies the Bit position of the CWU within the NM PDU.
        integer UdpNmCarWakeUpBytePosition [0..1]: 0..4294967295, multiplicity set at link in variant link-time / pre-compile in variant pre-compile, set at link in variant link-time / pre-compile in variant pre-compile, default-value=0  # Specifies the Byte position of the CWU within the NM PDU.
        float UdpNmImmediateNmCycleTime: 0.001..65.535, multiplicity set at link in variant link-time / pre-compile in variant pre-compile, set at link in variant link-time / pre-compile in variant pre-compile, default-value=0.2  # Defines the immediate NM PDU cycle time in seconds which is used for UdpNmImmediateNmTransmissions NM PDU transmissions.
        integer UdpNmImmediateNmTransmissions [0..1]: 0..255, set at link in variant link-time / pre-compile in variant pre-compile, default-value=0  # Defines the number of immediate NM PDUs which shall be transmitted. If the value is zero no immediate NM PDUs are transmitted.
        float UdpNmMainFunctionPeriod: 0.001..0.255, set at link in variant link-time / pre-compile in variant pre-compile, default-value=0.01  # Call cycle of UdpNm_MainFunction_x for the respective instance in [s].
        float UdpNmMsgCycleOffset [0..1]: 0..65.535, set at link in variant link-time / pre-compile in variant pre-compile, default-value=0.1  # Time offset in the periodic transmission node. It determines the start delay of the transmission. | < UDPNM_MSG_CYCLE_TIME This parameter is only valid if UDPNM_PASSIVE_MODE_ENABLED is disabled.
        float UdpNmMsgCycleTime [0..1]: 0.001..65.535, set at link in variant link-time / pre-compile in variant pre-compile, default-value=0.2  # Period of a NM-message. It determines the periodic rate and is the basis for transmit scheduling. | NM_TIMEOUT_TIME = n * UDPNM_MSG_CYCLE_TIME This parameter is only valid if UDPNM_PASSIVE_MODE_ENABLED is disabled.
        float UdpNmMsgTimeoutTime: 0.001..65.535, set at link in variant link-time / pre-compile in variant pre-compile, default-value=0.2  # Transmission Timout of NM-message. If there is no transmission confirmation by the UDP Interface within this timeout, the UDPNM module shall gibe an error notification. | This parameter is only valid if UDPNM_PASSIVE_MODE_ENABLED is disabled. UDPNM_MSG_TIMEOUT_TIME should be a multiple of UDPNM_MSG_CYCLE_TIME.
        integer UdpNmNodeId [0..1]: 0..255, set at link in variant link-time / pre-compile in variant pre-compile, default-value=50  # Node identifier of local node. | This parameter is only valid if UDPNM_PASSIVE_MODE_ENABLED is set to OFF and UDPNM_NODE_DETECTION_ENABLED is set to ON.
        enumeration UdpNmPduCbvPosition: {UDPNM_PDU_BYTE_0, UDPNM_PDU_BYTE_1, UDPNM_PDU_OFF}, set at link in variant link-time / pre-compile in variant pre-compile, default-value=UDPNM_PDU_BYTE_1  # Defines the position of the control bit vector within the NM PACKET. | The value of the parameter represents the location of the control bit vector in the NM PACKET (UDPNM_PDU_BYTE_0 means byte 0, UDPNM_PDU_BYTE_1 means byte 1, UDPNM_PDU_OFF means the control bit vector is not part of the NM PACKET) See also UDPNM_PDU_NID_POSITION if (UDPNM_PDU_CBV_POSITION != UDPNM_PDU_OFF && UDPNM_PDU_NID_POSITION != UDPNM_PDU_OFF) then UDPNM_PDU_CBV_POSITION != UDPNM_PDU_NID_POSITION if (UDPNM_PDU_CBV_POSITION != UDPNM_PDU_OFF && UDPNM_PDU_NID_POSITION == UDPNM_PDU_OFF) then UDPNM_PDU_CBV_POSITION = UDPNM_PDU_BYTE0
        integer UdpNmPduLength: 0..8, scope=ECU, set at link in variant link-time / pre-compile in variant pre-compile, default-value=8  # Defines the length of the NM PACKET in bytes. | Valid values are within the range 0 <= UDPNM_PDU_LENGTH <= 8.
        enumeration UdpNmPduNidPosition: {UDPNM_PDU_BYTE_0, UDPNM_PDU_BYTE_1, UDPNM_PDU_OFF}, set at link in variant link-time / pre-compile in variant pre-compile, default-value=UDPNM_PDU_BYTE_0  # Defines the position of the source node identifier within the NM PACKET. | ImplementationType: UdpNm_PduPositionType The value of the parameter represents the location of the source node identifier in the NM PACKET (UDPNM_PDU_BYTE_0 means byte 0, UDPNM_PDU_BYTE_1 means byte 1, UDPNM_PDU_OFF means source node identifier is not part of the NM PACKET) See also UDPNM_PDU_CBV_POSITION if (UDPNM_PDU_NID_POSITION != UDPNM_PDU_OFF && UDPNM_PDU_CBV_POSITION != UDPNM_PDU_OFF) then UDPNM_PDU_NID_POSITION != UDPNM_PDU_CBV_POSITION if (UDPNM_PDU_NID_POSITION != UDPNM_PDU_OFF && UDPNM_PDU_CBV_POSITION == UDPNM_PDU_OFF) then UDPNM_PDU_IND_POSITION = UDPNM_PDU_BYTE0
        boolean UdpNmPnEnabled: multiplicity set at link in variant link-time / pre-compile in variant pre-compile, set at link in variant link-time / pre-compile in variant pre-compile, default-value=false  # Enables or disables support of partial networking. | false: Partial networking Range not supported true: Partial networking supported
        boolean UdpNmPnEraCalcEnabled: multiplicity set at link in variant link-time / pre-compile in variant pre-compile, set at link in variant link-time / pre-compile in variant pre-compile, default-value=false  # Specifies if UdpNm calculates the PN request information for external requests. (ERA) | false: PN request are not calculated true: PN request are calculated.
        boolean UdpNmPnHandleMultipleNetworkRequests [0..1]: multiplicity set at link in variant link-time / pre-compile in variant pre-compile, set at link in variant link-time / pre-compile in variant pre-compile, default-value=false  # false: UdpNm_NetworkRequest is ignored in NO. | true: UdpNm_NetworkRequest triggers a change from NO to RM.
        float UdpNmRemoteSleepIndTime [0..1]: 0.001..65.535, set at link in variant link-time / pre-compile in variant pre-compile, default-value=0.6  # Timeout for Remote Sleep Indication. | It defines the time in [s] how long it shall take to recognize that all other nodes are ready to sleep. Typically it should be equal to: n * UDPNM_MSG_CYCLE_TIME, where n denotes the number of NM packets that are normally sent before Remote Sleep Indication is detected. The value of n decremented by one determines the amount of lost NM packets that can be tolerated by the Remote Sleep Indication procedure.
        float UdpNmRepeatMessageTime: 0..65.535, set at link in variant link-time / pre-compile in variant pre-compile, default-value=2  # Timeout for Repeat Message State. | It defines the time in [s] how long the NM shall stay in the Repeat Message State. Typically it should be equal to: n * UDPNM_MSG_CYCLE_TIME, where n denotes the number of NM packets that are normally sent in the Repeat Message State. The value of n decremented by one determines the amount of lost NM packets that can be tolerated by the node detection procedure. The value 0 denotes that no Repeat Message State is configured. It means that Repeat Message State is transient what implicates that it is left immediately after entrance and in result no start-up stability is guaranteed and no node detection procedure is possible.
        boolean UdpNmRetryFirstMessageRequest [0..1]: multiplicity set at link in variant link-time / pre-compile in variant pre-compile, set at link in variant link-time / pre-compile in variant pre-compile  # Specifies if first message request in UdpNm is repeated until accepted by SoAd.
        boolean UdpNmStayInPbsEnabled: set at link in variant link-time / pre-compile in variant pre-compile, default-value=false  # If this parameter is disabled Prepare Bus-Sleep Mode is left after UdpNmWaitBusSleepTime. If this parameter is enabled Prepare Bus-Sleep Mode can only be left if ECU is powered off or any restart reason applies.
        float UdpNmTimeoutTime: 0.002..65.535, set at link in variant link-time / pre-compile in variant pre-compile, default-value=5  # Network Timeout for NM packets. | It denotes the time in [s] how long the NM shall stay in the Network Mode before transition into Prepare Bus-Sleep Mode shall take place. It shall be equal for all nodes in the cluster. It shall be greater than UDPNM_MSG_CYCLE_TIME. Typically, it should be equal to: x * UDPNM_MSG_CYCLE_TIME, where n denotes the number of NM PACKET cycle times in the Ready Sleep State before transition into the Bus-Sleep Mode is initiated. The value of n decremented by one determines the amount of lost NM packets that can be tolerated by the coordination algorithm.
        float UdpNmWaitBusSleepTime: 0.001..65.535, set at link in variant link-time / pre-compile in variant pre-compile, default-value=1.5  # Timeout for bus calm down phase. | It denotes the time in [s] how long the NM shall stay in the Prepare Bus-Sleep Mode before transition into Bus-Sleep Mode shall take place. It shall be equal for all nodes in the cluster. It shall be long enough to empty all Tx-buffer empty.
        reference UdpNmPnEraRxNSduRef [0..1]: multiplicity set at link in variant link-time / pre-compile in variant pre-compile, set at link in variant link-time / pre-compile in variant pre-compile, destination=Pdu  # Reference to a Pdu in the COM-Stack. The SduRef is required for every UdpNm Channel, because ERA is reported per channel.
        symbolic name reference UdpNmComMNetworkHandleRef: scope=ECU, set at link in variant link-time / pre-compile in variant pre-compile, destination=ComMChannel  # This reference points to the unique channel defined by the ComMChannel and provides access to the unique channel index value in ComMChannelId.
        container UdpNmRxPdu [1..*]  # This container describes the UdpNm RX PDU's.
          string UdpNmRxPduId: 0..65535, scope=ECU, set at pre-compile, symbolic-name-value=true  # ID of the RxPdu that will be used by a RxIndication of the lower layer.
          reference UdpNmRxPduRef: set at link in variant link-time / pre-compile in variant pre-compile, destination=Pdu  # The reference to a PDU in the global PDU structure described in the AUTOSAR ECU Configuration Specification. This reference will be used by the UdpNm module to derive the PDU Id.
        container UdpNmTxPdu [0..1]  # This container describes the UdpNm TX PDU's.
          string UdpNmTxConfirmationPduId: 0..65535, scope=ECU, set at pre-compile, symbolic-name-value=true  # Id of the TxPdu that will be used by a TxConfirmation from the lower layer.
          reference UdpNmTxPduRef: set at link in variant link-time / pre-compile in variant pre-compile, destination=Pdu  # The reference to a PDU in the global PDU structure described in the AUTOSAR ECU Configuration Specification. This reference will be used by the UdpNm module to derive the PDU Id.
        container UdpNmUserDataTxPdu [0..1]  # This optional container is used to configure the UserNm PDU. This container is only available if UdpNmComUserDataSupport is enabled.
          string UdpNmTxUserDataPduId: 0..65535, scope=ECU, set at pre-compile, symbolic-name-value=true  # ID of the RxPdu that will be used by a RxIndication of the lower layer.
          reference UdpNmTxUserDataPduRef: set at link in variant link-time / pre-compile in variant pre-compile, destination=Pdu  # Reference to the NM User Data I-PDU in the global PDU collection.
      container UdpNmPnInfo [0..1]  # PN information configuration
        integer UdpNmPnInfoLength: 1..7, set at link in variant link-time / pre-compile in variant pre-compile, default-value=1  # Specifies the length of the PN request information in the NM message.
        integer UdpNmPnInfoOffset: 1..7, set at link in variant link-time / pre-compile in variant pre-compile, default-value=1  # Specifies the offset of the PN request information in the NM message.
        container UdpNmPnFilterMaskByte [0..7]  # PN information configuration
          integer UdpNmPnFilterMaskByteIndex: 0..6, set at link in variant link-time / pre-compile in variant pre-compile, default-value=0  # Index of the filter mask byte. Specifies the position within the filter mask byte array.
          integer UdpNmPnFilterMaskByteValue: 0..255, set at link in variant link-time / pre-compile in variant pre-compile, default-value=0  # Parameter to configure the filter mask byte.
