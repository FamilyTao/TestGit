AUTOSAR XML (schema 4-2-2)
package /AUTOSAR
  module definition CryIf [0..1]  # Configuration of the Crypto Interface.
    container CryIfIncludes [0..1]  # Container for callback function configurations
      container CryIfInclude [0..*]: multiplicity set at pre-compile
        string IncludeName: multiplicity set at pre-compile, set at pre-compile
    container CryIfGeneral  # Container for incorporation of CryIfGeneral.
      boolean CryIfDevErrorDetect: default-value=true  # Switches the development error detection and notification on or off. | true: detection and notification is enabled. false: detection and notification is disabled.
      boolean CryIfVersionInfoApi: default-value=false  # Pre-processor switch to enable and disable availability of the API CryIf_GetVersionInfo(). | True: API CryIf_GetVersionInfo() is available False: API CryIf_GetVersionInfo() is not available.
      boolean CryIfMulDriverSupport: default-value=false  # Whether multi drive is supported. | True: API CryIf_GetVersionInfo() is available False: API CryIf_GetVersionInfo() is not available.
    container CryIfChannel [0..*]  # Container for incorporation of CryIfChannel.
      integer CryIfChannelId: 0..4294967295, symbolic-name-value=true  # Identifier of the crypto channel. | Specifies to which crypto channel the CSM queue is connected to.
      string CryptoDriverInterfaceName: multiplicity set at pre-compile, set at pre-compile  # This parameter defines the name of the Crypto_(vi)_(ai)
      reference CryIfDriverObjectRef: requires-symbolic-name-value=true, destination=CryptoDriverObject  # This parameter refers to a Crypto Driver Object. | Specifies to which Crypto Driver Object the crypto channel is connected to
    container CryIfKey [0..*]  # Container for incorporation of CryIfKey.
      integer CryIfKeyId: 0..4294967295, symbolic-name-value=true  # Identifier of the CryIf key. | Specifies to which CryIf key the CSM key is mapped to.
      integer CryIfChannelIdd: 1..4294967295, symbolic-name-value=true
      reference CryIfKeyRef: requires-symbolic-name-value=true, destination=CryptoKey  # This parameter refers to the crypto driver key. | Specifies to which crypto driver key the CryIf key is mapped to.
