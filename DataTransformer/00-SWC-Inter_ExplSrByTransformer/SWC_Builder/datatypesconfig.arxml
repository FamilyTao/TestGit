AUTOSAR XML (schema 4-2-2)
standard types defined: sint8, uint8, sint16, uint16, sint32, uint32, sint64, uint64, float, double, boolean
package /AUTOSAR/DataTypes
  impl type IdtUint8: category=VALUE, base-type=uint8
  impl type StructA: category=STRUCTURE
    4 x element:
      Data16: category=VALUE, base-type=uint16
      Crc8: category=VALUE, base-type=uint8
      Counter8: base-type=uint8
      Data8: base-type=uint8
package /AUTOSAR/SwBaseTypes
  4 x base type, all with category=FIXED_LENGTH:
    sint4: base-type-size=4, base-type-encoding=VOID, native-declaration=sint4
    uint4: base-type-size=4, base-type-encoding=NONE, native-declaration=uint4
    char8: base-type-size=8, base-type-encoding=NONE, native-declaration=char8
    char16: base-type-size=19, base-type-encoding=NONE, native-declaration=char16
